## Documentation/devicetree/bindings/dma/sprd-dma.txt
```
Spreadtrum DMA Controller

Required properties:
- compatible: "sprd,ap-dma-v1.0".
	There are different DMA IP versions for different Spreadtrum SoC families.
	So we use specified IP to compatible different SoC.
	e.g. ap-dma-v0.0(sharkl);aon-dma-v0.0(sharkl);ap-dma-v1.0(whale);agcp-dma-v1.0(whale);
	ap-dma-v2.0(whale2);agcp-dma-v2.0(whale2).
	Required properties:
	compatible: should be one of following:
		"sprd,ap-dma-v0.0" - compatible with ports present on sharkl SoC,
		"sprd,aon-dma-v0.0" - compatible with ports present on sharkl SoC,
		"sprd,ap-dma-v1.0" - compatible with ports present on whale SoC,
		"sprd,agcp-dma-v1.0" - compatible with ports present on whale SoC,
		"sprd,ap-dma-v2.0" - compatible with ports present on whale2 SoC,
		"sprd,agcp-dma-v2.0" - compatible with ports present on whale2 SoC.
- reg: Address range of the DMAC registers.
- dma-channels: Number of channels supported by hardware.
- #dma-cells: must be <1>.
- sprd,aon-offset: The AON dma controller channel number offset.
- sprd,full-type-offset: The full type channel number offset for AP/AGCP or AON dma.
- sprd,syscon-dma-glb: DMA glb reg base.
- clock-names: DMA clock enable/disabe name.
- clocks: DMA clock enable/disable bit.

Optional properties:
- interrupt: Should contain the DMAC interrupt number.
	There are some DMAC do not need to request interrupts, because these interrupts
	could be handled by others subsys.

Example:

	dma: dma-controller@20100000 {
		compatible = "sprd,ap-dma-v1.0";
		reg = <0 0x20100000 0 0x4000>,	/* ap reg */
		      <0 0x40100000 0 0x4000>;	/* aon reg */
		interrupts = <0 50 0x0>,		/* ap int */
			     <0 70 0x0>;		/* aon int */
		#dma-channels = <64>;
		#dma-cells = <1>;
		sprd,aon-offset = <33>;
		sprd,full-type-offset = <25 25>;	/* ap & aon */
		sprd,syscon-dma-glb = <&ap_ahb_controller>;
		clock-names = "enable";
		clocks = <&clk_ap_ahb_gates 5>;

	};

DMA clients must use the format described in the dma.txt file, using a two cell
specifier for each channel.

Example:

	uart0: serial@70000000 {
		compatible = "sprd,sc9836-uart",
			     "sprd,sc9838-uart";
		reg = <0 0x70000000 0 0x100>;
		interrupts = <GIC_SPI 2 IRQ_TYPE_LEVEL_HIGH>;
		clocks = <&ext_26m>;
		status = "disabled";
		dmas = <&dma 0>,
		       <&dma 1>;
		dma-names = "rx", "tx";
	};
```

## Documentation/devicetree/bindings/fuse/sprd_efuse.txt
```
* Spreadtrum efuse Controller
-----------------------------------------------------
The Spreadtrum efuse Controller provides an interface to read and write efuse
There are two efuse chips: Generic efuse for AP part , efuse for PMIC.
Generic efuse reg  have register address and length.
Efuse of PMIC only have Registers location.

Required properties:
- compatible: "sprd,efuse"
              "sprd,sc2723-efuse"
              "sprd,ap_r6p0_efuse"
- reg: Registers address and [length] (length is not required for PMIC efuse)

Optional properties:
- sprd,syscon-enable: use aon apb controller(optional for PMIC efuse);
- clocks: use ap efuse clk eb to enable clk control.
- sprd,uid-start: uid block start.
- sprd,uid-end : uid block end.
- sprd,block-start: public efuse start block index.
- sprd,block-num: public efuse block number.
- sprd,block-width: public efuse width.
- hwlocks: ap efuse use spinlock index.


Example:
	ap_efuse: efuse@40240000 {
				compatible = "sprd,efuse";
				sprd,syscon-enable = <&aon_apb_controller>;
				reg = <0 0x40240000 0 0x48>;
			};

	pmic_efuse: efuse@200 	{
				compatible = "sprd,sc2723-efuse";
				reg = <0x200>;
			};

	ap_efuse: efuse@40240000 {
				compatible = "sprd,ap_r6p0_efuse";
				sprd,syscon-enable = <&aon_apb_controller>;
				reg = <0x40240000 0x10000>;
				clock-names = "enable";
				clocks = <&clk_aon_apb_gates0 13>;
				sprd,uid-start= <46>;
				sprd,uid-end= <47>;
				sprd,block-start= <36>;
				sprd,block-num = <12>;
				sprd,block-width = <32>;
				hwlocks = <&hwslock1 8>;
				hwlock-names = "ap_efuse";
			};
```

## Documentation/devicetree/bindings/gpio/gpio-sprd.txt
```
* SPREADTRUM GPIO controller bindings

Required properties:
- compatible: "sprd,ap-eic".
  where <chip> is digital(sc9838) or analog(sc2723t),
  eic is a gpi with the capability to latch a signal or debounce a signal,
  gpio did not have the capability.
- reg: Should contain GPIO controller registers location and length
- interrupts: Should be the port interrupt shared by all the gpios.
- #gpio-cells: Should be two.  The first cell is the gpio number and
  the second cell is used to specify optional parameters (currently
  unused).
- gpio-controller: Marks the device node as a GPIO controller.
- sprd,gpiobase: identifies the first GPIO number handled by the chip.
- sprd,ngpios: the number of GPIOs handld by the controller.


Example:
	ap_eic: gpio-controller@40210000 {
		compatible = "sprd,ap-eic";
		reg = <0 0x40210000 0 0x1000>;
		gpio-controller;
		#gpio-cells = <2>;
		sprd,gpiobase = <288>;/*TODO:Need to be changed when pinctrl driver is ready*/
		sprd,ngpios = <16>;
		interrupt-controller;
		#interrupt-cells = <2>;
		interrupts = <GIC_SPI 37 IRQ_TYPE_LEVEL_HIGH>;
	};
```

## Documentation/devicetree/bindings/gpu/spreadtrum,gpu-midgard.txt
```
* ARM Mali-T720 GPU
* It has common properties with mali-utgard, as described in spreadtrum,gpu.txt.

Required properties:
    - compatible : "sprd,mali-midgard" for mali T720 IP present in SC9838 etc. SoC

    - operating-points : It's the DVFS optional frequence range of GPU which depends on Linux Kernel. example:
        153600 means the clock source frequence is 153600 kHz,
        0  is current voltage.

Example:
	gpu@60000000 {
		compatible = "arm,mali-midgard";
		...

		operating-points = <
			/* kHz   uV */
			512000   0
			384000   0
			256000   0
			153600   0
			>;

		...
	};


* ARM Mali-T820 GPU
* It has common properties with mali-utgard, as described in spreadtrum,gpu.txt.

Required properties:
    - compatible : "sprd,mali-midgard" for mali T820 IP present in sc9850j etc. SoC

    - system-coherency : Selecting the coherency mode of the platform is done through device tree. The following modes are supported for cci400:
	0  : ACE-Lite
	31 : no coherency

Example:
	gpu@60000000 {
		compatible = "arm64,mali-midgard";
		...

		system-coherency = <31>;
	};
```

## Documentation/devicetree/bindings/gpu/spreadtrum,gpu-rogue.txt
```
* IMG Rogue GPU
* It has common properties with mali, as decribed in spradtrum,gpu.txt.

Required properties:
    - compatible : "sprd,rogue" for rogue IP present in iwhale2 etc. SoC

Optional properties:
    - operating-points : It's the DVFS optional frequence range of GPU which depends on Linux Kernel. example:
        384000 means the clock source frequence is 384000 kHz,
        840000 is current voltage is 0.84v.

Example:
    gpu@60000000 {
        compatible = "sprd,rogue";
        ...

        operating-points = <
                     /* kHz    uV */
                     384000    840000
                     512000    1050000
                     700000    1050000
                     >;

        ...
    };
```

## Documentation/devicetree/bindings/gpu/spreadtrum,gpu-utgard.txt
```
* ARM Mali-300/400/450 GPU
* It has common properties with mali-midgartd, as decribed in spradtrum,gpu.txt.

Required properties:
    - compatible : "arm,mali-400" "sprd,mali-utgard" for mali 400 IP present in SC9830 etc. SoC

Optional properties:
    - pmu_domain_config:
        - If the Mali internal PMU is present and the PMU IRQ is specified in
            interrupt/interrupt-names ("IRQPMU").This contains the mapping of
            Mali HW units to the PMU power domain.
        -Mali Dynamic power domain configuration in sequence from 0-11, like:
            <GP PP0 PP1 PP2 PP3  PP4 PP5 PP6 PP7 L2$0 L2$1 L2$2>.

    - pmu-switch-delay:
        - Only needed if the power gates are connected to the PMU in a high fanout
            network. This value is the number of Mali clock cycles it takes to
            enable the power gates and turn on the power mesh. This value will
            have no effect if a daisy chain implementation is used.

Example:
	gpu@60000000 {
		compatible = "arm,mali-400", "arm,mali-utgard";
		...

		pmu_domain_config = <0x1000 0x1000 0x1000
			0x0 0x0 0x0
			0x0 0x0 0x0
			0x1000 0x0 0x0>;
		pmu_switch_delay = <0xffff>;

		...
	};
```

## Documentation/devicetree/bindings/gpu/spreadtrum,gpu.txt
```
* Spreadtrum  GPU HW Accelerator Common Properties

Required properties:
  - compatible : For more details, please refer to utgard, midgard and rogue

  - reg : Physical base address and length of the GPU's registers.

  - sprd,syscon-pmu-apb : PMU-APB bus node, used to get GPU status.

  - interrupts:
        List of all Mali interrupts.
        This list must match the number of and the order of entries in interrupt-names.

  - interrupt-names:
        - IRQPP<X> - Name for PP interrupts.
        - IRQPPMMU<X> -  Name for interrupts from the PP MMU.
        - IRQPP - Name for the PP broadcast interrupt (Mali-450 only).
        - IRQGP - Name for the GP interrupt.
        - IRQGPMMU - Name for the interrupt from the GP MMU.
        - IRQPMU - Name for the PMU interrupt (If pmu is implemented in HW, it must be contained).

  - clocks : Should not be changed, it's set according to the chip design.

    Note : these below "sprd,dfs-xxx" configurations are sprd private, should not be arbitrarily modified.

  - sprd,dfs-lists : It's the DFS optional frequence range of GPU, example:
    <153600 2 1> means the clock source frequence is 153600 kHz,
                2 is an index of gpu parent clocks array that descripted in chipset spec,
                1 is divisor of this clock source, it only can be changed according to the spec.

  - sprd,dfs-default : The default frequence of GPU. The number is the index of sprd,dfs-lists.

  - sprd,dfs-scene-extreme : It means these scene that need extreme high performance,
                             GPU should run at the chosen frequence.

  - sprd,dfs-scene-high : It means these scene that need high performance,
                             GPU should run at the chosen frequence.

  - sprd,dfs-scene-medium: It means these scene that need medium performance,
                             GPU should run at the chosen frequence.

  - sprd,dfs-scene-low: It means these scene that need to save power,
                             GPU should run at the chosen frequence.

  - sprd,dfs-range-max : DFS max range, the number is the index of sprd,dfs-lists.

  - sprd,dfs-range-min : DFS min range, the number is the index of sprd,dfs-lists.

Example:
	gpu@60000000 {
		compatible = "arm,mali-400", "arm,mali-utgard";
		reg = <0x60000000 0x10000>;
		sprd,syscon-pmu-apb = <&pmu_apb_controller>;
		interrupts = <GIC_SPI 39 IRQ_TYPE_LEVEL_HIGH>,
			<GIC_SPI 39 IRQ_TYPE_LEVEL_HIGH>,
			<GIC_SPI 39 IRQ_TYPE_LEVEL_HIGH>,
			<GIC_SPI 39 IRQ_TYPE_LEVEL_HIGH>,
			<GIC_SPI 39 IRQ_TYPE_LEVEL_HIGH>,
			<GIC_SPI 39 IRQ_TYPE_LEVEL_HIGH>,
			<GIC_SPI 39 IRQ_TYPE_LEVEL_HIGH>;
		interrupt-names = "IRQGP",
			"IRQGPMMU",
			"IRQPP0",
			"IRQPPMMU0",
			"IRQPP1",
			"IRQPPMMU1",
			"IRQPMU";

		clocks = <&clk_aon_apb_gates0 27>,<&clk_gpu>,
			<&clk_twpll_153m6>,<&clk_twpll_192m>,
			<&clk_twpll_256m>,<&clk_twpll_307m2>,
			<&clk_twpll_384m>,<&clk_twpll_512m>;

		sprd,dfs-lists = <
			/* kHz	idx	div */
			153600	2	1
			256000	4	1
			384000	6	1
			512000	7	1
			>;

		sprd,dfs-default = <1>;
		sprd,dfs-scene-extreme = <2>;
		sprd,dfs-scene-high = <1>;
		sprd,dfs-scene-medium = <1>;
		sprd,dfs-scene-low = <0>;
		sprd,dfs-range-max = <3>;
		sprd,dfs-range-min = <0>;
	};
```

## Documentation/devicetree/bindings/hwspinlock/hwsplock-sprd.txt
```
Spreadtrum hardware spinlock controller binding

Required properties:
- compatible: Should be "sprd,hwspinlock-r2p0", it's similar to that on sc9838 SoC family.
- reg: Offset and length of hardware spinlock controller register space.
- hwlocks-base: Assign a base id to register the hwspinlock controller.
- hwlocks-num: The number of the hardware spinlock.
- resets: The resets property is related to reset source.
- reset-names: Its purpose is to constrain resets property.
- clock-names: Clock-names should be "enable" specified in hwspinlock driver.
	       Its purpose is to constrain clocks property.
- clocks: The freq of apb clk connected to hwspinlock module.
- sprd,axi-id: Setting this property to make HWSPINLCOK record AXI ID. If no,
	       the HWSPINLOCK will record the USERID as default.

Example:
	hwslock1: hwspinlock@40060000{
		compatible  = "sprd,hwspinlock-r2p0";
		reg = <0 0x40060000 0 0x1000>;
		#hwlock-cells = <1>;
		hwlocks-base = <0>;
		hwlocks-num = <32>;
		resets = <&aon_rst 24>;
		reset-names = "hwspinlock1";
		clock-names = "enable";
		clocks = <&clk_aon_apb_gates0 22>;
	};
```

## Documentation/devicetree/bindings/hwspinlock/hwsplock.txt
```
Hardware spinlock controller binding

* Hardware spinlock controller

Required property:
- #hwlock-cells: Must be at least 1. Used to provide hardware lock controller specific information.
- hwlocks-base: Specify the hwlocks base id of this controller to register into the hwlocks radix tree.

Optional properties:
- hwlocks-num: Number of hardware spinlock supported by the controller.

Example:
	hwslock0: hwlocks@20c00000{
		compatible  = "sprd,sc9838-hwspinlock";
		reg = <0 0x20c00000 0 0x1000>;
		#hwlock-cells = <1>;
		hwlocks-base = <32>;
		hwlocks-num = <32>;
	};

* Users of hardware spinlock

The users' driver should specify the hardware spinlock property using a phandle.

Required property:
- hwlocks: Each consisting of
	- A phandle pointing to hardware spinlock controller node.
	- A number of integer cells, as determined by the #hwlock-cells
	property in the node referenced by phandle containing hardware
	spinlock controller specific information. This typically contains
	a hardware spinlock id, but can contain any data that is required
	for configuring a hardware spinlock.
- hwlock-names: Contains one identifier string for each hardware spinlock in
	the hwlocks property. The specific strings that can be used are defined
	in the binding of the client device.

Examples:
	adc@1 {
		...
		hwlocks = <&hwslock0 2 &hwslock0 3>;
		hwlocks-names = "lock0", "lock1";
		...
	};
```

## Documentation/devicetree/bindings/i2c/i2c-sprd.txt
```
I2C for Spreadtrum platforms

Required properties:
- compatible: Should be "sprd,r7p0-i2c".
- reg: physical base address of the controller and length of memory mapped region.
- interrupts: Should contain I2C interrupt.
- clock-names:	The i2C for spreadtrum clock-names should contain i2c
		clock node, source clk node ,i2c module enable clock node.
		Clock-names is fixed in i2c drivers, and its purpose is to
		constrain the order of clocks property.Consumers drivers
		will use clock-names to match clock input names with clocks
		specifiers.
- clocks: The freq of source clk connected to i2c.List of clock input name
	  strings sorted in the same order as the clocks property.
- clock-frequency: The property is communication frequency of i2c controller
- #address-cells: Should be <1> address cells for i2c device address
- #size-cells: Should be <0> as i2c addresses have no size component

Optional properties:
- Child nodes conforming to i2c bus binding

Examples:
i2c0: i2c@70500000 {
	compatible = "sprd,r7p0-i2c";
	reg = <0 0x70500000 0 0x1000>;
	interrupts = <GIC_SPI 11 IRQ_TYPE_LEVEL_HIGH>;
	clock-names = "i2c", "source","enable";
	clocks = <&clk_i2c3>, <&ext_26m>,
		<&clk_ap_apb_gates 11>;
	clock-frequency = <400000>;
	#address-cells = <1>;
	#size-cells = <0>;
};
```
