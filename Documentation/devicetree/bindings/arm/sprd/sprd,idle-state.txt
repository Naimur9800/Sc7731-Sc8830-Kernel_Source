## Documentation/devicetree/bindings/iio/adc/sprd_adc.txt
```
Spreadtrum PMIC Analog to Digital Converter (ADC)

Required properties:
  - compatible: Should be one of
		"sprd,sc2723t-adc":when using sprd sc2723 pmic device
		"sprd,sc2731-adc": when using sprd sc2731 pmic device
  - reg: Registers address
  - #io-channel-cells: Should be 1, see ../iio-bindings.txt

Example:
pmic_adc: adc@300{
			compatible = "sprd,sc2723-adc";
			reg = <0x300>;
			#io-channel-cells = <1>;
		 };
```

## Documentation/devicetree/bindings/iio/sprd_hub/sprd_sensorhub.txt
```
Device-Tree bindings for SPREADTRUM Sensor Hub driver

Required properties:
	- compatible: must be "sprd,sensorhub"

Optional properties:
	- null ,may add some properties for compatible no-sensorhub or other funtions later.

Example:
	sprd_sensorhub {
		compatible = "sprd,sensorhub";
	};
```
