## Documentation/devicetree/bindings/arm/sprd/sprd,idle-state.txt
```
SPRD Idle States for cpuidle driver

The devicetree representation of the idle state should be -

Required properties:

- compatible: Must be one of -
	"sprd_dummy,idle-state",and "arm,idle-state".

Other required and optional properties are specified in
Documentation/devicetree/bindings/arm/idle-states.txt

Example:

	idle-states {
		entry-method = "arm,psci";
		LIGHT_SLEEP: light_sleep {
			compatible = "sprd_dummy,idle-state";
			entry-latency-us = <1000>;
			exit-latency-us = <700>;
			min-residency-us = <2500>;
			local-timer-stop;
			arm,psci-suspend-param = <0x00010002>;
		};
		HEAVY_SLEEP: heavy_sleep {
			compatible = "sprd_dummy,idle-state";
			entry-latency-us = <1000>;
			exit-latency-us = <1000>;
			min-residency-us = <3000>;
			local-timer-stop;
			arm,psci-suspend-param = <0x01010003>;
		};
	};
```

## Documentation/devicetree/bindings/bluetooth/brcm,bluesleep.txt
```
Broadcom Bluesleep Device

Required properties:

- compatible: should be "brcm,bluesleep"
- bt-wake-host-gpios: Broadcom bt wake up baseband chip
- host-wake-bt-gpios: baseband chip wake up Broadcom chip

Example:

bluesleep {
	compatible = "brcm,bluesleep";
	bt-wake-host-gpios = <&ap_gpio 86 0>;
	host-wake-bt-gpios = <&ap_gpio 85 0>;
};
```

## Documentation/devicetree/bindings/bluetooth/brcm,rfkill.txt
```
Broadcom Rfkill Device

Required properties:

- compatible: should be "brcm,rfkill"
- power-gpios: power up broadcom chip
- reset-gpios: reset broadcom chip

Example:

rfkill {
	compatible = "brcm,rfkill";
	power-gpios = <&ap_gpio 92 0>;
	reset-gpios = <&ap_gpio 122 0>;
};
```

## Documentation/devicetree/bindings/clock/sprd/sprd,adjustable-pll-clock.txt
```
Spreadtrum adjust pll clock driver.

Spreadtrum platform have some adjustable pll clock, this is used for sprd
adjustable pll clock driver.

Required properties:

- compatible : shall be: "sprd,iwhale2-adjustable-pll-clock" or
			 "sprd,sc9838-adjustable-pll-clock"

Example:

	clk_mpll: clk@402e0044 {
		compatible = "sprd,sc9838-adjustable-pll-clock";
		#clock-cells = <0>;
		reg = <0 0x402e0044 0 0x4>,
		      <0 0x402e0048 0 0x4>;
		clocks = <&clk_mpll_gate>;
		clock-output-names = "clk_mpll";
	};
```

## Documentation/devicetree/bindings/clock/sprd/sprd,composite-clock.txt
```
Spreadtrum composite clock driver.

Required properties:

- compatible : should be "sprd,composite-clock".

- sprd,mux-msk : Composite clocks which have multiple clock sources must
		 have this property. And there must has a register which
		 contains some bits can be used to select parent. This
		 property stands for these bits' mask.

- sprd,div-msk : Composite clocks which have divider function must have
		 this property. And a register will be used for dividering
		 the source clock. This property stands for these bits' mask.

- sprd,gate-msk : Composite clocks which have gate function must have
		  this property. If having this property, there must have
		  a register can be used for gating the clock. Gating the
		  clock only need one bit. This property can used for mask
		  the gate bit.

Example:

	clk_sensor: clk@60e00024 {
		compatible = "sprd,composite-clock";
		#clock-cells = <0>;
		reg = <0 0x60e00024 0 0x4>;
		clocks = <&ext_26m>, <&clk_twpll_48m_def>,
			 <&clk_twpll_76m8_def>, <&clk_twpll_96m_def>;
		clock-output-names = "clk_sensor";
		sprd,mux-msk = <0x3>;
		sprd,div-msk = <0x700>;
	};
```

## Documentation/devicetree/bindings/clock/sprd/sprd,divider-clock.txt
```
Spreadtrum divider clock driver.

Spreadtrum divider clock only supports simple indexed divider.

Required properties:

- compatible : should be "sprd,divider-clock"

- sprd,div-msk : The divider clock's register has some bits used for
		 dividering it's parent clock. The property is the mask
		 of these bits.

Example:

	clk_ca7_big_axi: clk_ca7_big_axi {
		compatible = "sprd,divider-clock";
		#clock-cells = <0>;
		reg = <0 0x20e00038 0 0x4>;
		sprd,div-msk = <0x700>;
		clocks = <&clk_big_mcu>;
		clock-output-names = "clk_ca7_big_axi";
	};
```

## Documentation/devicetree/bindings/clock/sprd/sprd,gates-clock.txt
```
Spreadtrum gate clock driver.

Spreadtrum chip often uses one register to control more than one gate clock.
consumers should use index to get the correct gate clock according to asic
design documents.

Required properties:

- compatible : should be "sprd,gates-clock"

- #clock-cells: must be set 1.

- sprd,gates-msk: Sprd chip gates clocks are gathering to a few registers.
		  This property should follow with the asic documents and
		  it indicates the gate index bit in register.Module user
		  should follow asic documents to get correct gate index.

- clock-output-names : The output name indicates the gates name.

Example:

	clk_mpll_gates: clk@402b00b0 {
		compatible = "sprd,gates-clock";
		#clock-cells = <1>;
		reg = <0 0x402b00b0 0 0x4>;
		sprd,gates-msk = <0x40004>;
		clocks = <&ext_26m>;
		clock-output-names = "clk_mpll0_gate", "clk_mpll1_gate";
	};

Here is an example about consumers how to configure the gate clock.
clk_mpll0 should use index 2 to get the clock and clk_mpll1 use index 18.
Example:

	clk_mpll0: clk@40400024 {
		compatible = "sprd,sc9850-adjustable-pll-clock";
		#clock-cells = <0>;
		reg = <0 0x40400024 0 0x4>,
			<0 0x40400028 0 0x4>;
		clocks = <&clk_mpll_gates 2>;
		clock-output-names = "clk_mpll0";
	};

	clk_mpll1: clk@4040002c {
		compatible = "sprd,sc9850-adjustable-pll-clock";
		#clock-cells = <0>;
		reg = <0 0x4040002c 0 0x4>,
			<0 0x40400030 0 0x4>;
		clocks = <&clk_mpll_gates 18>;
		clock-output-names = "clk_mpll1";
	};
```

## Documentation/devicetree/bindings/clock/sprd/sprd,muxed-clock.txt
```
Spreadtrum multiplexed clock driver.

Required properties:

- compatible : should be "sprd,muxed-clock"

- sprd,mux-msk : Mux clock has more than one parent clock. It uses a
		 register's some bits to index parent clock. This property
		 is the mask of these bits.

Example:

	clk_adi: clk@402d0028 {
		compatible = "sprd,muxed-clock";
		#clock-cells = <0>;
		reg = <0 0x402d0028 0 0x4>;     /* select reg */
		sprd,mux-msk = <0x3>;
		clocks = <&ext_26m>, <&ext_4m>, <&clk_twpll_38m4_def>,
			 <&clk_twpll_51m2_def>;
		clock-output-names = "clk_adi";
	};
```

## Documentation/devicetree/bindings/clock/sprd/sprd,pike2-ads.txt
```
Device Tree ADS(Avoid Disturb Solution) for pike2 SoC

Required properties:
- compatible : must be "sprd,pike2-ads"
- reg : Shall be the ADS iram base address and plls' spread spectrum base address.
- sprd,ads-off-info : Iram reserved a region for save ads offset info. Depend on
	design spec, this property should include disturbing modules' clocks num
	info, current disturbing modules' clock info and disturbed syss' request
	info.
- sprd,sad-dst-id  : shall be the destination sipc ids
- sprd,pll-index   : shall be the plls' index number
- clocks           : shall be plls' phandle, which corresponding to the pll index

Examples:
avoid_disturb: avoid-disturb@402e01b0 {
	compatible = "sprd,pike2-ads";
	reg = <0x402e01b0 0x14>,
	      <0x5000f800 0x800>;
	sprd,ads-off-info = <0x10 0x20>,
			    <0x20 0x80>,
			    <0x220 0x800>;
	sprd,sad-dst-id = <2 3 4>;
	sprd,pll-index = <1 3 4>;
	clocks = <&clk_dpll>, <&clk_cpll>, <&clk_gpll>;
};
```

## Documentation/devicetree/bindings/crypto/sansa-ce.txt
```
Sansa crypto engine driver

Required properties:

- compatible  : should be "dx,cc63p"
- reg         : specifies base physical address and size of the registers map
- interrupts  : interrupt number
- clock-names : list of device clock input names; should contain one entry
		"enable"
- clocks      : list of clock phandle and specifier pairs for all clocks
		listed in clock-names property
- status      : Should be "okay" or "disabled" for enabled/disabled.

Example:
	crypto@50100000 {
		compatible = "dx,cc63p";
		reg = <0x50100000 0x1000>;
		interrupts = <GIC_SPI 21 IRQ_TYPE_LEVEL_HIGH>;
		clock-names = "enable";
		clocks = <&clk_ap_ahb_gates 11>;
		status = "disabled";
	};
```

## Documentation/devicetree/bindings/devfreq/sprd/sprd_dfs.txt
```
* Spreadtrum DDR DFS device

The Spreadtrum DDR DFS device provides an interface to DFS core(cm4 or ARM&). 
This file documents the properties used by the Spreadtrum DDR DFS devic

Required properties:
- compatible:
 should be "sprd,dfs" for sharkl2/isharkl2/iwhale2/sharklj1/sharkle
 "sprd,dfs_auto" for sharkl3 and later chips.
- freq-num: frequency number can set by kernel.
- sprd-scene: scene name which set by userspace.
- sprd-freq: frequency for every sprd-scene.


Optional properties:
- overflow: the bandwith when frequency up to next level
- underflow: the bandwith when frequency down to previous level

Example:

         scene-frequency {
                 compatible = "sprd,dfs_auto";
                 freq-num = <8>;
                sprd-scene = "boost", "lcdon", "lcdoff", "camlow",
                        "camhigh";
                sprd-freq = <933 311 233 533 933>;
```

## Documentation/devicetree/bindings/devfreq/sprd_governor.txt
```
Spreadtrum ddr dvfs bindings

Required properties:
- compatible:
   must be
  "sprd,ddr-boost-freq"

- sprd,ddr-boost-freq:
  ddr boost frequence, the value depend on platform.
  such as 9820e should be 667, 7731e should be 553

Example:

sprd-ddr-boost {
	compatible = "sprd,ddr-boost-freq";
	sprd,ddr-boost-freq = <667>;
};
```

## Documentation/devicetree/bindings/display/sc2703-panel,backlight.txt
```
Spreadtrum Communications SC2703 Panel, WLED(Backlight) bindings

Required properties for AMOLED mode:
- compatible: should be "sprd,sc2703-bllcd"

Required properties for TFT mode:
- compatible: Same as above
- reg: I2C slave address, 0x4B.
- sprd,wled-mode: Wled operation modes,
	it is able to chosse one of below five modes.
	Whole modes can be turned on by PWM(GPIO) input
	if you don't add the 'sprd,wled-enable-by-i2c' property.
	the 'sprd,wled-enable-by-i2c' means that it is turned on by i2c access.

	1. "bypass-mode" : Controlled by external PWM(duty) directly
			based on fixed wled_idac_code_o, PWM output by input PWM.
			* The external PWM input is controlled by sc2703 wled driver.

	2. "direct-mode" : Controlled by Internal PWM or wled_idac_code_o.
			In this case, user has to fix either of them.
			Also please make sure that WLED_PWM input pin is low!

			i) Required properties in the case brightness is controlled
			   by wled_idac_code_o
				sprd,level-ctrl-by="idac-control"
				sprd,pwm-out-freq-hz = <xxxxx>;
				sprd,pwm-out-duty = <xx>;

			ii) Required properties in the case brightness is controlled
			    by pwm duty
				sprd,level-ctrl-by="pwm-control"
				sprd,pwm-out-freq-hz = <xxxxx>;
				sprd,wled-idac-microamp = <xxxx>

	3. "duty-det-pwm-mode" : Controlled by external PWM(duty) based on fixed
			wled_idac_code_o, output by internal PWM register
			* Required properties(in below Optional peoperties)
				- 'sprd,wled-idac-microamp'
				- 'pwms'
	4. "duty-det-analog-mode" : Controlled by external PWM(duty) based on fixed
			wled_idac_code_o, always high PWM(duty) output
			* Required properties(in below Optional peoperties)
				- 'sprd,wled-idac-microamp'
				- 'pwms'
	5. "duty-det-mixed-mode" : Combination of "duty-det-pwm"/"duty-det-analog"
			fix PWM_IN_DUTY_THRESHOLD(sprd,pwm-in-duty-thresh) below
			* Required properties(in below Optional peoperties)
				- 'sprd,wled-idac-microamp'
				- 'pwms'
	6. "ext-r-sink-mode" : Controlled by external PWM(duty) based on the
			VDAC_FUL_SCALE_EXT_R accordingly
			(sprd,vdac-ful-scale-ext-r) below, external R-Sink mode.
			* Required properties(in below Optional peoperties)
				- 'sprd,wled-idac-microamp'
				- 'pwms'

	For further information,
	please see the data sheet(Wled Operation Modes) further details.

Optional properties:
- sprd,wled-enable-by-i2c: wled enable by i2c access for turning on/off
			instead of GPIO control.
- sprd,lcd-enable-gpio: LCD enable by extern GPIO control instead of
			i2c access control for turning on and off.
- sprd,level-ctrl-by: In case of direct mode. user must select
			either "idac-control or "pwm-control"
			please refer above "direct mode"
- sprd,pwm-out-freq-hz : PWM out frequency for direct-mode, duty-det-pwm
			and duty-det-mixed mode.
			20000 Hz <= Range <= 34000 Hz
- sprd,pwm-out-duty : PWM out duty, range is from 0(0%) to 255(100%) for
			direct-mode, duty-det-pwm and duty-det-mixed mode.
- sprd,wled-idac-microamp : For WLED IDAC current target,
			range 160 ~ 40960 uA.
- sprd,pwm-in-duty-thresh : For duty-det-mixed mode. Range 0 ~ 255.
- sprd,max-brightness:
	To determine the max brightness when use external PWM,
	it means the mode is one of below 5 modes
	(by-pass, duty-det-pwm, duty-det-analog, duty-det-mixed mode,
	ext-r-sink)
	if set to 100, then host use the brightness range: 0 ~ 100.
	this property can be set up to 0xFFFF as maximum.
	So for the direct mode(Not external PWM mode), this will be set to
		20480 for controlling by idac-control
		255 for controlling by pwm-control
- sprd,idac-ramp-disable: WLED IDAC ramp disable
- sprd,vdac-code-microvolt: Full-scale VDAC code for WLED in ext_r_rmode,
			range from 0 to 1600000 uV
- sprd,vdac-sel-microvolt: VDAC target for WLED boost,
			range from 0 to 1600000 uV
- irq

======

Example for one of pwm modes(1,3,4,5 and 6 in sprd,wled-mode above):

	panel: sc2703-display@4b{
		compatible = "sprd,sc2703-bllcd";
		reg = <0x4b>;
		interrupt-parent = <&gpio6>;
		interrupts = <11 IRQ_TYPE_LEVEL_LOW>;
		pwms = <&pwm1 0 40000 0>;
		pwm-names = "sprd-wled";
		sprd,wled-mode = "duty-det-mixed-mode";
		sprd,pwm-out-duty = <255>;
		sprd,wled-idac-microamp = <20480>;
		sprd,pwm-in-duty-thresh = <20>;
		sprd,max-brightness = <2047>;
		lcd-enable-gpio = <&gpio6 14 1>;
	};

	sc2703-disp@4b {
		compatible = "sprd,sc2703-disp";
		reg = <0x4b>;

		lcd_vdd: lcd-regulator {
			compatible = "sprd,sc2703-lcd-regulator";
			regulator-name = "sc2703-lcd";
			regulator-boot-on;
		};

		sc2703-backlight {
			compatible = "sprd,sc2703-backlight";

			pwms = <&pwms 0 30000>;
			pwm-names = "wled-pwm";
			sprd,wled-mode = "duty-det-mixed-mode";
			sprd,level-ctrl-by = "pwm-control";
			sprd,pwm-out-freq-hz = <30000>;
			sprd,pwm-duty = <80>;
			sprd,wled-idac-microamp = <20480>;
			sprd,pwm-in-duty-thresh = <20>;
			sprd,max-brightness = <255>;
			sprd,vdac-code-microvolt = <1500000>;
			sprd,vdac-sel-microvolt = <1000000>;
		};
	};
```
