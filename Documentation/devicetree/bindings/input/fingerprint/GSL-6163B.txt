## Documentation/devicetree/bindings/media/sprd-jpg.txt
```
* Spreadtrum JPEG compress and decompress Processing Engine

Required properties:
- compatible: Should be "sprd,jpg".
- reg: physical base address of the controller and length of memory mapped region.
- interrupts: JPG interrupt specifier.
- sprd,syscon-aon-apb: AON-APB bus node, used to get JPG status
- sprd,syscon-mm-ahb: mm-ahb bus node, used to get JPG status
- clock-names:	List of clock input name strings sorted in the same
		order as the clocks property.  Consumers drivers
		will use clock-names to match clock input names
		with clocks specifiers.
- clocks: The freq of source clk connected to JPG.


Optional properties:
-

Examples:
	jpg: jpeg-codec@0x60b00000{
                compatible = "sprd,jpg";
                reg = <0 0x60b00000 0 0x8000>;
                interrupts = <0 42 0x0>;
		sprd,syscon-aon-apb = <&aon_apb_controller>;
		sprd,syscon-mm-ahb = <&mm_ahb_controller>;
                clock-names = "clk_mm_i","clk_jpg";
                clocks = <&clk_aon_apb_gates0 25>, <&clk_jpg>;
            };
```

## Documentation/devicetree/bindings/media/sprd-mipi-csi.txt
```
Spreadtrum CSI Controller driver binding file
----------------------------------------------------------------

CSI is MIPI host controller and provide communication between camera
 sensor and Camera controller.
Data path: Sensor -> CSI -> Camera Controller
----------------------------------------------------------------

Required Properties:

- compatible: compatible = "snps,csi-controller"
- reg: physical base address and length of registers
		   for the device;
- clock-names: must contain "clk_cphy_gate", "clk_mipi_gate",
		   "clk_csi_eb" and "clk_mm_i"entries, matching entries
		   in the clocks property.
- clocks: list of clock specifiers, corresponding to
		   entries in the clock-names property
- sprd,ip-version: version of the csi controller.

- phys: phy provider specifier for the CSI.


port node:
----------
Required properties:

- endpoint: description of endpoints
- subnode endpoint:
	- remote_endpoint: connects the device node to the remote
				end-point of the node sensor_main_1.
Example:

/* SOC properties */

	 csi: csi-controller@60c00000 {
			compatible = "snps,csi-controller";
			reg = <0x60c00000 0x10000>;
			interrupts = <GIC_SPI 40 IRQ_TYPE_LEVEL_HIGH>,
					<GIC_SPI 41 IRQ_TYPE_LEVEL_HIGH>;
			clock-names = "clk_cphy_gate",
					"clk_mipi_gate",
					"clk_csi_eb",
					"clk_mm_i";
			clocks = <&clk_mm_axi_gate 0>,
				<&clk_mm_axi_gate 1>,
				<&clk_mm_ahb_gate 4>,
				<&clk_aon_apb_gates0 25>;
			sprd,ip-version = <0x3130332A>;
			sprd,mm-ahb-syscon = <&mm_ahb_controller>;
			sprd,aon-apb-syscon = <&aon_apb_controller>;
			status = "disabled";
			phys = <&mipi_csi_phy>;
	};

	mipi_csi_phy: mipi-csi-phy@60d00008 {
			compatible = "snps,mipi-csi-phy";
			...
			#phy-cells = <1>;
	};

/* Board Properties */

&csi2 {
	status = "okay";
	port {
		csi2_out: endpoint {
			remote-endpoint = <&sensor_main_1>;
			};
	};
};

&i2c0 {

	status = "okay";
	sensor_main: sensor-main@3c {
		compatible = "sprd,sensor-main";
		reg = <0x3c>;
		....
		port {
			sensor_main_1: endpoint {
				remote-endpoint = <&csi_out>;
			};
		};
	};
};
```

## Documentation/devicetree/bindings/media/sprd-sensor.txt
```
Spreadtrum Camera Sensor driver binding file
----------------------------------------------------------------
Two Sensors(Main sensor and Sub sensor) are being used in Spreadtrum
SOC.

Main Camera sensor is connected to the CSI controller through MIPI
interface and capture frames/video data from connected sensor
and transfer it to the SPRD camera controller.
Data path: Main Sensor -> CSI -> Camera Controller

Sub sensor is connected to the camera controller through parallel
interface e.g; CCIR.
Data path: Sub Sensor -> Camera Controller
----------------------------------------------------------------

Required properties:

- compatible: should be compatible to connected sensors on
		board e.g. for main sensor it would be
		"sprd,sensor-main", for sub sensor
		"sprd,sensor-sub", for maian2 sensor
		"sprd,sensor-main2", for sub2 sensor
		"sprd,sensor-sub2".
- reg: sensor  i2c slave addresses, used as control
	interface
- clocks: list of clock sources, corresponding to entries
	 in clock-names property
- clock-names: Compatible with the clocks mentioned in clocks
		 node "clk_src" entries
- reset-gpios: sensor reset  gpio id
- vddio-supply: I/O power supply

---------------------------------------------------------------------

Optional properties:

- vddcama-supply: analog power supply
- vddcamd-supply: digital power supply
- vddcammot-supply: auto focus power supply

- power-down-gpios: sensor powerdown gpio id
- flash-gpios: enable flash gpio pin
- mipi-switch-en-gpios: enable mipi switch gpio id
- mipi-switch-mode-gpios: mipi switch mode gpio id
- main-sensor-vdd-gpios: main sensor vdd gpio id
- switch-mode-gpios: switch mode gpio id
- sub-sensor-vdd-gpios: sub sensor vdd gpio id



- port node
	defines end point of the sensor and it has to be connected to
	end point in csi2 node
	- endpoint: description of endpoints
	- subnode endpoint
		- remote_endpoint: connects the device node to the
				    remote end-point of the csi2
				    controller csi2_out.

Example:

/* Board Properties */
&i2c0 {
	status = "okay";

	sensor_sub: sensor-sub@21 {
		compatible = "sprd,sensor-sub";
		reg = <0x21>;
		clock-names = "clk_src";
		clocks  = <&clk_ccir>;
		vddio-supply = <&vddcamio>;
		vddcama-supply = <&vddcama>;
		vddcamd-supply = <&vddcamd>;
		vddcammot-supply = <&vddcammot>;
		reset-gpios = <&ap_gpio 44 0>;
		power-down-gpios = <&ap_gpio 46 0>;
	};

	sensor_main: sensor-main@3c {
		compatible = "sprd,sensor-main";
		reg = <0x3c>;
		clock-names = "clk_src";
		clocks = <&clk_sensor>;
		vddio-supply = <&vddcamio>;
		vddcama-supply = <&vddcama>;
		vddcamd-supply = <&vddcamd>;
		vddcammot-supply = <&vddcammot>;
		reset-gpios = <&ap_gpio 45 0>;
		power-down-gpios = <&ap_gpio 47 0>;
		port {
			sensor_main_1: endpoint {
				remote-endpoint = <&csi_out>;
			};
		};
	};
};

&csi2 {
	status = "okay";
	port {
		csi2_out: endpoint {
			remote-endpoint = <&sensor_main_1>;
			};
	};
};
```

## Documentation/devicetree/bindings/media/sprd-vpp.txt
```
* Spreadtrum Video PostProcessing Engine

Required properties:
- compatible: Should be "sprd,vpp".
- reg: physical base address of the controller and length of memory mapped region.
- interrupts: VPP interrupt specifier.
- sprd,syscon-aon-apb: AON-APB bus node, used to get VPP status
- sprd,syscon-mm-ahb: mm-ahb bus node, used to get VPP status
- clock-names:	List of clock input name strings sorted in the same
		order as the clocks property.  Consumers drivers
		will use clock-names to match clock input names
		with clocks specifiers.
- clocks: The freq of source clk connected to VPP.


Optional properties:
-

Examples:
            vpp: video-processor@61000000{
                compatible = "sprd,vpp";
                reg = <0 0x61000000 0 0x4000>;
                interrupts = <0 43 0x0>;
                sprd,syscon-aon-apb = <&aon_apb_controller>;
		sprd,syscon-mm-ahb = <&mm_ahb_controller>;
                clock-names = "clk_mm_i","clk_vpp";
                clocks = <&clk_aon_apb_gates0 25>, <&clk_vpp>;
            };
```

## Documentation/devicetree/bindings/media/sprd-vsp.txt
```
* Spreadtrum Video Signal Processing Engine

Required properties:
- compatible: shall be one of the follows:
              "sprd,sharkl-vsp", for sharkl series of chips,such as sc9830, sc9832;
              "sprd,sharklt8-vsp", for sharklt8 series of chips,such as sc9838;
- reg: physical base address of the controller and length of memory mapped region.
- interrupts: VSP interrupt specifier.
- sprd,syscon-aon-apb: AON-APB bus node, used to get VSP status
- sprd,syscon-mm-ahb: mm-ahb bus node, used to get VSP status
- clock-names: List of clock input name strings sorted in the same
		order as the clocks property.  Consumers drivers
		will use clock-names to match clock input names
		with clocks specifiers.
- clocks: The freq of source clk connected to VSP.


Optional properties:
-

Examples:
        vsp: video-codec@60900000{
			compatible = "sprd,sharkl-vsp";
			reg = <0x60900000 0xc000>;
			interrupts = <GIC_SPI 43 IRQ_TYPE_LEVEL_HIGH>;
			sprd,syscon-aon-apb = <&aon_apb_controller>;
			sprd,syscon-mm-ahb = <&mm_ahb_controller>;
			clock-names = "clk_mm_i", "clk_vsp", "clk_mm_axi";
			clocks = <&clk_aon_apb_gates0 25>, <&clk_vsp>, <&clk_mm_ahb>;
		};
```

## Documentation/devicetree/bindings/mfd/sprd-glb.txt
```
* Global Configuration Registers of Spreadtrum Soc

The Global Configuration Registers are used to configure Spreadtrum SoC
internal bus behavior

Required properties:
- compatible:	Should be one of the following
		"sprd,sys-ap-ahb", "syscon"
		"sprd,sys-pmu-apb", "syscon"
		"sprd,sys-aon-apb", "syscon"
		"sprd,sys-gpu-ahb", "syscon"
		"sprd,sys-mm-ahb", "syscon"
		"sprd,sys-ap-apb", "syscon"
- reg:	Contains offset/length value of the Global Configuration Registers
	memory region.

Example:

ap_ahb_controller: syscon@20e00000 {
	compatible = "sprd,sys-ap-ahb", "syscon";
	reg = <0 0x20e00000 0 0x40000>;
};
```

## Documentation/devicetree/bindings/misc/epl2182.txt
```
P&L sensor epl2182  devicetree bindings

Required properties for the I2C bindings:
- compatible:		should be set to "elan,epl2182_pls"
- reg:			i2c slave address
- gpios:		interrupt gpio

Example for a I2C device node:
	epl2182_pls@49{
		compatible = "elan,epl2182_pls";
		reg = <0x49>;
		gpios = <&ap_gpio 140 1>;
	};
```

## Documentation/devicetree/bindings/misc/lis3dh.txt
```
eccelerometer lis3dh devicetree bindings

Required properties for the I2C bindings:
- compatible:		should be set to "st,lis3dh_acc"
- reg:			i2c slave address
- gpios:		iterrupt gpio
- polling_interval:	polling time delay ms


Example for a I2C device node:
	lis3dh_acc@18{
		compatible = "st,lis3dh_acc";
		reg = <0x18>;
		gpios = <&ap_gpio 139 1>;
		poll_interval = <10>;
		min_interval = <1>;
		g_range = <0>;
		axis_map_x = <0>;
		axis_map_y = <1>;
		axis_map_z = <2>;
		negate_x = <1>;
		negate_y = <1>;
		negate_z = <0>;
	};
```

## Documentation/devicetree/bindings/misc/marlin2/sprd,integrate_marlin.txt
```
Spreadtrum integrate Marlin and GNSS platform devices.

This node provides properties for controlling
the Spreadtrum integrate WCN device.

Required properties:

- compatible:
	"sprd,integrate_marlin" for BT WIFI.
	"sprd,integrate_gnss" for GNSS.
	"sprd,wcn_internal_chip" for WCN.
- sprd,name: used to generate the name of the directory in the proc
	file system.
- sprd,syscon-ap-apb: If ctrl-type is 0, the REG addr bases on ap-apb.
- sprd,syscon-ap-pmu: If ctrl-type is 1, the REG addr bases on  ap-pmu.
- sprd,syscon-ap-pub-apb: If ctrl-type is 2, the REG addr bases on pub-apb.
- sprd,syscon-anlg_wrap_wcn: If ctrl-type is 3,
                             the REG addr bases on anlg-wrap-wcn.
- sprd,syscon-anlg_phy_g6: If ctrl-type is 3,
                             the REG addr bases on anlg-phy-g6.
- sprd,ctrl-probe-num: from ctrl-reg[0] to ctrl-reg[ctrl-probe-num - 1]
		       need init in the driver probe stage
- sprd,ctrl-reg: register offset for controlling BT-WIFI or GNSS start.
- sprd,ctrl-mask: corresponding control register mask.
- sprd,ctrl-value: the mask bits will be set to which value.
- sprd,ctrl-rw-offset: Spreadtrum chipset some function REGs
	read and write use different ADDR.
- sprd,ctrl-us-delay: Spreadtrum chipset some function REGs setting
	should be wait few time to do next operation.
- sprd,ctrl-type: control register type
                  (ap-apb or ap-pmu or pub-apb or anlg_wrap_wcn).
- sprd,ctrl-shutdown-reg: Another group which used to shut down.
- sprd,ctrl-shutdown-mask: corresponding control register mask.
- sprd,ctrl-shutdown-value: the mask bits will be set to which value.
- sprd,ctrl-shutdown-rw-offset: Spreadtrum chipset some function REGs
- sprd,ctrl-shutdown-us-delay: Spreadtrum chipset some function REGs setting
	should be wait few time to do next operation.
sprd,ctrl-shutdown-type: control register type(ap-apb or ap-pmu or pub-apb).
- reg: address range of BT-WIFI or GNSS runtime region.
- sprd,file-name: The firmware file path.
- sprd,file-name-ext: The firmware file path used by GNSS.
- sprd,file-length: The firmware file size.

Example:
wcn_btwf: cpwcn@88000000 {
	compatible = "sprd,integrate_marlin";
	sprd,name = "wcn_btwf";
	sprd,syscon-ap-apb = <&aon_apb_controller>;
	sprd,syscon-ap-pmu = <&pmu_apb_controller>;
	sprd,syscon-ap-pub-apb = <&pub_apb_controller>;
	sprd,syscon-anlg-wrap-wcn = <&anlg_wrap_wcn_controller>;
	sprd,syscon-anlg-phy-g6 = <&anlg_phy_g6_controller>;
	sprd,ctrl-probe-num = <2>;
	sprd,ctrl-reg = <0x1578 0x30a0 0x2100 0x157c 0x20b0 0x20cc>;
	sprd,ctrl-mask = <0x03000000 0xffff 0x03000000
						0x80 0x600 0x00080000>;
	sprd,ctrl-value = <0x00000000 0x0808 0x03000000
						0x80 0x600 0x00080000>;
	sprd,ctrl-rw-offset = <0x1000 0x0 0x2000 0x1000 0x2000 0x2000>;
	sprd,ctrl-us-delay = <10 10 10 10 10 10>;
	sprd,ctrl-type = <0x0 0x2 0x1 0x0 0x1 0x1>;
	sprd,ctrl-shutdown-reg = <0x257c>;
	sprd,ctrl-shutdown-mask = <0x80>;
	sprd,ctrl-shutdown-value = <0x80>;
	sprd,ctrl-shutdown-rw-offset = <0x2000>;
	sprd,ctrl-shutdown-us-delay = <10>;
	sprd,ctrl-shutdown-type = <0x0>;
	reg = <0x0 0x88000000 0x0 0x180000>;
	sprd,file-name = "/dev/block/platform/soc/soc:ap-ahb/20600000.sdio/by-name/wcnmodem";
	sprd,file-length=<0x180000>;
};

wcn_gnss: cpwcn@88300000 {
	compatible = "sprd,integrate_gnss";
	sprd,name = "wcn_gnss";
	sprd,syscon-ap-apb = <&aon_apb_controller>;
	sprd,syscon-ap-pmu = <&pmu_apb_controller>;
	sprd,syscon-ap-pub-apb = <&pub_apb_controller>;
	sprd,syscon-anlg-wrap-wcn = <&anlg_wrap_wcn_controller>;
	sprd,syscon-anlg-phy-g6 = <&anlg_phy_g6_controller>;
	sprd,ctrl-probe-num = <2>;
	sprd,ctrl-reg = <0x1578 0x30a0 0x2100 0x157c 0x20b0 0x20cc>;
	sprd,ctrl-mask = <0x03300000 0xffff 0x03000000
			  0x40 0x800 0x00080000>;
	sprd,ctrl-value = <0x00300000 0x0808 0x03000000
			   0x40 0x800 0x00080000>;
	sprd,ctrl-rw-offset = <0x1000 0x0 0x2000 0x1000 0x2000 0x2000>;
	sprd,ctrl-us-delay = <10 10 10 10 10 10>;
	sprd,ctrl-type = <0x0 0x2 0x1 0x0 0x1 0x1>;
	sprd,ctrl-shutdown-reg = <0x257c>;
	sprd,ctrl-shutdown-mask = <0x40>;
	sprd,ctrl-shutdown-value = <0x40>;
	sprd,ctrl-shutdown-rw-offset = <0x2000>;
	sprd,ctrl-shutdown-us-delay = <10>;
	sprd,ctrl-shutdown-type = <0x0>;
	reg = <0x0 0x88300000 0x0 0x100000>;
	sprd,file-name = "/dev/block/platform/soc/soc:ap-ahb/20600000.sdio/by-name/gpsgl";
	sprd,file-name-ext = "/dev/block/platform/soc/soc:ap-ahb/20600000.sdio/by-name/gpsbd";
	sprd,file-length=<0x100000>;
}`;

wcn_bt {
	compatible = "sprd,bt-sharkle";
	sprd,name = "ttyBT";
	sprd,dst = <3>;
	sprd,channel = <4>;
	sprd,tx_bufid = <11>;
	sprd,rx_bufid = <10>;
};

wcn_fm {
	compatible = "sprd,fm-sharkle";
	sprd,name = "fm";
	sprd,dst = <3>;
	sprd,tx_channel = <4>;
	sprd,rx_channel = <4>;
	sprd,tx_bufid = <14>;
	sprd,rx_bufid = <13>;
};

gnss_common_ctl {
	compatible = "sprd,gnss_common_ctl";
	sprd,name = "gnss_common_ctl";
};

stty4gnss {
	compatible = "sprd,stty4gnss";
	sprd,name = "sttygnss";
	sprd,dst = <4>;
	sprd,channel = <4>;
	sprd,bufid = <0>;
};
```

## Documentation/devicetree/bindings/misc/marlin2/sprd,marlin2_tty.txt
```
Spreadtrum Marlin2 Bluetooth SDIO devices

This node provides properties for controlling the Spreadtrum Bluetooth SDIO device.

Required properties:

 - compatible : Should be "sprd,mtty".

Example:
sprd-mtty {
	compatible = "sprd,mtty";
	sprd,name = "ttyM";
};
```
