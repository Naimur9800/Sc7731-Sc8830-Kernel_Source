## Documentation/devicetree/bindings/input/fingerprint/GSL-6163B.txt
```
*Silead fingerprint controller

Required properties:
- compatible: must be "silead,GSL-6163B"
- reg: SPI address of the chip
- spi-max-frequency: The maximum frequency this chip is able to handle
- gpios: GPIO specification for RESET and INT pins

Optional properties:
- label: Descriptive name of the key.

Example:
spi0: spi@71400000{
	/* ... */
	fingerprint@0 {
		compatible = "silead,GSL-6163B";
		reg = <0x26>;
                spi-max-frequency = <10000000>;
                label = "fingerprint keys";
		gpios = <&ap_gpio 145 0
			&ap_gpio 144 0>;
	};
	/* ... */
};
```

## Documentation/devicetree/bindings/input/sc2705-haptic.txt
```
Spreadtrum Communications SC2705 Haptics bindings

Required properties:
- compatible: "sprd,sc2705-haptics"
- reg:  I2C slave address
- interrupts: haptic events report.
- pwms : phandle to the physical PWM(Pulse Width Modulation) device.
	PWM properties should be named "pwms". And number of cell is different
	for each pwm device.
	To get more information, please refer to documentation.
	[*] refer Documentation/devicetree/bindings/pwm/pwm.txt
- sprd,vib-mode:
	"LRA_MODE" - Linear Resonance Actuator mode
	"ERM_BAR" - Bar type Eccentric Rotating Mass mode
	"ERM_COIN" - Coin type Eccentric Rotating Mass mode
- sprd,play-mode: choose one in below five modes
	"DRO-MODE" - Direct register override mode
	"PWM-MODE" - PWM based playback mode
	"WAVEFORM-Reg-trig" - Waveform + register triggered mode
	"WAVEFORM-Rising-trig" - Waveform + rising edge triggered mode
	"WAVEFORM-dual-trig" - Waveform + dual edge triggered mode

	In case of WAVEFORM mode, user can choose one of below options.
	1. Fix PS_SEQ_LOOP (0~15), send value(PS_SEQ_ID) to driver.
		please use below optional property 'sprd,seq-loop'
	2. Send value to driver. the value consist of
		PS_SEQ_LOOP(4Bits[7:4]) & PS_SEQ_ID(4Bits[3:0])
		For example, if PS_SEQ_LOOP = 8, PS_SEQ_ID = 8,
			then it must be 0x88.

	In case of WAVEFORM-rising-trig and dual-trig mode,
	User have to enable haptic first then, must handle PWM or GPIO input.
	- rising edge edge mode:
		whenever external input is up to high, it will start to play
		but if it goes low->high during playback is on going,
		it will stop.
	- dual edge edge mode:
		external input is up to high, it will start to play
		external input is down to low, it will stop

- sprd,nom-volt-rating: nominal drive voltage rating, default 2500mV
- sprd,abs-max-volt: Absolute max voltage rating , default 2800mV
- sprd,current-rate: Actuator current rating, default 250mA
- sprd,impedance-ohms: Actuator impedance, please apply below formula(average)
	 in case of coin type ERM, otherwise just apply its own ohms.
	A Coin ERM(datasheet) may show Impedance = 33/66 Ohms then,
	impedance-ohms = 44 = 2/3*(Low val = 33) + 1/3*(High val = 66)
- sprd,filter-res-trim: Actuator impedance related threshold(MIN/MAX, 0~3)
	How to calculate:
	B1 = sprd,impedance-ohms(above, user input)
	B2 = Actuator_inductance_Henry(user input)
	* B3, filter-res-trim: MIN = 0, MAX = 3
	B3 = 3+ROUNDDOWN(LOG10(12.2/B1)/LOG10(1.5))
	B4 = B2/(B1*(60E-12*(1.5^(B3-3))-6E-12)*350E3)
	sprd,filter-res-trim = 3+ROUNDDOWN(LOG10(B4)/LOG10(2.15)-0.5)
	For example,
	sprd,filter-res-trim = 3, for (B1 = 3(Ohms), B2 = 0.0001(H))

For further information, see device datasheet or contact to responsible contact point.

Optional properties:
- sprd,resonant-freq: use in case of LRA_MODE, default 205Hz.
		the freq range: 50Hz ~ 300Hz.
		It will be set to 205Hz if the value is out of range.
- sprd,seq-loop: use if want to fix seq-loop(0~15).
- sprd,mem-array: use in case that memory registers should be updated,
		Please fill the whole buffer(90 values) to avoid any error in driver.
		If pattern size is 80, then fill the rest(10) of array to '0' as below.
		For example,
		sprd,mem-array = <
			0 1 2 3 4 5 6 7 8 9
			10 11 12 13 14 15 16 17 18 19
			20 21 22 23 24 25 26 27 28 29
			30 31 32 33 34 35 36 37 38 39
			40 41 42 43 44 45 46 47 48 49
			50 51 52 53 54 55 56 57 58 59
			60 61 62 63 64 65 66 67 68 69
			70 71 72 73 74 75 76 77 78 79
			0 0 0 0 0 0 0 0 0 0
		>;

For further information, see device datasheet or contact to responsible contact point.

======

Example:

	haptics: sc2705-haptics@4A {
		compatible = "sprd,sc2705-haptic";
		reg = <0x4A>;
		interrupt-parent = <&gpio6>;
		interrupts = <11 IRQ_TYPE_LEVEL_LOW>;
		pwms = <&pwm 0 40000 0>;
		sprd,vib-mode = "ERM_COIN";
		sprd,play-mode = "DRO-MODE";
		sprd,nom-volt-rating = <2500>;
		sprd,abs-max-volt = <2800>;
		sprd,current-rate = <130>;
		sprd,resonant-freq = <200>;
		sprd,impedance-ohms = <20>;
		sprd,filter-res-trim = <3>;
	};
```

## Documentation/devicetree/bindings/input/touchscreen/focaltech_ts.txt
```
* Focaltech ft5x0x touchscreen controller

Required properties:
- compatible: must be "focaltech,ft5x0x"
- reg: I2C address of the chip
- interrupt-parent: a phandle pointing to the interrupt controller
                     serving the interrupt for this chip
- interrupts:       interrupt specification for the touchdetect
                     interrupt
- reset-gpios: GPIO specification for the RESET input
- touchscreen-size-x: horizontal resolution of touchscreen (in pixels)
- touchscreen-size-y: vertical resolution of touchscreen (in pixels)
- virtualkeys: the coordinate of the touchscreen's keys.
		<X Y W H>, X: the x coordinate of the center of key region
			   Y: the y coordinate of the center of key region
			   W: the width of key region
			   H: the height of key region

Optional properties:
- avdd-supply: Phandle to a regulator supply


Example:
i2c3: i2c@70800000 {
	/* ... */
	touchscreen-ft@38{
		compatible = "focaltech,ft5x0x";
		reg = <0x38>;
		interrupt-parent = <&ap_gpio>;
		interrupts = <144 IRQ_TYPE_EDGE_FALLING>;
		reset-gpios = <&ap_gpio 145 0>;
		avdd-supply = <&vdd28>;
		virtualkeys = <580 1350 60 45>,
				<360 1350 60 45>,
				<160 1350 60 45>;
		touchscreen-size-x = <720>;
		touchscreen-size-y = <1280>;
	};
	/* ... */
};
```

## Documentation/devicetree/bindings/input/touchscreen/msg2138_ts.txt
```
* MStar msg2138 touchscreen controller

Required properties:
- compatible: must be "Mstar,msg2138_ts"
- reg: I2C address of the chip
- gpios: GPIO specification for RESET and INT pins
- touchscreen-size-x: horizontal resolution of touchscreen (in pixels)
- touchscreen-size-y: vertical resolution of touchscreen (in pixels)
- virtualkeys: the coordinate of the touchscreen's keys.
		<X Y W H>, X: the x coordinate of the center of key region
			   Y: the y coordinate of the center of key region
			   W: the width of key region
			   H: the height of key region

Optional properties:
- avdd-supply: Phandle to a regulator supply


Example:
i2c3: i2c@70800000 {
	/* ... */
	msg2138_ts@26{
		compatible = "Mstar,msg2138_ts";
		reg = <0x26>;
		gpios = <&ap_gpio 145 0
			&ap_gpio 144 0>;
		avdd-supply = "vdd28";
		virtualkeys = <256 1068 64 64
			128 1068 64 64
			192 1068 64 64>;
		touchscreen-size-x = <480>;
		touchscreen-size-y = <800>;
	};
	/* ... */
};
```

## Documentation/devicetree/bindings/interrupt-controller/sprd,intc-ap.txt
```
Spreadtrum AP SoC interrupt controllers

Each Spreadtrum AP SoC contains 5 custom interrupt controllers which are used
to extend the ARM gic. When system is in the low power state, we can select and
enable the corresponding interrupt source by configuring these custom interrupt
controllers to wake up the system.

Required properties:
- compatible: shall be one of follows:
	-"sprd,sc7731-extn-intc" for soc sc7731
	-"sprd,sc9836-extn-intc" for soc sc9836
	-"sprd,sc9838-extn-intc" for soc sc9838
- reg: Physical base address(es) of interrupt registers length of memory mapped
  region.
  index 0 : the base address of sprd intc0
  index 1 : the base address of sprd intc1
  index 2 : the base address of sprd intc2
  index 3 : the base address of sprd intc3
  index 4 : the base address of sprd aon intc
- interrupt-controller: Identifies the node as an interrupt controller.

Example:
	ap_gic_extn: interrupt-controller@71400000 {
		compatible = "sprd,sc9838-extn-intc";
		interrupt-controller;
		reg =   <0 0x71400000 0 0x1000>,
			<0 0x71500000 0 0x1000>,
			<0 0x71600000 0 0x1000>,
			<0 0x71700000 0 0x1000>,
			<0 0x40200000 0 0x1000>;
	}
```

## Documentation/devicetree/bindings/interrupt-controller/sprd,pmuwakeup-chip.txt
```
Spreadtrum pmu wakeup interrupt controllers

we treat the pmu wakeup enable function as a intc, in the init
stage, we enable the required wakeup source.

Required properties:
- compatible: shall be follows:
	-"sprd,whale2-pmuwakeup-chip" for whale2 soc(sc9850/sp9860)
	-"sprd,iwhale2-pmuwakeup-chip" for iwhale2 soc
	-"sprd,sc7731-extn-intc" for sc7731
	-"sprd,sc9836-extn-intc" for sc9836
	-"sprd,sc9838-extn-intc" for sc9838
- reg: Physical base address(es) of interrupt registers length of memory mapped
  region.
- interrupt-controller: Identifies the node as an interrupt controller.

Example:
whale2_pmuwakeup: interrupt-controller@402b0220 {
			  compatible = "sprd,whale2-pmuwakeup-chip";
			  interrupt-controller;
			  reg = <0 0x402b0220 0 0x18>;
		  };
```

## Documentation/devicetree/bindings/ion/sprd,ion.txt
```
Device-Tree bindings for SPREADTRUM ION

SPRD ION
=========

The SPRD ION device tree node contains up to four heap nodes
describing each of the ION heaps.

Required properties:
 - compatible: Should be "sprd,ion"
 - #address-cells: should be <1>
 - #size-cells: should be <0>

ION heap
=========
Required properties:
 - reg: Should be <0> to <31>
         This describes ION heap id.
 - label: heap name
 - type: Should be <0> to <5>
          This is matched with enum ion_heap_type in ion.h.

Optional properties:
 - memory-region: ION heap's memory region.
   Usually, this is used when ION heap need reserved memory.

Examples:
	reserved-memory {
		#address-cells = <1>;
		#size-cells = <1>;

		mm_reserved: multimediabuffer@9872d000{
			reg = <0x9872d000 0x7100000>;
		};

		overlay_reserved: overlaybuffer@9f82d000{
			reg = <0x9f82d000 0x322000>;
		};

		fb_reserved: framebuffer@9fb4f000{
			reg = <0x9fb4f000 0x4b1000>;
		};
	};

	ion {
		compatible = "sprd,ion";
		#address-cells = <1>;
		#size-cells = <0>;

		heap@0 {
			reg = <0>;
			label = "system";
			type = <0>;
		};

		heap@1 {
			reg = <1>;
			label = "carveout_mm";
			type = <2>;
			memory-region = <&mm_reserved>;
		};

		heap@2 {
			reg = <2>;
			label = "carveout_overlay";
			type = <2>;
			memory-region = <&overlay_reserved>;
		};

		heap@3 {
			reg = <3>;
			label = "carveout_fb";
			type = <2>;
			memory-region = <&fb_reserved>;
		};
	};
```

## Documentation/devicetree/bindings/leds/leds-sprd-bltc-rgb.txt
```
Spreadtrum leds driver bindings
Each LED is represented as a sub-node of the leds device.
Each node's name represents the name of the corresponding LED.

Required properties:
- compatible: must be one of
	"sprd,sc2723t-bltc-rgb"
	"sprd,sc2731-bltc-rgb"
	"sprd,sc2721-bltc-rgb"
	"sprd,sc2720-bltc-rgb"

- reg: the chip addr offset

Example:

pmic_bltc_rgb: bltc-rgb@180 {
	compatible = "sprd,sc2720-bltc-rgb";
	reg = <0x180>;
	status = "disabled";
};
```

## Documentation/devicetree/bindings/leds/sprd,leds-gpio.txt
```
Spreadtrum gpio control leds driver bindings

Required properties:
- compatible: "sprd,gpio-rgb"
- gpios: describes the gpio that is used for enabling/disabling the led.

Example:

	gpio-rgb {
		compatible = "sprd,gpio-rgb";
		gpios = <&ap_gpio 97 0
			&ap_gpio 96 0
			&ap_gpio 87 0>;
		status = "okay";
	};
```

## Documentation/devicetree/bindings/leds/sprd,leds.txt
```
Spreadtrum leds driver bindings

Required properties:
- compatible: must be one of
  sprd,sc2731-bltc-rgb"
  sprd,sc2731-kpled"

- reg: the chipselect index
- sprd,prechg-led-gpios: only for bltc-rgb.
  When battery over discharge,
  signal light will flash in charging.

Example:

bltc-rgb@200  {
	compatible = "sprd,sc2731-bltc-rgb";
	reg = <0x200>;
	sprd,prechg-led-gpios = <&ap_gpio 33 0>;
};

kpled@2c4 {
	compatible = "sprd,sc2731-kpled";
	reg = <0x2c4>;
};
```

## Documentation/devicetree/bindings/media/radio/marlin2_fm/sprd,marlin2_fm.txt
```
Spreadtrum FM Radio Device

This node provides properties for controlling the Spreadtrum FMRadio SDIO device.

Required properties:

- compatible: should be "sprd,marlin2-fm"

Example:
sprd-fm: sprd-fm@400b0000{
	compatible  = "sprd,marlin2-fm";
	reg = <0x400b0000 0x0000>;
};
```

## Documentation/devicetree/bindings/media/sprd-gsp.txt
```
* Spreadtrum Graphic Signal Processor

Required properties:
- compatible: shall be one of the follows:
              "sprd,gsp-core", for gsp with only one core,such as sc9830, sc9832;
              "sprd,gsp-core0", for a core of gsp is the first one,such as spwhale;
              "sprd,gsp-core1", for a core of gsp is the second one,such as spwhale;
- reg: physical base address of the controller and length of memory mapped region.
- core-id: the core number.
- kcfg-num: indicate how many kcfgs this core possess.
- real-time: figure out whether core kthread priority is real-time.
- map-64-bit: indicate whether gsp core must need iommu because of 64-bit environment 
- interrupts: gsp interrupt specifier.
- sprd,syscon-ap-ahb: ap-ahb bus node, used to get gsp status
- sprd,syscon-aon-apb: AON-APB bus node, used to get gsp status
- clock-names: List of clock input name strings sorted in the same
		order as the clocks property.  Consumers drivers
		will use clock-names to match clock input names
		with clocks specifiers.
- clocks: The freq of source clk connected to gsp.


Optional properties:
-

Examples:
			gsp_core0: gsp@20a00000 {
				compatible = "sprd,gsp-core";
				reg = <0x20a00000 0x1000>;
				core-id = <0>;
				kcfg-num = <8>;
				real-time;
				map-to-64bit;
				interrupts = <GIC_SPI 51 IRQ_TYPE_LEVEL_HIGH>;
				iommus = <&iommu_gsp>;
				sprd,sys-ap-ahb = <&ap_ahb_controller>;
				sprd,sys-aon-apb = <&aon_apb_controller>;
				clock-names = "clk_gsp",
						   "clk_gsp_parent",
						   "clk_emc_gsp",
						   "clk_gsp_eb";
				clocks = <&clk_gsp>,
						<&clk_twpll_256m>,
						<&clk_aon_apb_gate1 13>,
						<&clk_ap_ahb_gates 3>;
			};
```

## Documentation/devicetree/bindings/media/sprd-isp.txt
```
* Spreadtrum ISP

Required properties:
- compatible: Should be "sprd,isp-r1p0".
- reg: physical base address of the controller and length of memory mapped region.
- interrupts: isp interrupt specifier.
- clocks: The freq of source clk connected to isp.
- clock-names: List of clock input name strings sorted in the same
  order as the clocks property.  Consumers drivers will use clock-names to
  match clock input names with clocks specifiers.
- sprd,sys-mm-ahb: mm-ahb bus node, used to get isp status

Optional properties:
-

Examples:
         isp: isp@60a00000 {
             compatible  = "sprd,isp-r1p0";
             reg = <0x60a00000 0x100000>;
             interrupts = <GIC_SPI 44 IRQ_TYPE_LEVEL_HIGH>;
             clocks = <&clk_aon_apb_gates0 25>,<&clk_isp>,<&clk_twpll_307m2>,
                 <&clk_mm_axi_gate 4>, <&clk_mm_ahb_gate 2>;
             clock-names = "clk_mm_i","clk_isp","clk_isp_parent",
                 "isp_axi_eb","isp_eb";
             sprd,sys-mm-ahb = <&mm_ahb_controller>;
         };
```
