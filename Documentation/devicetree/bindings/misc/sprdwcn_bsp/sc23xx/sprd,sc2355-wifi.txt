## Documentation/devicetree/bindings/misc/sprdwcn_bsp/sc23xx/sprd,sc2355-wifi.txt
```
Spreadtrum Marlin3 Fullmac wireless devices

This node provides properties for controlling the Spreadtrum wireless device.

Required properties:

 - compatible : Should be "sprd,sc2355-wifi".

Example:

sprd-wlan {
	compatible = "sprd,sc2355-wifi";
};
```

## Documentation/devicetree/bindings/mmc/mmc-pwrseq-sprd-sdio.txt
```
* The sprd sdio power sequence provider

The purpose of the driver provider is to supports sprd wcn chip

Required properties:
- compatible : contains "mmc-pwrseq-sprd-sdio".

Optional properties:
- rstn-gpios : contains a list of GPIO specifiers. The reset GPIOs are asserted
	at initialization and prior we start the power up procedure of the card.
	They will be de-asserted right after the power has been provided to the
	card.
- chip-en-gpios The chip-en GPIOs are asserted when power up chip.
- clocks : Must contain an entry for the entry in clock-names.
  See ../clocks/clock-bindings.txt for details.
- clock-names : Must include the following entry:
  "ext_clock" (External clock provided to the card).

Example:
	sdio_pwrseq: sdio-pwrseq {
		compatible = "mmc-pwrseq-sprd-sdio";
		rstn-gpios = <&ap_gpio 111 0>;
		chip-en-gpios = <&ap_gpio 112 0>;
		clock-names = "clk_32k","source","enable";
		clocks = <&clk_aux0>,<&ext_32k>,
			 <&clk_aon_apb_gates1 2>;
		post-power-on-delay-ms = <20>;
	};
```

## Documentation/devicetree/bindings/mtd/sprd-nand.txt
```
* Spreadtrum Nand Host Controller

The Spreadtrum Nand Host Controller provides an interface for Nand.
This file documents differences between the coreproperties described by Nand.txt
and the properties used by the Spreadtrum Nand driver.

Required properties:
- compatible:
 should be "sprd,nandc-r5"
 in order to compatible with Nand controller version
- reg: Registers location and length
- interrupts: exactly one interrupt specifier
- clock-frequency: Base freq of nand controller
- clocks: Freq of source clk of nand controller ECC and ahb enable or disable
Example:

nandc: nandc@21a00000 {
	compatible = "sprd,nandc-r5";
	reg = <0x21a00000 0x1000>;
	interrupts = <GIC_SPI 59 IRQ_TYPE_LEVEL_HIGH>;
	clock-frequency = <192000000>;
	clocks = <&clk_nandc_2x>,<&clk_nandc_ecc>,
		 <&clk_rpll_195m>,<&ext_26m>,
		 <&clk_ap_ahb_gates 10>;
	status = "disabled";
};
```

## Documentation/devicetree/bindings/net/wireless/sprd,sc2332.txt
```
Spreadtrum Marlin2 Fullmac wireless SDIO devices

This node provides properties for controlling the Spreadtrum wireless device. The
node is expected to be specified as a child node to the SDIO controller that
connects the device to the system.

Required properties:

 - compatible : Should be "sprd,sc2332".

Example:
&sdio1 {
    sprd,delay = <0x03 0x03 0x03>;
    voltage-ranges = <2900 3200>;
    bus-width = <4>;
    sprd,name = "sdio_wifi";
    status = "okay";

    sprd-wlan {
	compatible = "sprd,sc2332";
    };
};
```

## Documentation/devicetree/bindings/pci/sprd-pcie.txt
```
Spreadtrum PCIe host bridge DT description

Spreadtrum PCIe host controller is based on Designware PCI core.
It shares common functions with PCIe Designware core driver and inherits
common properties defined in
Documentation/devicetree/bindings/pci/designware-pci.txt.

Additional properties are described here:

Required properties:
- compatible: Should contain "sprd,pcie".
- reg: Should contain dbi, config registers location and length.
- reg-names: Must include the following entries:
  "dbi": controller configuration registers;
  "config": PCIe configuration space registers.

Optional properties:
- status: Either "ok" or "disabled".

Example:
	pcie0@20c00000 {
		compatible = "sprd,pcie", "snps,dw-pcie";
		reg = <0x0 0x20c00000 0x0 0x100000>,
		      <0x3 0xffffe000 0x0 0x2000>;
		reg-names = "dbi", "config";
		#address-cells = <3>;
		#size-cells = <2>;
		device_type = "pci";
		ranges = <0x43000000 0x0 0x00000000 0x2 0x80000000 0x1 0x77f00000>;
		#interrupt-cells = <3>;
		interrupts = <GIC_SPI 148 IRQ_TYPE_LEVEL_HIGH>;
		bus-range = <0  15>;
		num-lanes = <1>;
		num-vectors = <256>;
		num-viewport = <8>;
		status = "okay";
	};
```

## Documentation/devicetree/bindings/phy/sprd-phy.txt
```
Spreadtrum MIPI-CSI PHY
-----------------------

Required properties:
 - compatible:	"snps,mipi-csi-phy"
 - reg:	physical base address and length of MIPI CSI PHY registers
 - #phy-cells:	must be 1

For generic PHY binding properties, refer to phy/phy-bindings.txt

 Example:

	mipi_csi_phy: mipi-csi-phy@60d00008 {
			compatible = "snps,mipi-csi-phy";
			reg = <0x60d00008 0x4>;
			#phy-cells = <1>;
	};
```

## Documentation/devicetree/bindings/phy/sprd-typec-phy.txt
```
Spreadtrum Type-C phy
-----------------------
Required properties:
 - compatible: sprd,typec
 - reg: offset and length of the PHY registers
 - mode: 0 ufp, 1 dfp, 2 drp
 - tsleep: in millisecond

For generic PHY binding properties, refer to phy/phy-bindings.txt

Example:

	pmic_typec: typec@100 {
			compatible = "sprd,typec";
			interrupt-parent = <&pmic>;
			interrupts = <13 IRQ_TYPE_LEVEL_HIGH>;
			reg = <0x100>;
			mode = <2>;
			tsleep = <1500>;
                };
```

## Documentation/devicetree/bindings/power/reset/sc2723-poweroff.txt
```
* Device tree bindings for SC2723 power off

SC2723 is used to externally trigger a system power off. Once the trigger has
been sent, which signals the system to power off.

Required properties:
- compatible: should contain "sprd,sc2723-poweroff"
- reg:        Physical offset in PMIC address space

Example:

pmic_poweroff: power@950 {
	compatible = "sprd,sc2723-poweroff";
	reg = <0x950>;
};
```

## Documentation/devicetree/bindings/power/sprd_2723_charge.txt
```
Binding for sprd 2723 charger

Required properties:
compatible          must be "sprd,sc2723-charger"
reg                 charge ctl offset base on adi
chg-cv-gpios        gpio of eic,trigger when vbat is higher then cccv
chg-ovi-gpios       gpio of eic,trigger when charge voltage is higher
                    then the set value

Examples:
  pmic_charge: charge@904{
	compatible = "sprd,sc2723-charger";
	reg = <0x904>;
	chg-cv-gpios = <&pmic_eic 4 0>;
	chg-ovi-gpios = <&pmic_eic 6 0>;
};
```

## Documentation/devicetree/bindings/power/sprd_2723_fgu.txt
```
Binding for sprd 2723 fgu

Required properties:
compatible          must be "sprd,sc2723-fgu"
reg                 fgu ctl offset base on adi
interrupt-parent    must be <&pmic_intc>
interrupts          pmic_intc interrupts number 4
ocv-type            0 for soft_ocv,1 for pocv to get battery init level

Examples:
pmic_fgu: fgu@500{
	compatible = "sprd,sc2723-fgu";
	reg = <0x500>;
	interrupt-parent = <&pmic_intc>;
	interrupts = <4>;
	ocv-type = <0>;
};
```

## Documentation/devicetree/bindings/power/sprd_battery.txt
```
Binding for SPRD BATTERY

Required properties:
compatible                     should be "sprd,sprd-battery"
charger-det-gpios              charger plugin eic gpio
battery-det-gpios              vbat detect eic gpio
io-channels                    adc channel id
io-channel-names               adc channel name
chg-end-vol                    charge end voltage (mv)
chg-end-vol-check              voltage to check if charge full (mv)
chg-bat-safety-vol             safety voltage for battery when charging (mv)
adp-cdp-cur                    charge current for cdp (ma)
adp-dcp-cur                    charge current for dcp (ma)
adp-sdp-cur                    charge current for sdp (ma)
ovp-stop                       over voltage protect : stop charge voltage (mv)
ovp-restart                    over voltage protect : restart charge voltage (mv)
chg-timeout                    charge timeout (s)
chg-rechg-timeout              recharge timeout (s)
chg-end-cur                    charge terminal current (ma)
chg-polling-time               charge status check period (s)
cap-one-per-time               the min time one percent capcity changed (s)
chg-full-condition             charge full decided by 0:vol and cur;
                               1:status and cur;2:ext ic
fgu-mode                       fgu work in 1:voltage mode; 0:mixed mode
only-vol-mode                  get battery cap mode 0: fgu and voltage mixed mode 1:only voltage mode
alm-soc                        alarm level
alm-vol                        alarm voltage (mv)
soft-vbat-uvlo                 vbat voltage is lower then soft-vbat-uvlo,shut down (mv)
rint                           battery internal resistor (mohn)
cnom                           battery capacity
rsense-real                    real sensing resistor (mohn)
rsense-spec                    sensing resistor in spec (mohn)
relax-current                  when bat current lower then this ,we can get a ocv value (ma)
fgu-cal-ajust                  fgu calibration offset
ocv-tab-vol                    ocv table (mv)
ocv-tab-cap                    battery level table corresponding to the ocv table
charge-vol-tab                 only val mode charge ocv table(mv)
charge-vol-tab-cap	           battery level table corresponding to the charge ocv table
discharge-vol-tab	           only val mode discharge ocv table(mv)
discharge-vol-tab-cap	       battery level table corresponding to the discharge ocv table


Optional properties:

temp-support                   1:support get battery temperature; 0:not support
temp-comp-res                  compensation resistor for read temperature
temp-tab-val                   the voltage of ntc resistor table (mv)
temp-tab-temp                  temperature table corresponding to temp-tab-val
                               (temperature + 1000,750 = 1000 + (-250))

jeita-temp-tab                 temperature table to change charge cur and cccv
jeita-temp-recovery-tab        temperature recovery table to recovery charge cur and cccv
jeita-cur-tab                  charge current table (ma)
jeita-cccv-tab                 charge cccv piont table (mv)

cnom-temp-tab                  cnom - temperature table
rint-temp-tab                  rint - temperature table
Examples:

battery {
	compatible = "sprd,sprd-battery";
	charger-det-gpios = <&pmic_eic 0 0>;
	battery-det-gpios = <&pmic_eic 9 0>;
	io-channels = <&pmic_adc 1>,<&pmic_adc 10>,
			<&pmic_adc 12>,<&pmic_adc 16>;
	io-channel-names = "adc_temp","adc_vbat",
			"adc_vchg","adc_isense";
	chg-end-vol = <4200>;
	chg-end-vol-check = <4190>;
	chg-bat-safety-vol = <4280>;
	rechg-vol = <4131>;
	adp-cdp-cur = <700>;
	adp-dcp-cur = <700>;
	adp-sdp-cur = <450>;
	ovp-stop = <6500>;
	ovp-restart = <5800>;
	chg-timeout = <21600>;
	chg-rechg-timeout = <5400>;
	chg-end-cur = <80>;
	chg-polling-time = <30>;
	chg-polling-time-fast = <1>;
	cap-one-per-time = <30>;
	chg-full-condition = <0>;
	temp-support = <0>;
	temp-comp-res = <30>;
	temp-tab-val = <1084 1072 1055 1033 1008 977
			938 897 850 798 742 686
			628 571 513 459 410 362 318>;
	temp-tab-temp = <750 800 850 900 950 1000
			1050 1100 1150 1200 1250 1300
			1350 1400 1450 1500 1550 1600 1650>;
	jeita-temp-tab = <900 1000 1100 1450 1500 3000>;
	jeita-temp-recovery-tab = <870 970 1070 1420 1470 3000>;
	jeita-cur-tab = <0 100 500 1000 700 0>;
	jeita-cccv-tab = <4200 4200 4350 4350 4350 4350>;
	fgu-mode = <0>;
	alm-soc = <5>;
	alm-vol = <3600>;
	soft-vbat-uvlo = <3100>;
	rint = <250>;
	cnom = <1900>;
	rsense-real = <215>;
	rsense-spec = <200>;
	relax-current = <50>;
	fgu-cal-ajust = <0>;
	ocv-tab-vol = <4185 4113 4066 4022 3983 3949 3917
			3889 3864 3835 3805 3787 3777 3773
			3770 3765 3752 3724 3680 3605 3400>;
	ocv-tab-cap = <100 95 90 85 80 75 70 65 60 55
			50 45 40 35 30 25 20 15 10 5 0>;
	charge-vol-tab = <4180 4130 4100 4060 4030 4000 3959
			3930 3904 3880 3860 3840 3830 3810
			3790 3780 3730 3690 3565 3510 3400>;
	charge-vol-tab-cap = <100 95 90	85 80 75 70
			65 60 55 50 45 40 35 30 25 20 15 10 5 0>;
	discharge-vol-tab = <4150 4100 4050 4020 4000 3970 3940
			3910 3880 3850 3820 3790 3770 3755
			3750 3715 3680 3650 3600 3510 3400>;
	discharge-vol-tab-cap = <100 95 90 85 80 75 70
			65 60 55 50 45 40 35 30 25 20 15 10 5 0>;
	cnom-temp-tab = <1020 1800
			1010 1300
			1000 1070
			990  1000>;
	rint-temp-tab = <1020 200
			1010 450
			1000 650
			990  1100>;
};
```

## Documentation/devicetree/bindings/pwm/pwm-sprd-pmic.txt
```
Spreadtrum PMIC based PWM Subsystem
===================================

Spreadtrum PMIC contain PWM controller which can be used provide PWM signal
to LED flash.
--------------------------------------------------------------------------

Required porperties:

- compatible: should be one of:
		"sprd,sc2723-pwm"
		"sprd,flash-ocp8137"
- #pwm-cells: Should be 2. See pwm.txt in this directory for a description of
the cells format.

- reg: Offset to pwm control registers from pmic base
--------------------------------------------------------------------------

Optional properties:
- None
-------------------

PWM user nodes
-----------------

Required porperties:

- compatible: should be compatible to LED flash e.g. "sprd,pwm-led-flash".

- reg: Contains the addresses of registers RGB_CTRL and WHTLED_CTRL
		respectively.

- pwms: PWM properties: phandle to pwm node, the chip-relative PWM number
		and the PWM period in nanoseconds.

- flash-levels: Brightness level of led-flash.
		value can be from 0 to 255.
----------------------------------------------------------------------

Optional properties:
- pwm-names: contain a list of strings corresponding to pwm devices
		in pwms property.

------------------------------------------------------------------

Example:

	pmic_pwm: pwm@20 {
		compatible = "sprd,sc2723-pwm";
		#pwm-cells = <2>;
		reg = <0x20>;
	};

	pmic_led_flash: pmic-led-flash@8ec {
		compatible = "sprd,pwm-led-flash";
		reg = <0x8ec>, <0x8f0>;
		pwms = <&pmic_pwm 0 5000000>;
		pwm-names = "sprd-led-flash";
		flash-levels = <255>;
	};
```

## Documentation/devicetree/bindings/pwm/sprd,pwm.txt
```
*Spreadtrum SoCs based PWM Subsystem
=============================================

Spreadtrum SoCs contain PWM controller which can be used for system clock
event timers,as well as to drvier SoC output wiht PWM signal.Each controller
provides 4 PWM channels.

Required porperties:
- compatible : "sprd,pwm"

- reg: base address and size of register area

- clock-names: should contain all following required clock names:
        - "sprd_pwm_clk_parent" - parent clock for pwm clock,
        - "clk_pwm" - pwm base clock used to generate PWM signals.

- clocks: phandle of the clock used by the PWM module.

See pwm.txt in this directory for a description of the cells format.
More information refer to <Documention/devicetree/bindings/pwm.txt>.

Optional properties:
- None

Example:
        pwms: pwm@40260000{
                compatible = "sprd,pwm";
                reg = <0x40260000 0x10000>;
                clock-names = "sprd_pwm_clk_parent", "clk_pwm";
                clocks = <&ext_26m>, <&clk_pwm2>;
                #pwm-cells = <2>;
        }
```

## Documentation/devicetree/bindings/regulator/cpufreqhw.txt
```
Binding for cpufreqhw regulators
virtual i2c device for sprd cpu hw dvfs.

Required properties:
  - compatible: one of "sprd,cpufreqhw-regulator-sharkl3"
  - reg: I2C address

Optional properties:

Example:

       /*virtual i2c device for cpu hw dvfs*/
       cpufreqhw@61 {
               compatible = "sprd,cpufreqhw-regulator-sharkl3";
               reg = <0x61>;
       };
```
