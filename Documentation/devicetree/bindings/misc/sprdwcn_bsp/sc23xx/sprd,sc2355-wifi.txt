## Documentation/devicetree/bindings/regulator/ncp6335d.txt
```
Binding for ncp6335d regulators

Required properties:
  - compatible: "onnn,ncp6335d-regulator"
  - reg: I2C address
  - onnn,vsel: set Default OUT voltage and dcdc mode
  - onnn,slew-rate-ns: output voltage will decrease in equidistant steps per defined time period
  - onnn,discharge-enable: this feature can be easily disabled or enabled with DISCHG bit in PGOOD register
  - onnn,step-size: raised or decrease steps of voltage
  - onnn,min-slew-ns: smallest time period may set
  - onnn,max-slew-ns: largest time period may set
  - regulator-min-microvolt: smallest output voltage may set
  - regulator-max-microvolt: largest output voltage may set
  - regulator-always-on: boolean, regulator should never be disabled
  - onnn,min-setpoint: base output voltage

Example:

	ext_pmic: ncp6335d-regulator@1c {
		compatible = "onnn,ncp6335d-regulator";
		reg = <0x1c>;
		onnn,vsel = <0>;
		onnn,slew-rate-ns = <2666>;
		onnn,discharge-enable;
		onnn,step-size = <6250>;
		onnn,min-slew-ns = <333>;
		onnn,max-slew-ns = <2666>;
		regulator-min-microvolt = <850000>;
		regulator-max-microvolt = <1350000>;
		regulator-always-on;
		onnn,min-setpoint = <600000>;
	};
```

## Documentation/devicetree/bindings/regulator/sprd-regulator.txt
```
Spreadtrum regulators
Required Properties:
- compatible: Should be one of:
  - "sprd,sc2723-regulator" for olders SoCs like sc9838,sc9830
  - "sprd,sc2731-regulator" for newer SoCs like sc9001, sc9850
  - "sprd,sc2721-regulator" for newer SoCs like sc9833

Optional nodes:
-regulators:Must contain a sub-node per regulator from the list below.

	    Each sub-node should contain the constraints and initialization information for that
	    regulator.See regulator.txt for a description of standard properties for these sub-nodes.
	    Additional custom properties are listed below.

Optional sub-node properties:
	    sprd,hide-offset - chip hide offset voltage
	    sprd,default-on - chip auto power-on
	    sprd,default-microvolt - the voltage ldo/dcdc reset value
            sprd,step-microvolt - the minimum adjustment voltage


Example:
power-controller@810 {
		compatible = "sprd,sc2723-regulator";
                reg = <0x810>,
                      <0x8c0>,
                      <0x8f4>,
                      <0xa00>,
                      <0xa1c>,
                      <0x8f4>;

	regulators {
	        #address-cells = <1>;
	        #size-cells = <0>;

		vddarm: dcdc@1 {
                        reg = <1>;
			regulator-name = "vddarm";
			regulator-min-microvolt = <600000>;
			regulator-max-microvolt = <3125000>;
			sprd,step-microvolt = <3125>;
			sprd,default-microvolt = <900000>;
			sprd,hide-offset = <1000>; /* kernel hide_offset =  hide-offset - 1000 */
			sprd,default-on;
		};

		vddusb: ldo@25 {
                        reg = <25>;
			regulator-name = "vddusb";
			regulator-min-microvolt = <1200000>;
			regulator-max-microvolt = <3760000>;
			sprd,step-microvolt = <10000>;
			sprd,default-microvolt = <3300000>;
			sprd,hide-offset = <1000>; /* kernel hide_offset =  hide-offset - 1000 */
		};

	}
}
```

## Documentation/devicetree/bindings/rtc/sprd-rtc.txt
```
* SPREADTRUM Real Time Clock controller bindings

This binding supports the following chip: sc2723t

Required properties:
- compatible: should be: "sprd,sc2723t-rtc",
- reg: physical base address offset of the controller
- interrupt-parent: rtc alarm parent's interrupt
- interrupts: rtc alarm interrupt

Example:

rtc@80 {
	compatible = "sprd,sc2723t-rtc";
	interrupt-parent = <&pmic_intc>;
	interrupts = <2>;
	reg = <0x80>;
};
```

## Documentation/devicetree/bindings/serial/sprd-uart.txt
```
* Spreadtrum serial UART

Required properties:
- compatible: must be "sprd,sc9836-uart"
- reg: offset and length of the register set for the device
- interrupts: exactly one interrupt specifier
- clocks: phandles to input clocks.

Optional properties:
- sprd,dma-tx: the hardware number of UART request DMA.
- dmas: contain the DMA controller node and the DMA channel of the UART
	requesting.
- dma-names: contain one identifier string for each DMA specifier in
	the dmas property.

Examples:
	uart1: serial@70100000 {
		compatible = "sprd,sc9836-uart";
		reg = <0 0x70100000 0 0x100>;
		interrupts = <GIC_SPI 3 IRQ_TYPE_LEVEL_HIGH>;
		clock-names = "enable", "uart", "source";
		clocks = <&clk_ap_apb_gates 14>;
		sprd,dma-tx = <20>;
		dma-names = "tx_chn";
		dmas = <&ap_dma 20>;
		status = "disabled";
	};
```

## Documentation/devicetree/bindings/soc/sprd/sprd,bm-perf.txt
```
Spreadtrum PERF BUSMONITOR

Required properties:
- compatible: "sprd,bm-perf-<chip name>".
	There will be different pub chanel for different Spreadtrum
	SoC families. So we use chip name to compatible different SoC.
	e.g. sprd,bm-perf-pike2; sprd,bm-perf-sharkl2
- reg: Address range of performance busmonitor registers.
- interrupt: Should contain the bus-monitor interrupt number.
- reg-names: Reg names is corresponding to reg base address.If there is doulbe DDR,pub1 will be used.
- sprd,syscon-aon-glb: For global aon apb controller compatible.
- sprd,bm-dma: Performance busmonitor chanel to request DMA,different chips use different channel number.
- dma-names: DMA name for performance busmonitor
- dmas: Choose DMA chanel,this chanel should be available ,not used by others.
Example:

	pub {
		compatible = "simple-bus";
		#address-cells = <1>;
		#size-cells = <1>;
		ranges;

		bm_perf: bm-perf@30040000{
			compatible = "sprd,bm-perf-pike2";
			reg = <0x30040000 0x80000>,
				<0 0>,
				<0x40270000 0x10000>,
				<0x300e0000 0x4>,
				<0 0>;
			interrupts = <GIC_SPI 86 IRQ_TYPE_LEVEL_HIGH>;
			reg-names = "pub0","pub1","timer",
					"pub0_glb","pub1_glb";
			sprd,syscon-aon-glb =  <&aon_apb_controller>;
			sprd,bm-dma = <11>;
			dma-names = "bm_chn";
			dmas = <&aon_dma 9>;
		};
	};
```

## Documentation/devicetree/bindings/soc/sprd/sprd,busmonitor.txt
```
Spreadtrum BUSMONITOR

Required properties:
- compatible: must be "sprd,busmonitor".
- interrupts: Should contain the BUSMONITOR interrupt number.
- reg: Should contain the number of the sys on the djtag bus.
- sprd,bm-num: Should contain the number of BUSMONITOR this sys have.
- sprd,bm-name: Should contain the name of each BUSMONITOR in this sys.
- sprd,bm-type: Should contain all BUSMONITOR type.
- sprd,bm-dap: Should contain the number of the dap contain the BUSMONITOR.
- sprd,bm-config: Should contain busmonitor enable, monitor type
		(monitor writing or reading) and monitor mode.
- sprd,bm-id: Should contain BUSMONITOR the id match function enable,
	      monitored ID and ID type.
- sprd,bm-ranges: Should contain BUSMONITOR monitored range address.

Configuration related macro definitions:
#define ENABLE		1
#define DISABLE		0
#define MON_WRITE	1
#define MON_READ	2
#define MON_WRITEREAD	(MON_WRITE | MON_READ)
#define MON_OUTSIDE	0
#define MON_INSIDE	1

#define USERID		1
#define AXI		1
#define AHB		0
#define AXIID		0

Example:
&djtag {
	aon-busmonitor@3{
		compatible  = "sprd,busmonitor";
		interrupts = <GIC_SPI 34
			IRQ_TYPE_LEVEL_HIGH>;
		reg = <0x3>;
		sprd,bm-num = <4>;
		sprd,bm-name =
			"AP", "WTLCP", "PUBCP","WCN";
		sprd,bm-type =
			<AXI>, <AXI>, <AXI>, <AXI>;
		sprd,bm-dap = <1>, <2>, <3>, <4>;
		sprd,bm-config =
			<DISABLE MON_READ MON_INSIDE>,
			<DISABLE MON_WRITE MON_INSIDE>,
			<DISABLE MON_WRITE MON_INSIDE>,
			<DISABLE MON_WRITE MON_INSIDE>;
		sprd,bm-id =
			<DISABLE 0 AXIID>,
			<DISABLE 0 AXIID>,
			<DISABLE 0 AXIID>,
			<DISABLE 0 AXIID>;
		sprd,bm-ranges =
			<0x33000800 0x3300088c>,
			<0 0>, <0 0>, <0 0>;
	};
}
```

## Documentation/devicetree/bindings/soc/sprd/sprd,camera.txt
```
Spreadtrum camera bindings

Required properties:
- compatible: should be one of:
	"sprd,dcam-r3p0"
	"sprd,cpp"
	"sprd,csi-controller"
	"sprd,mipi-csi-phy"
	"sprd,sprd_scale"
	"sprd,sprd_rotation"
- reg: address range of dcam-r3p0 device.
- interrupters: interrupt number used for dcam r3p0.
- clocks: dcam r3p0 related clocks.
- clock-names: dcam r3p0 related clock names.
- sprd,isp: isp is a attribute of dcam r3p0.
- sprd,dcam-count: dcam r3p0 device contains channel number.

Example:

dcam: dcam@60800000 {
        compatible = "sprd,dcam-r3p0";
        reg = <0x60800000 0x1000>;
        interrupters = <GIC_SPI 45 IRQ_TYPE_LEVEL_HIGH>;
        clocks = <&clk_ahb_mm_gates 0>, <&clk_aon_apb_gates0 25>;
        clock-names = "dcam_eb", "clk_mm_eb";
        sprd,isp = <&isp>;
        sprd,dcam-count = <1>;
        status = "disable";
    };
```

## Documentation/devicetree/bindings/soc/sprd/sprd,dmc-mpu-r4p0.txt
```
Spreadtrum DMC MPU

Required properties:
- compatible: "sprd,dmc-mpu-r4p0".
	There will be different IP versions for different Spreadtrum
	SoC families. So we use specified IP to compatible different SoC.
	e.g. sprd,dmc-mpu-r4p0 for SHARKL3.
- reg: Address range of dmc mpu registers.
- sprd,ddr-interleaved: Used to indicate whether the DDR is interleaved.
- interrupts: Should contain the bus-monitor interrupt number.
- sprd,channel-num: Should contain DDR hardware channel number.
- sprd,mpu-num: Should contain MPU module number.
- sprd,channel-names: Should contain the name of each DDR hardware channel.
- sprd,ranges: Should contain DMC MPU monitored range address each channel.
- sprd,chn-config: Should contain enable channel, monitor range and monitor mode.
- sprd,id-config: Should contain DMC MPU monitored ID type, master ID and mask bits.
- sprd,panic: Used to indicate whether panic when occurred the address violate event
- sprd,shared-chn: Should contain the channel name which used for shared.
- sprd,port-map: Should contain the mapping table from the MPU channel to
		the DDR channel.
- sprd,ddr-offset: The value is the offset of the AXI accessing address to
		the DDR hardware address
- status: Used to indicate whether open the MPU device.

Configuration related macro definitions:
/*MPU property*/
#define ENABLE		1
#define DISABLE		0
#define MON_WRITE	1
#define MON_READ	2
#define MON_WRITEREAD	(MON_WRITE | MON_READ)
#define MON_OUTSIDE	0
#define MON_INSIDE	1

/*ID property*/
#define USERID	1
#define MPUID	0

Example:

dmc_mpu: dmc-mpu@300e0000 {
	compatible = "sprd,dmc-mpu-r4p0";
	reg = <0 0x300e0000 0 0x20000>;
	interrupts = <GIC_SPI 61 IRQ_TYPE_LEVEL_HIGH>;
	sprd,channel-num = <8>;
	sprd,mpu-num = <16>;
	sprd,channel-names =
		"MM", "GPU", "DPU","CPU",
		"AP/PUBCP", "WTLCP", "AON/WCN/ETR",
		"VSP", "SHARED0", "SHARED1",
		"SHARED2","SHARED3", "SHARED4",
		"SHARED5","SHARED6", "SHARED7";
	sprd,ranges = <0 0>, <0 0>, <0 0>, <0 0>,
		<0 0>, <0 0>, <0 0>, <0 0>,
		<0 0>, <0 0>, <0 0>, <0 0>,
		<0 0>, <0 0>, <0 0>, <0 0>;
	sprd,chn-config =
		<DISABLE MON_INSIDE MON_WRITE>,
		<DISABLE MON_INSIDE MON_WRITE>,
		<DISABLE MON_INSIDE MON_WRITE>,
		<DISABLE MON_INSIDE MON_WRITE>,
		<DISABLE MON_INSIDE MON_WRITE>,
		<DISABLE MON_INSIDE MON_WRITE>,
		<DISABLE MON_INSIDE MON_WRITE>,
		<DISABLE MON_INSIDE MON_WRITE>,
		<DISABLE MON_INSIDE MON_WRITE>,
		<DISABLE MON_INSIDE MON_WRITE>,
		<DISABLE MON_INSIDE MON_WRITE>,
		<DISABLE MON_INSIDE MON_WRITE>,
		<DISABLE MON_INSIDE MON_WRITE>,
		<DISABLE MON_INSIDE MON_WRITE>,
		<DISABLE MON_INSIDE MON_WRITE>,
		<DISABLE MON_INSIDE MON_WRITE>;
	sprd,id-config =
			<MPUID 0 0>, <MPUID 0 0>,
			<MPUID 0 0>, <MPUID 0 0>,
			<MPUID 0 0>, <MPUID 0 0>,
			<MPUID 0 0>, <MPUID 0 0>,
			<MPUID 0 0>, <MPUID 0 0>,
			<MPUID 0 0>, <MPUID 0 0>,
			<MPUID 0 0>, <MPUID 0 0>,
			<MPUID 0 0>, <MPUID 0 0>;
	sprd,port-map = <0>, <1>, <2>, <3>, <4>,
			<5>, <6>, <7>, <0>, <0>,
			<0>, <0>, <0>, <0>, <0>,
			<0>;
	sprd,ddr-offset = <0x80000000>;
	sprd,panic;
	status = "disabled";
};
```

## Documentation/devicetree/bindings/soc/sprd/sprd,dmc-mpu.txt
```
Spreadtrum DMC MPU

Required properties:
- compatible: "sprd,dmc-mpu-v1.0".
	There will be different IP versions for different Spreadtrum
	SoC families. So we use specified IP to compatible different SoC.
	e.g. dmc-mpu-v1.0(whale2); dmc-mpu-v2.0(future chip)
- reg: Address range of dmc mpu registers.
- mpu-channels: Number of channels supported by hardware.
- interrupt: Should contain the bus-monitor interrupt number.

Example:

	dmc_mpu: dmc-mpu@30010000{
		compatible = "sprd,dmc-mpu-v1.0";
		reg = <0 0x30010000 0 0x1000>,
		      <0 0x30810000 0 0x1000>;
		#mpu-channels = <11 11>;
		interrupts = <GIC_SPI 143 IRQ_TYPE_LEVEL_HIGH>,
			     <GIC_SPI 144 IRQ_TYPE_LEVEL_HIGH>;
	};
```

## Documentation/devicetree/bindings/soc/sprd/sprd,dsim-plug.txt
```
Spreadtrum dsim-plug bindings

Required properties:
- compatible: must be "sprd,dsim-plug".
- sprd,name: the name of the associated spipe device.
- sprd,dst: communication with the processor ID.
- sprd,channel: the channel of the associated sbuf.
- sim1-gpios: specified detection SIM1 card hot plug pin.
- sim2-gpios: specified detection SIM2 card hot plug pin.

Example:

dsim-plg-lte {
	compatible = "sprd,dsim-plug";
	sprd,name = "dsim-plg-lte";
	sprd,dst = <5>;
	sprd,channel = <23>;
	sim1-gpios = <&ap_gpio 40 0>;
	sim2-gpios = <&ap_gpio 41 0>;
};
```
