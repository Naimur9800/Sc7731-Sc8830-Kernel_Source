## Documentation/devicetree/bindings/thermal/sprd_cooling_device.txt
```
Spreadtrum cooling device

The Spreadtrum cooling devices can be bound to thermal zone trip points.
When a trip point reached, the bound cpufreq cooling device turns active
to set CPU frequency low to cool down the CPU.

Required properties:
- compatible :    Should be "sprd,cpu-cooling"
- policy : 	  used to describe cooling devices thermal policy,
		  set IPA if policy filled,
		  other policy if it is empty
- sprd,efuse-block :
		  Efuse block number is used to indicate that in order to
		  get thermal information which efuse block should read.
- #cooling-cells: Used to provide cooling device specific information
		  while referring to it. Must be at least 2, in order
		  to specify minimum and maximum cooling state used
		  in the reference. The first cell is the minimum
		  cooling state requested and the second cell is
		  the maximum cooling state requested in the reference.
		  See Cooling device maps section below for more details
		  on how consumers refer to cooling devices.
Optional properties:
- sprd,leak-core: coefficient of core leakage power.
- sprd,leak-cluster:
		  coefficient of cluster leakage power.
- sprd,temp-scale:For temperature scale calculation.
- sprd,volt-scale:For voltage scale calculation.
- sprd,hotplug-period:
		  Periods to wait before hotplugging CPUs.
- sprd,core-base:
		  base of core leakage power.
- sprd,cluster-base:
		  base of cluster leakage power.
- sprd,dynamic-core:
		  coefficient of core dynamic power.
- sprd,dynamic-cluster:
		  coefficient of cluster dynamic power.

Example:

cooling-devices {
	policy = "ipa";
	cooling_device0: cooling-device0 {
		compatible = "sprd,cpu-cooling";
		#cooling-cells = <2>; /* min followed by max */
		sprd,efuse-block = <7>;
		sprd,leak-core = <2 85 1869>;
	};
	cooling_device1: cooling-device1 {
		compatible = "sprd,cpu-cooling";
		#cooling-cells = <2>; /* min followed by max */
		sprd,efuse-block = <7>;
		sprd,temp-scale = <825 (-117000) 6080000 (-81850000)>;
	};
};
```

## Documentation/devicetree/bindings/thermal/sprd_thermal.txt
```
* Spreadtrum thermal

The Spreadtrum thermal support read temp and strategy(Optional)
Thermal node properties:
Required properties:
		compatible : should be these followings.
			     "sprd,ap-thermal";
			     "sprd,sc2723-thermal";
			     "sprd,virt-thermal";
		k-po: the proportional term constant during temperature
		      overshoot periods (current temperature is above
		      "desired temperature" trip point).
		k-pu: the proportional term constant during temperature
		      undershoot periods (current temperature below
		      "desired temperature" trip point).
		k-i: configures the PID loop's integral term constant
		k-d: configures the PID loop's derivative term constant
		cutoff: When the temperature error is below `integral_cutoff`,
		        errors are accumulated in the integral term

Example:
virt_sensor: virt-sensor@11 {
		compatible = "sprd,virt-thermal";
		#thermal-sensor-cells = <1>;
		sensor-names = "cpu-thm";
		k-po = <128>;
		k-pu = <256>;
		k-i = <2>;
		cutoff = <10000>;
		};
```

## Documentation/devicetree/bindings/timer/sprd,gptimer.txt
```
Spreadtrum General Purpose Timer bindings

Required properties:
- compatible : this property should be set to one of the following:
	"sprd,gp-timer" (default compatible string)
	"sprd,evt-r3p0" (applicable to soc using sprd r3p0 ip as clockevent
			and clocksource)
	"sprd,bcevt-r3p0" (applicable to soc using sprd r3p0 IP as broadcast
			clockevent)
	"sprd,evt-r4p0" (applicable to soc using sprd r4p0 ip as clockevent
			and clocksource)
	"sprd,bcevt-r4p0" (applicable to soc using sprd r4p0 IP as broadcast
			clockevent)
	"sprd,aon-systimer" (default to aon system timer node)
	"sprd,ap-systimer" (default to ap system timer node)

- reg : Contains timer register address range (base address and length).

- clock-frequency : The frequency of the general purpose timer in Hz.

Optional properties:
- interrupts : Contains the interrupt information for the timer. The
  format is being dependent on interrupt parent controller.

- sprd,evtlist : Contains the timer used as clockevent timer for each cpu.

- sprd,clksrc : Contains the timer used as the clocksource counter.

Example:

sprd_evt_r3p0 {
	compatible  = "sprd,evt-r3p0";
	sprd,evtlist = <&aon_timer0
				&apt0_timer0 &apt1_timer0 &apt2_timer0>;
	sprd,clksrc = <&aon_timer1>;
};

aon_timer0: timer@40050000 {
	reg =   <0 0x40050000 0 0x14>;
	compatible = "sprd,bcevt-r3p0";
	interrupts = <GIC_SPI 28 IRQ_TYPE_LEVEL_HIGH>;
	clock-frequency = <32768>;
};

aon_timer0: timer@40050000 {
	reg =   <0 0x40050000 0 0x14>;
	compatible = "sprd,bcevt-r4p0";
	interrupts = <GIC_SPI 28 IRQ_TYPE_LEVEL_HIGH>;
	clock-frequency = <32768>;
};
```

## Documentation/devicetree/bindings/timer/sprd,persistent-clock.txt
```
Spreadtrum persistent clock bindings

Required properties:
- compatible : this property should be set to :
	"sprd,persistent-clock"

- reg : Contains timer register address range (base address and length).

- clock-frequency : The frequency of the general purpose timer in Hz.

Example:

aon_timer1: timer@40050020 {
	compatible = "sprd,persistent-clock";
	reg = <0x40050020 0x14>;
	clock-frequency = <32768>;
};
```

## Documentation/devicetree/bindings/video/sprd,mipi-panel.txt
```
Spreadtrum MIPI Panel Binding file
-----------------------------------
In Spreadtrum Board configuration, Each MIPI Panel have their
own specific DTSI file.
All the Panel specific data is presented into this file.

MIPI Panel driver(generic for all mipi Panels) read the Panel data from
this DTSI file and communicate(send/receive data) with Panel accordingly.

According to the panel connected with Board, we have to include the right
Panel(DTSI) file in the DTS(Spreadtrum Board file).


-- lcd_XXX_mipi --> mipi panel node label
	here XXX would be any LCD panel name. E.g. hx8394a

-------------------
Required properties
-------------------
	-reg			: Id of lcd panel
	-panel-name		: Name of lcd panel

	*Display timing parameter refer-
	kernel\documentation\devicetree\bindings\video\display-timing.txt.

	-hactive		: Display timing parameter
	-vactive		: Display timing parameter
	-hfront-porch		: Display timing parameter
	-hback-porch		: Display timing parameter
	-hsync-len		: Display timing parameter
	-vback-porch		: Display timing parameter
	-vfront-porch		: Display timing parameter
	-vsync-len		: Display timing parameter
	-hsync-active		: hsync pulse is active low/high/ignored
	-vsync-active		: vsync pulse is active low/high/ignored
	-de-active		: data-enable pulse is active low/high/ignored

	-fps			: frame per second E.g. 60, 30, etc.
	-work-mode		: type of work mode
				command mode(0) or video mode(1)

	-bpp			: DPI, eDPI bus width -> 16, 18 or 24
	-lane-number		: number of MIPI D-PHY lanes
	-dphy-freq		: MIPI PHY frequency
	-color-mode_pol		: color mode polarity
	-shut-down_pol		: shut down polarity

Optional Properties :
--------------------
	-clean-lcd		: 0 or 1, whether to clean LCD
				at the time of resume
	-direction		: refer to "LCD Direction Info" section
	-te-active		: tearing polarity
	-sprd,simu-width	: low resolution simulator width
	-sprd,simu-height	: heigh resolution simulator width
	-esd			: ESD value used in esd operations
--------------------------------
Panel's operations specific nodes
--------------------------------

Panel init operation
--------------------
- init-data --> Panel init operation specific info/data.
	- Command Structure: [cmd_type, wait_time, 2-bytes-data-len, data]
				--- N commands
			[cmd_type, wait_time, 2-bytes-data-len, data]

-----------------------
Panel read-id operation
-----------------------
- readid-wrcmd --> read-id operation's write data/info.
	ex: [37 00 00 02 03 00]
	command structure same as of init-data node(mentioned above)

- readid-rdcmd:Read data from Panel for LCD Panel id.
	ex: [0x04 3]
	command structure: [read_addr-1,length_to_read]
	--- N read
	[read_addr-n,length_to_read]

- readid-cmp: compare data to compare with data read from Panel
					for LCD Panel id.
	ex: [00 83 01 94 2 0x1A]
	command structure: [byte-to-compare-1,data]
	--- N comparison
	[byte-to-compare-n,data]

---------------------
Panel sleep operation
---------------------
- sleep-in: command data for set of commands, for panel_sleep operation.

	ex: [39 00 00 02 28 00]
	command structure same as of init-data node(mentioned above)

- sleep-out: command data for set of commands, for panel_sleep operation.
	ex: [39 78 00 02 11 00]
	command structure same as of init-data node(mentioned above)

-----------------------
ESD specific operations ->>>
-----------------------
- esd-check: command data to write to lcd in ESD operation
	ex: [37 00 00 02 01 00]
	command structure same as of init-data node(mentioned above)


---------------------
LCD Direction Info
---------------------
LCD_DIRECT_NORMAL	0
LCD_DIRECT_ROT_90	1
LCD_DIRECT_ROT_180	2
LCD_DIRECT_ROT_270	3
LCD_DIRECT_MIR_H	4
LCD_DIRECT_MIR_V	5
LCD_DIRECT_MIR_HV	6
---------------------


Example:
--------
/{
	lcd_hx8394a_mipi: lcd-hx8394a-mipi@0 {

		reg			= <0x8394>;
		panel-name		= "lcd_hx8394a_mipi";

		hactive			= <720>;
		vactive			= <1280>;
		hfront-porch		= <80>;
		hback-porch		= <60>;
		hsync-len		= <60>;
		vback-porch		= <12>;
		vfront-porch		= <38>;
		vsync-len		= <4>;
		hsync-active		= <0>;
		vsync-active		= <0>;
		de-active		= <0>;
		te-active		= <0>;

		fps			= <60>;
		direction		= <0>;
		work-mode		= <1>;
		bpp			= <24>;
		lane-number		= <4>;
		dphy-freq		= <450000>;
		color-mode-pol		= <1>;
		shut-down-pol		= <1>;

		esd			= <28>;

		init-data		= [
					39 00 00 04 B9 FF 83 94
					39 00 00 11 BA 63 82 00 16 C5
					00 10 FF 0F 24 03 21 24 25 20 08
					39 00 00 12 B1 01 00 04 C4 03 12
					F1 24 2C 3F 3F 57 02 00 E6 E2 A6
					39 00 00 07 B2 00 C8 0E 30 00 33
					39 00 00 20 B4 80 04 32 10 08 54
					15 0F 22 10 08 47 53 54 0A 4B 53
					54 02 61 61 02 06 44 06 5F 0A 6B
					70 05 08 39 00 00 02 B6 21
					39 00 00 37 D5 00 00 00 00 0A 00
					01 22 00 33 CC 00 AA BB 01 23 45
					67 9A BC 45 67 88 88 88 88 88 88
					88 01 88 88 88 88 88 88 88 88 88
					88 88 88 88 88 88 88 88 88 88 88
					88 88 3C 01 39 00 00 02 cc 09
					39 00 00 05 bf 06 02 10 04
					39 00 00 05 c7 00 10 00 10
					39 00 00 1A E0 00 04 08 28 2F 3F
					15 34 06 0C 0E 12 14 13 14 11 19
					00 04 08 29 2E 3F 15 35
					39 00 00 11 07 0C 0F 11 13 11 12
					10 16 0A 17 07 12 0A 17 06 11
					39 00 00 03 c0 0c 17
					39 00 00 03 c6 08 08
					39 00 00 02 D4 32
					39 78 00 01 11
					39 0a 00 12 BA 63 82 00 16 C5 00
					10 FF 0F 24 03 21 24 25 20 08 3D
					39 64 00 01 29
					];

		esd-check		= [37 00 00 02 01 00];

		readid-wrcmd		= [37 00 00 02 03 00];
		readid-rdcmd		= [04 3];
		readid-cmp		= [00 83 01 94 02 1A];

		sleep-in		= [
					39 00 00 02 28 00
					39 78 00 02 10 00
					];
		sleep-out		= [
					39 78 00 02 11 00
					39 00 00 02 29 00
					];
	};
};
```
