## Documentation/devicetree/bindings/soc/sprd/sprd,iq-mem.txt
```
Spreadtrum iq bindings

Required properties:
- compatible: must be "sprd,iq-mem".
- reg: address range of iq-mem device.

Example:
q_reserved: iq-mem@93100000{
	compatible = "sprd,iq-mem";
	reg = <0x93100000 0x8000000>;
};
```

## Documentation/devicetree/bindings/soc/sprd/sprd,iq.txt
```
Spreadtrum iq bindings

Required properties:
- compatible: must be "sprd,iq".
- sprd,region: the memory of the associated iq data.
- sprd,mapping-offs: ap/cp mapping.

Example:

sprd-iq {
	compatible = "sprd,iq";
	sprd,region = <&iq_reserved>;
	sprd,mapping-offs = <0x80000000>;
};
```

## Documentation/devicetree/bindings/soc/sprd/sprd,mailbox.txt
```
Spreadtrum mailbox bindings

Required properties:
- compatible: must be "sprd,mailbox".
- reg: address range of mailbox registers.
- sprd,syscon-ap-apb: must be <&aon_apb_controller>.
- interrupts: interrupt number used for mailbox.
- sprd,core-cnt: number of processor cores using mailbox communications.
- sprd,version: driver version used.

Example:

mailbox@400a0000 {
	compatible = "sprd,mailbox";
	reg = <0 0x400a0000 0 0x8000>,
	      <0 0x400a8000 0 0x8000>;
	sprd,syscon-ap-apb = <&aon_apb_controller>;
	interrupts = <GIC_SPI 28 0>,
		     <GIC_SPI 29 0>;
	sprd,core-cnt = <6>;
	sprd,version = <2>;
};
```

## Documentation/devicetree/bindings/soc/sprd/sprd,memdisk.txt
```
SPRD memdisk Driver

sprd memdisk driver use a block of DDR memory as a disk. we can load the
android image to this disk when mmc driver is not ready, for example in
vdk and FPGA platform.

Required properties:
- compatible: must be "sprd,memdisk"
- memory-region: indicates the phandle of reserved memory used as disk

Example for iwhale2 vdk:

reserved-memory {
	#address-cells = <2>;
	#size-cells = <2>;
	ranges;

	memdisk_reserved: memdisk@10000000 {
			  reg = <0x0 0x10000000 0x0 0x23c34600>, /* system */
			        <0x0 0x08000000 0x0 0x8000000>; /* userdata */
	};
};

sprd_memdisk {
	compatible = "sprd,memdisk";
	memory-region = <&memdisk_reserved>;
};
```

## Documentation/devicetree/bindings/soc/sprd/sprd,scproc_pubcp.txt
```
Spreadtrum scproc_pubcp bindings

Required properties:
- compatible:
	"sprd,scproc" for sp9830/sp9832/sp9838 SoCs
	"sprd,scproc_pubcp" for sp9850/sp9860 SoCs
- sprd,name: used to generate the name of the directory in the proc file system.
- sprd,ctrl-reg: register offset for controlling CP start.
- sprd,ctrl-mask: corresponding control register mask.
- sprd,ctrl-type: control register type(AON_APB or PMU_APB).
- reg: address range of cp runtime region.
- #address-cells: must be 1.
- #size-cells: must be 1.
- ranges: child node relative to the address range of the parent node.

ChildNode required properties:
- cproc,name: used to generate the name of the file in the proc file system.
- reg: address range.

Example:

scproc@080000 {
	compatible = "sprd,scproc_pubcp";
	sprd,name = "pmic";
	sprd,syscon-ap-apb = <&aon_apb_controller>;
	sprd,syscon-ap-pmu = <&pmu_apb_controller>;
	sprd,ctrl-reg = <0xff 0xff 0xc4 0xff>;
	sprd,ctrl-mask = <0x400 0x800000 0x200002 0x1>;
	sprd,ctrl-type = <0x0 0x1 0x1 0x1>;
	reg = <0 0x80000 0 0x40000>;
	#address-cells = <1>;
	#size-cells = <1>;
	ranges = <0x0 0x0 0x80000 0x40000>;
	pm_sys@0 {
		cproc,name = "pm_sys";
		reg = <0x0 0x40000>; /* <pmsys_addr size> */
	};
};
```

## Documentation/devicetree/bindings/soc/sprd/sprd,sdiodev.txt
```
Spreadtrum Sdio Device

Required properties:

- compatible: should be "sprd,marlin"
- bt-wakeup-ap-gpios: marlin bt wake up baseband chip
- ap-wakeup-cp-gpios: ap wake up marlin chip
- wifi-wakeup-ap-gpios: marlin req ap sdio to read data
- cp-reset-gpios: marlin reset pin
- vddcon-supply: marlin VDD voltage
- vddwifipa-supply: marlin wifi pa VDD voltage
- clock-names:
		The clock-names must have "clk_aux0".
		The clk_aux0 for spreadtrum clock-name should contain clk_aux0
		clock node.
- clocks: The freq of source clk connected to clk_aux0.
- sdhci-name: sdio host

Example:

sprd-marlin {
	compatible = "sprd,marlin";
	bt-wakeup-ap-gpios = <&ap_gpio 97 0>;
	ap-wakeup-cp-gpios = <&ap_gpio 132 0>;
	wifi-wakeup-ap-gpios = <&ap_gpio 133 0>;
	cp-reset-gpios = <&ap_gpio 122 0>;
	vddcon-supply = <&vddcon>;
	vddwifipa-supply = <&vddwifipa>;
	clk-name = "clk_aux0";
	clock	= <&ext_32k>;
	sdhci-name = "sdio_wifi";
};
```

## Documentation/devicetree/bindings/soc/sprd/sprd,seth.txt
```
Spreadtrum seth bindings

Required properties:
- compatible: must be "sprd,seth".
- sprd,name: the name of the associated seth device.
- sprd,dst: communication with the processor ID.
- sprd,channel: the channel of the associated sbuf.
- sprd,blknum: the number of the sblock.
- sprd,poolsize: the size of the block for receiving data.

Example:

seth0-lte {
	compatible = "sprd,seth";
	sprd,name = "seth_lte0";
	sprd,dst = <5>;
	sprd,channel = <7>;
	sprd,blknum = <256>;
	sprd,poolsize = <16>;
};
```

## Documentation/devicetree/bindings/soc/sprd/sprd,sipc.txt
```
Spreadtrum spipe bindings

Required properties:
- compatible: must be "sprd,sipc-v1".
- sprd,name: the name of the associated sipc device.
- sprd,dst: communication with the processor ID.
- sprd,smem-info: ap/cp shared memory info.

Example:

sipc@7800000 {
	compatible = "sprd,sipc-v1";
	sprd,name = "sipc-lte";
	sprd,dst = <5 2>; /* <dst core-id> */
	/* <ap-addr dst-maped-addr size> */
	sprd,smem-info = <0x07800000 0x87800000 0x5b0000>;
};
```

## Documentation/devicetree/bindings/soc/sprd/sprd,sipx.txt
```
Spreadtrum sipx bindings

Required properties:
- compatible: must be "sprd,sipx".
- sprd,name: the name of the associated spipe device.
- sprd,dst: communication with the processor ID.
- sprd,dl-pool: used to configure the size of dl-pool.
- sprd,dl-ack-pool: used to configure the size of dl-ack-pool.
- sprd,ul-pool: used to configure the size of ul-pool.
- sprd,ul-ack-pool: used to configure the size of ul-ack-pool.

Example:

sipx-lte {
	compatible = "sprd,sipx";
	sprd,name = "sipx_lte";
	sprd,dst = <5>;
	sprd,dl-pool = <1024>;
	sprd,dl-ack-pool = <512>;
	sprd,ul-pool = <1024>;
	sprd,ul-ack-pool = <1024>;
};
```

## Documentation/devicetree/bindings/soc/sprd/sprd,sleep-config.txt
```
Spreadtrum sleep config bindings

Required properties:
- compatible: should be one of:
	 "sprd,sys-ap-intc"
	 "sprd,sys-aon-intc"
	 "sprd,sys-aon-iram0"
- reg: address range of controller registers.

Example:
	intc0_controller: syscon@71400000 {
		compatible = "sprd,sys-ap-intc", "syscon";
		reg = <0x71400000 0x1000>;
	};
```

## Documentation/devicetree/bindings/soc/sprd/sprd,sleep-ctrl.txt
```
Spreadtrum DDR force light sleep feature

Required properties:
- compatible: should be "sprd,sleep-ctrl".
- sprd,sys-aon-apb: aon apb.
- sprd,aon_reg: aon register

Example:

	sleep-ctrl {
		compatible = "sprd,sleep-ctrl";
		sprd,sys-aon-apb = <&aon_apb_controller>;
		sprd,aon_reg = <0x0530>;
	};
```

## Documentation/devicetree/bindings/soc/sprd/sprd,spipe.txt
```
Spreadtrum spipe bindings

Required properties:
- compatible: must be "sprd,spipe".
- sprd,name: the name of the associated spipe device.
- sprd,dst: communication with the processor ID.
- sprd,channel: the channel of the associated sbuf.
- sprd,size-rxbuf: the size of the ring buffer for receiving data.
- sprd,size-txbuf: the size of the ring buffer for sending data.
- sprd,sipc-name: which SIPC device is used.

Example:

stty-lte {
	compatible = "sprd,spipe";
	sprd,name = "stty_lte";
	sprd,dst = <5>;
	sprd,channel = <6>;
	sprd,ringnr = <32>;
	sprd,size-rxbuf = <0x0800>; /* 2*1024*/
	sprd,size-txbuf = <0x0800>; /* 2*1024 */
	sprd,sipc-name = "sipc0";
};
```

## Documentation/devicetree/bindings/soc/sprd/sprd,spool.txt
```
Spreadtrum spool bindings

Required properties:
- compatible: must be "sprd,spool".
- sprd,name: the name of the associated spool device.
- sprd,dst: communication with the processor ID.
- sprd,channel: the channel of the associated sblock.
- sprd,tx-blksize: the size of the tx-block buffer for sending data.
- sprd,tx-blknum: the number of the tx-block buffers.
- sprd,rx-blksize: the size of the rx-block buffer for receiving data.
- sprd,rx-blknum: the size of the rx-block buffers.

Example:

slog_lte {
	compatible = "sprd,spool";
	sprd,name = "slog_lte";
	sprd,dst = <5>;
	sprd,channel = <5>;
	sprd,tx-blksize = <0>;
	sprd,tx-blknum = <0>;
	sprd,rx-blksize = <0x10000>; /* 64k*/
	sprd,rx-blknum = <4>;
};
```

## Documentation/devicetree/bindings/soc/sprd/sprd,swcnblk.txt
```
Spreadtrum swcnblk bindings

Required properties:
- compatible: must be "sprd,swcnblk".
- sprd,name: the name of the associated swcnblk device.
- sprd,dst: communication with the processor ID.
- sprd,channel: the channel of the associated sblock.
- sprd,tx-blksize: the size of the tx-block buffer for sending data.
- sprd,tx-blknum: the number of the tx-block buffers.
- sprd,rx-blksize: the size of the rx-block buffer for receiving data.
- sprd,rx-blknum: the size of the rx-block buffers.
- sprd,basemem: the sblock addr alloc from the basemem.
- sprd,alignsize: the size of the block buffer align.

Example:

wcn_wifi_data0 {
	compatible = "sprd,swcnblk";
	sprd,name = "wcn_wifi_data0";
	sprd,dst = <3>;
	sprd,channel = <8>;
	sprd,tx-blksize = <1664>;
	sprd,tx-blknum = <64>;
	sprd,rx-blksize = <1664>;
	sprd,rx-blknum = <128>;
	sprd,alignsize = <4096>;
};
```

## Documentation/devicetree/bindings/soc/sprd/sprd,sys-dmc-phy.txt
```
Spreadtrum DDR CAPACITY DRV

Required properties:
- compatible:should be "sprd,sys-dmc-phy".
- reg: Address range of dmc registers.
- sprd,sizel_off: Low 32bit address of DDR CAPACITY.
- sprd,sizeh_off: High 32bit address of DDR CAPACITY.

Example:

	pub {
		compatible = "simple-bus";
		#address-cells = <1>;
		#size-cells = <1>;
		ranges;

		dmc_controller: syscon@30000000 {
			compatible = "sprd,sys-dmc-phy", "syscon";
			reg = <0x30000000 0x400>;
			sprd,sizel_off = <0x1b4>;
			sprd,sizeh_off = <0x1b8>;
		};
	};
```

## Documentation/devicetree/bindings/soc/sprd/sprd,vibrator.txt
```
Spreadtrum Vibrator Bindings

The vibrator depends on different controllers, such as sc2723 or sc2731.

Required properties:
- compatible: must be one of
  sprd,sc2723t-vibrator
  sprd,sc2731-vibrator

- reg: the chipselect index

Example 1:

vibrator@8f8 {
	compatible = "sprd,sc2723t-vibrator";
	reg = <0x8f8>;
};

Example 2:

vibrator@ec8 {
	compatible = "sprd,sc2731-vibrator";
	reg = <0xec8>;
};
```

## Documentation/devicetree/bindings/soc/sprd/sprd-deepsleep.txt
```
Spreadtrum deepsleep bindings

Required properties:
- compatible: must be "sprd,deep-sleep".
- reg: address range of dcam-r3p0 device.
- sprd,sys-ap-ahb: ap ahb controller.
- sprd,sys-ap-apb: ap apb controller.
- sprd,sys-pmu-apb: aon pmu controller.
- sprd,sys-aon-apb: aon apb controller.
- sprd,sys-ap-intc0: ap interrupt controller0.
- sprd,sys-ap-intc1: ap interrupt controller1.
- sprd,sys-ap-intc2: ap interrupt controller2.
- sprd,sys-ap-intc3: ap interrupt controller3.
- sprd,sys-aon-intc: aon interrupt controller.
- sprd,sys-aon-iram0: aon iram.
- sprd,deep-ap-clk0: ap clock config.
- sprd,deep-ap-clkp: ap clock parent.

Example:

		deep-sleep {
			compatible = "sprd,deep-sleep";

			sprd,sys-ap-ahb = <&ap_ahb_controller>;
			sprd,sys-ap-apb = <&ap_apb_controller>;
			sprd,sys-pmu-apb = <&pmu_apb_controller>;
			sprd,sys-aon-apb = <&aon_apb_controller>;

			sprd,sys-ap-intc0 = <&intc0_controller>;
			sprd,sys-ap-intc1 = <&intc1_controller>;
			sprd,sys-ap-intc2 = <&intc2_controller>;
			sprd,sys-ap-intc3 = <&intc3_controller>;
			sprd,sys-aon-intc = <&aon_intc_controller>;
			sprd,sys-aon-iram0 = <&aon_iram0>;

			sprd,deep-ap-clk0 = <&clk_ap_top_axi &clk_ap_ahb
				&clk_ap_apb &clk_gsp &clk_dispc0
				&clk_dispc0_dpi &clk_dsi_rxesc &clk_dphy_ref
				&clk_dphy_cfg &clk_otg_ref &clk_otg_utmi
				&clk_ce_sefuse &clk_ce_pub &clk_ce_sec
				&clk_uart0 &clk_uart1 &clk_uart2
				&clk_uart3 &clk_uart4
				&clk_i2c0 &clk_i2c1 &clk_i2c2 &clk_i2c3
				&clk_i2c4 &clk_spi0 &clk_spi2 &clk_iis0
				&clk_iis1 &clk_iis2 &clk_iis3>;
			sprd,deep-ap-clkp = <&ext_26m &ext_32k>;
		};
```

## Documentation/devicetree/bindings/soc/sprd/sprd-sysdump.txt
```
Spreadtrum Debug Sysdump bindings

Required properties:
- memory-region: a list of phandles to memory and other useful reserved node,
	such as mm_reserved node, overlay_reserved node.

Optional properties:
- iomem: a list of phandles to the sepcific node, which is added by owner
	according to whether module registers is need save by sysdump.

Example:

sprd-sysdump {
		memory-region = <&{/memory@80000000}>,<&mm_reserved>,
		 <&overlay_reserved>;
		iomem = <&isp>,<&vsp>;
};
```

## Documentation/devicetree/bindings/spi/spi-sprd-adi.txt
```
Spreadtrum ADI controller based on SPI framework device bindings

ADI bus is defined for communication between A-Die chip and D-Die chip,
And it follows the SPI framework for its hardware implementation is alike
to SPI bus and its timing is compatile to SPI timing.

ADI-SPI bus supports up to 26M, and supports up to 2 chips.

Required properties:
- compatible: Should be"sprd,sc9838-adi", it's similar to that on sc9838 SoC family.
- reg: Offset and length of ADI-SPI controller register space.
- #address-cells: number of cells required to define a chip select
	address on the ADI-SPI bus. Should be set to 1.
- #size-cells: size of cells required to define a chip select address size on
	the ADI-SPI bus, should be set to 0.
- sprd,hw-channels: the hw channel is used to wr/rd datas, one is the hw channel number
	should be enabled, the other is the value should be configed.

SPI slave nodes must be children of the SPI master node and can contain
properties described in Documentation/devicetree/bindings/spi/spi-bus.txt.

Example:
	adi_bus: spi@40030000 {  /* adi-controller */
		compatible = "sprd,sc9838-adi";
		reg = <0 0x40030000 0 0x10000>;
		#address-cells = <1>;
		#size-cells = <1>;
		sprd,hw-channels = <0 0>;

		a-die0: a-die@0 {
			compatible = "sprd,sc2723";
			reg = <0>; /* chip select 0 */
			spi-max-frequency = <26000000>;

			adi_rtc {
				compatible = "sprd,adi-rtc";
				reg = <0x80 0x80>;
				interrupt-parent = <&adie-intc>;
				interrupts = <2 0x0>;
			};
		};
	};
```

## Documentation/devicetree/bindings/spi/spi-sprd.txt
```
SPI for Spreadtrum platforms

Required properties:
- compatible: should be "sprd,spi-r4p0".
- reg: physical base address of the controller and length of memory mapped region.
- interrupts: Should contain SPI interrupt
- clock-names: The clock-names must have "spi", "source" and "enable".
	       Clock-names is fixed in SPI driver, and the property order
	       of clocks is according to it. SPI drivers will use clock-names
	       to match clock input names with clocks specifiers.
- clocks: The freq of source clk connected to SPI. List of clock input name
	  strings sorted in the same order as the clocks property.
- #address-cells: number of cells required to define a chip select
		  address on the SPI bus.Should be set to 1.
- #size-cells: Should be set to 0.


Example:
spi0: spi@70a00000{
	compatible = "sprd,spi-r4p0";
	reg = <0 0x70a00000 0 0x1000>;
	interrupts = <GIC_SPI 7 IRQ_TYPE_LEVEL_HIGH>;
	clock-names = "spi", "source","enable";
	clocks = <&clk_spi0>,<&ext_26m>,
		<&clk_ap_apb_gates 5>;
	#address-cells = <1>;
	#size-cells = <0>;
	status = "disabled";
};
```
