## Documentation/devicetree/bindings/video/sprd,panel.txt
```
Spreadtrum Generic Panel Binding file
-------------------------------------
In Spreadtrum Board Configurations, Generic LCD Panel framework
supports multiple LCD panels integration, dynamically at runtime.
Each LCD panel have its specific DTSI file.

The panel data, that is common to all LCD panels,
should be specified under LCD panel node exist in Board file(DTS).

Panel driver read panel's data from their respective DT nodes
defined in their DTSI files and communicate(send/receive data)
with Panel. Panel node, corresponding to which communication succeed,
is set and attach with SOC.

-------------------
Required Properties
-------------------

-compatible	:
		"sprd,lcd-mipi-panel" - for mipi panel driver
		"sprd,lcd-lvds-panel" - for lvds panel driver
		"sprd,lcd-rgb-panel" - for rgb panel driver
		"sprd,lcd-mcu-panel" - for mcu panel driver

-vlcdio-supply	: LCD I/O power supply regulators
-vlcdcore-supply: LCD core power supply regulators
-sprd,lcd-panels: Phandle list of LCD panels nodes
		(contains panel configuration data).

---------------
Required Nodes
---------------

-port :
-remote-endpoint : remote end point of panel node, through
		which panel communicates(send/receive) with DISPC or DSI.

Example:
--------
lcd0: panel@0 {
	compatible	= "sprd,lcd-mipi-panel";

	vlcdio-supply	= <&vdd28>;
	vlcdcore-supply	= <&vdd18>;
	sprd,lcd-panels	= <&lcd_ssd2075_mipi>,<&lcd_hx8394a_mipi>;

	port {
		panel_in: endpoint {
			remote-endpoint = <&dsi0_out>;
		};
	};
};

DSI node
---------
&dsi0{
	...
	ports {
		#address-cells = <1>;
		#size-cells = <0>;
		port@1 {
			reg = <1>;
			dsi0_out: endpoint {
				remote-endpoint = <&panel_in>;
			};
		};
	};
	...
};
```

## Documentation/devicetree/bindings/video/sprd,sharkl64-dispc.txt
```
DT Binding for Spreadtrum Display controller(DISPC) of Sharkl64
===============================================================

This document specify the Spreadtrum Display controller and its subsystem bindings.
It read data from the memory and output it to DSI0 controller. which in turn
transfer data to LCD Panel through MIPI interface.
In-case of RGB/MCU Panel, DISPC transfer data to LCD Panel through parallel
interface ports.

Required properties:
--------------------
  - compatible: it should be compatible with one of the following:
			"sprd,sc9838-dispc"; /* for Sharkl64 SoCs */
			"sprd,fpga-dispc" /* for development purpose */
  - reg: physical base address and length of the registers set for the device.
  - interrupts: contain DISPC interrupts.
  - clocks: a list of phandles as per clock specifiers mentioned in the clock-names.
  - clock-names: name of clock include dispc, dbi, dpi and dispc_emc clock entries.
  - clock-src: should contain the frequency of the clock.
  - memory-region: phandle to a node describing FB node, see document [2]
  - ports: contains a endpoint node which is connected to dispc node.
		#address-cells: should be 1
		#size-cells: should be 0
  - sprd,default-fps: specifies the default frequency for lcd to display frames.

Optional properties:
--------------------
  - rgb-if-timings: specify the timing information of the RGB interface incase of
		RGB Panel, see document [3] for more information.
  - mcu-if-timings: specify the timing information of the MCU interface incase of
		MCU Panel, see document [3] for more information.
  - sprd,fb_triple_framebuffer: Specify this property to enable triple frame
		buffer else it use normal buffering.  It is of boolean type.
  - sprd,input-data-type: Specify the inpput data type. Use 32 for ABGR888 or
		16 for BGR565, default set to 32.
  - sprd,light-sleep: Specify this property to enable light sleep,
		default it is disabled.
  - sprd,pll_type: specify the pll type from 0 or 2, default set to 2.

[1]: Documentation/devicetree/bindings/media/video-interfaces.txt
[2]: Documentation/devicetree/bindings/reserved-memory/reserved-memory.txt
[3]: Documentation/devicetree/bindings/video/display-timing.txt

Aliases:
--------
An alias should be created for the display, it can be used to assign the
style of each display. If no alias is defined, a random number is used
for display.

Example:
--------
SOC specific entries --->>

dispc0: dispc@20800000 {
	compatible = "sprd,sc9838-dispc";
	reg = <0 0x20800000 0 0x1000>;
	interrupts = <GIC_SPI 46 IRQ_TYPE_NONE>;
	clock-names = "dispc_clk_parent",
		"dispc_dbi_clk_parent",
		"dispc_dpi_clk_parent",
		"dispc_emc_clk_parent",
		"dispc_clk",
		"dispc_dbi_clk",
		"dispc_dpi_clk",
		"dispc_emc_clk";
	clocks = <&clk_twpll_256m_def>,
		<&clk_twpll_256m_def>,
		<&clk_twpll_384m_def>,
		<&clk_aon_apb>,
		<&clk_dispc0>,
		<&clk_dispc0_dbi>,
		<&clk_dispc0_dpi>,
		<&clk_aon_apb_gate1>;
	status = "disabled";
	port {
		#address-cells = <1>;
		#size-cells = <0>;
		dispc0_1: endpoint@0 {
			reg = <0>;
			remote-endpoint = <&dsi0_in>;
		};
	};
};

This is the board specific description of Shark64 platform, it may contain lcd
connected to DISPC using RGB/MCU(Parallel interface). Or it may communication with
the display controller using DSI(Serial interface).
	DISPC <-(RGB or MCU)-> LCD	Or
	DISPC <--> DSI <--> LCD

Board specific DT entry:
/ {
	aliases {
		...
		dispc0 = &dispc0;
	};
}

&dispc0 {
	status  = "okay";
	compatible = "sprd,sc9838-dispc";
	memory-region = <&fb_reserved>;
	sprd,dpi-clk = <384000000>;
	sprd,default-fps = <60>;
	sprd,fb_triple_framebuffer;
	sprd,input-data-type = <32>;
	sprd,light-sleep;
	sprd,pll_type = <2>;
};

This node will describe the DT binding when LCD is using RGB or MCU(Parallel
interface) to communicate with DISPC.
DISPC <-(RGB or MCU)-> LCD

See document [4] for more information about LCD DT node configuration.
[4]: Documentation/devicetree/bindings/video/sprd,panel.txt

&i2c0 {
	...
	lcd0: panel@0x0 {
		compatible = "sprd,lcd-lvds-panel";
		reg = <0x0>;
		vlcdio-supply = <&vdd28>;
		vlcdcore-supply = <&vdd18>;
		port {
			panel_in: endpoint {
			remote-endpoint = <&dispc0_1>;
			};
		};
	};
};
```

## Documentation/devicetree/bindings/video/sprd,sharkl64-dsim.txt
```
DT Binding for Spreadtrum MIPI DSI Master of sharkl64
=====================================================

Required properties:
--------------------
	- compatible: Shall contain "sprd,dsi-21a". /* for Sharkl64 SoCs */
	- reg: physical base address and length of the registers set for the device.
	- interrupts: should contain DSI interrupt.
	- #address-cells: number of cells to encode an address.
	- #size-cells: number of cells representing the size of an address.
	- port: contains a endpoint node which is connected to dispc node.
		#address-cells and #size-cells must 1 and 0, respectively.
	- status: Should be "ok" or "disabled" for enabled/disabled. Default is "disabled".

Child nodes:
------------
Should contain DSI peripheral nodes.

Video interfaces: Device node can contain video interface port nodes.
-----------------
	The following are properties specific to those nodes:

	port node:
		- reg: (required) can be used to select the DSI endpoint node.
		- endpoint node of DSI port.

Example:
--------
SOC specific entries --->>

dsi0: dsi@21800000 {
	compatible = "sprd,dsi-21a";
	reg = <0 0x21800000 0 0x1000>;
	interrupts = <GIC_SPI 48 IRQ_TYPE_NONE>,
		<GIC_SPI 49 IRQ_TYPE_NONE>,
		<GIC_SPI 47 IRQ_TYPE_NONE>;
	#address-cells = <1>;
	#size-cells = <0>;
	status = "disabled";
	ports {
		#address-cells = <1>;
		#size-cells = <0>;
		port@0 {
			reg = <0>;
			dsi0_in: endpoint {
				remote-endpoint = <&dispc0_1>;
			};
		};
	};
};

Board specific DT entry:
 / {
	aliases {
		...
		dsim0 = &dsi0;
	};
}

DSI0 node specify the DT binding if LCD is interfaced with DISPC using DSI serial interface.
	DISPC <--> DSI <--> LCD

&dsi0 {
        status = "okay";
        #address-cells = <1>;
        #size-cells = <0>;
        ports {
                #address-cells = <1>;
                #size-cells = <0>;
                port@1 {
                        reg = <1>;
                        dsi0_out: endpoint {
                                remote-endpoint = <&panel_in>;
                        };
                };
        };

	lcd0: panel@0 {
		compatible	= "sprd,lcd-mipi-panel";

		vlcdio-supply	= <&vdd28>;
		vlcdcore-supply	= <&vdd18>;
		sprd,lcd-panels	= <&lcd_ssd2075_mipi>,<&lcd_hx8394a_mipi>;

		port {
			panel_in: endpoint {
			remote-endpoint = <&dsi0_out>;
			};
		};
	};
};
```

## Documentation/devicetree/bindings/watchdog/sprd-pmic-wdt.txt
```
*Spreadtrum system reboot functionality

Required properties:
- compatible: should be "sprd,sc2723t-wdt".
- reg: Physical offset in PMIC address space

Example node:
	pmic_wdt: watchdog@40 {
		compatible = "sprd,sc2723t-wdt";
		reg = <0x40>;
	};
```

## Documentation/devicetree/bindings/watchdog/sprd-wdt.txt
```
* Spreadtrum's Watchdog Timer Controller

Required Properties:

- compatible : should be one among the following.
	(a) "sprd,shark-wdt" for SC9838 and previous SoCs
	(b) "sprd,whale-wdt" for SC9001 and later Socs
- reg        :  base physical address of the controller and length of memory mapped region.
- interrupts : interrupt number to the cpu.
- sprd,wdt-enable  : reference to syscon node.
- sprd,wdt-phandle : reference to pmic node.

Example:

        sprd_wdt: watchdog@40310000 {
		compatible = "sprd,whale-wdt";
		reg = <0 0x40310000 0 0x1000>;
		interrupts = <GIC_SPI 124 IRQ_TYPE_LEVEL_HIGH>;
		sprd,wdt-enable  = <&aon_apb_controller>;
		sprd,wdt-phandle = <&pmic_wdt>;
	};
```

## Documentation/devicetree/bindings/x86/mobilevisor.txt
```
X86 Mobilevisor Device Tree Bindings

compatible = "intel,mv_irq_wake"
compatible = "intel,mobilevisor"
```

## Documentation/devicetree/bindings/x86/sprd-isoc.txt
```
SPRD iSoC Device Tree Bindings
---------------------------

SoCs
-------------------------------------------

Each device tree must specify which SPRD iSoC it uses, using one of the
following compatible values:

  sprd,sprd-isoc

The CPU node
------------
	cpu@0 {
		device_type = "cpu";
		compatible = "intel,bullhill";
		reg = <0>;
		lapic = <&lapic0>;
	};

The reg property describes the CPU number. The lapic property points to
the local APIC timer.

The SoC node
------------

This node describes the in-core peripherals. Required property:
  compatible = "simple-bus";
```

## Documentation/devicetree/bindings/x86/sprd.txt
```
Spreadtrum i.XXX Platforms Device Tree Bindings

iwhale2 vdk board:
Required root node properties:
  - compatible = "sprd,iwhale2-vdk"

iwhale2 fpga board:
Required root node properties:
  - compatible = "sprd,iwhale2-fpga"

iwhale2 zebu board:
Required root node properties:
  - compatible = "sprd,iwhale2-zebu"
```

## Documentation/devicetree/bindings/x86/timer.txt
```
Timers
------

* High Precision Event Timer (HPET)
  Required property:
     compatible = "intel,x86-hpet";
```

## arch/arm/mach-sprd/Kconfig
```kconfig
config ARCH_SPRD
	bool "Spreadtrum SoC Familes"
	select CPU_V7
	select HAVE_SMP
	select ARM_GIC
	select HAVE_SCHED_CLOCK
	select LOCAL_TIMERS if SMP
	select VFP
	select VFPv3
	select NEON
	select GENERIC_TIME
	select USE_OF
	select CLKSRC_MMIO
	select CLKSRC_OF
	select COMMON_CLK
	select ARCH_HAS_CPUFREQ
	select ARM_HAS_SG_CHAIN
	select HAVE_FUTEX_CMPXCHG if MMU && FUTEX
	select REGMAP
	select MFD_SYSCON
	select CLKSRC_SPRD
	select PINCTRL
	help
	  Surpport Spreadtrum's arm based systems containing the shark, sharkl,
	  tshark, pike series.

menu "Spreadtrum Shark Family"

config SC9830
	bool "Spreadtrum SC9830(SharkL) Soc Support"
	depends on ARCH_SPRD
	help
	  This enables Spreadtrum SC9830 Soc and compatible support.
	  You only need to enable this, if you want to support
	  SC9830 Soc.

config SC9833
	bool "Spreadtrum SC9833(SharkL) Soc Support"
	depends on ARCH_SPRD
	help
	  This enables Spreadtrum SC9830 Soc and compatible support.
	  You only need to enable this, if you want to support
	  SC9833 Soc.

config SOC_PIKE2
	bool "Spreadtrum PIKE2 Soc Support"
	depends on ARCH_SPRD
	help
	  This enables Spreadtrum PIKE2 Soc and compatible support.
	  You only need to enable this, if you want to support
	  PIKE2 Soc.

config SOC_SHARKLE
	bool "Spreadtrum SharklE Soc Support"
	depends on ARCH_SPRD
	help
	  This enables Spreadtrum SharklE(32bits) Soc and compatible support.
	  You only need to enable this, if you want to support
	  SharklE Soc.

config SOC_SHARKL3
	bool "Spreadtrum Sharkl3 Soc Support"
	depends on ARCH_SPRD
	help
	  This enables Spreadtrum Sharkl3(32bits) Soc and compatible support.
	  You only need to enable this, if you want to support Sharkl3 Soc.
endmenu
```

## arch/x86/mobilevisor/Kconfig
```kconfig
if MOBILEVISOR

menu "Mobilevisor feature support"

config MOBILEVISOR_32BIT_WA
        tristate "WA to force 32bit address in VMM api"
        default y
        help
          Hence VMM host is still in 32bit mode, add this
		  WA to force all data pass to VMM are in 32bit address.

endmenu

endif
```

## drivers/clk/sprd/Kconfig
```kconfig
config SPRD_ADS
        bool "avoid disturb solution support"
        default n
        depends on ARCH_SPRD
        ---help---
	  To avoid disturb solution to spreadtrum SoC.
```

## drivers/input/fingerprint/Kconfig
```kconfig
menuconfig INPUT_FINGERPRINT
	bool "Fingerprint"
	help
	  Say Y here, and a list of supported fingerprint(s) will be displayed.
	  This option doesn't affect the kernel.

source "drivers/input/fingerprint/fpsensor/Kconfig"
source "drivers/input/fingerprint/et310_tee/Kconfig"
source "drivers/input/fingerprint/gdspi/Kconfig"
source "drivers/input/fingerprint/silead/Kconfig"
```

## drivers/input/fingerprint/et310_tee/Kconfig
```kconfig
if INPUT_FINGERPRINT
config ET310_FINGERPRINT_TEE
        tristate "Et310 int driver"
        help
          Say Y here to use et310 fingerprint int driver.

          If unsure, say N
endif
```

## drivers/input/fingerprint/gdspi/Kconfig
```kconfig
if INPUT_FINGERPRINT
config GOODIX_FINGERPRINT
	tristate "Goodix Fingerprint"
	default n
	---help---
	Goodix Fingerprint chip TEE driver
endif
```

## drivers/input/touchscreen/zte_touchscreen/Kconfig
```kconfig
#
# zte touchscreen module
#

config ZTE_TOUCHSCREEN
    tristate "ZTE touchscreen driver"
    depends on I2C || SPI_MASTER
    help
      Say Y here to use adaptive touchscreen driver.

if ZTE_TOUCHSCREEN
config TS_FIRMWARE
	string "config board firmware folder"

source "drivers/input/touchscreen/zte_touchscreen/synaptics_2.7/Kconfig"

config TOUCHSCREEN_FTS_V2_2
	bool "Focaltech Touchscreen"
		depends on I2C
		default n
		help
		  Say Y here if you have Focaltech touch panel.
		  If unsure, say N.
if TOUCHSCREEN_FTS_V2_2
source "drivers/input/touchscreen/zte_touchscreen/focaltech_touch_V2_2/Kconfig"
endif
config TOUCHSCREEN_TLSC6X
	bool "Focaltech Touchscreen"
		depends on I2C
		default n
		help
		  Say Y here if you have tlsc6x touch panel.
		  If unsure, say N.

config TOUCHSCREEN_HIMAX_CHIPSET_ONCELL
	bool "Himax touchpanel oncell tp"
	depends on I2C
	help
	  Say Y here if you have a Himax CHIPSET touchscreen.
	  HIMAX controllers are multi touch controllers which can
	  report 10 touches at a time.
	  If unsure, say N.

if TOUCHSCREEN_HIMAX_CHIPSET_ONCELL
source "drivers/input/touchscreen/zte_touchscreen/hxchipset_oncell/Kconfig"
endif

endif
```

## drivers/input/touchscreen/zte_touchscreen/focaltech_touch_V2_2/Kconfig
```kconfig
#
# Focaltech Touchscreen driver configuration
#

config TOUCHSCREEN_FTS_DIRECTORY
	string "Focaltech ts directory name"
	default "focaltech_touch"
	depends on TOUCHSCREEN_FTS_V2_2

config TS_FTS_MTK_INTERFACE
	tristate "Focaltech driver test over Dragon Board"
	depends on TOUCHSCREEN_FTS_V2_2
	help
	  This enables support for Focaltech driver in MTK platform.
```

## drivers/media/gsp/Kconfig
```kconfig
config SPRD_GSP
	bool "SPRD GSP driver"
	depends on ARCH_SPRD
	depends on (ION_SPRD_STAGING || ION_SPRD)
	depends on SYNC
	depends on SPRD_IOMMU
	---help---
	  GSP is hardware which not only can compose multiple layers
	  but also can transform and scale layers.
```
