## drivers/media/radio/sprd2331/Kconfig
```kconfig
#
# Spreadtrum SC2331 FM drivers
#
config RADIO_SC2331
	depends on SDIODEV
	tristate "Spreadtrum SC2331 FM Support"
	---help---
	Say Y to enable built-in FM controller in the
	Spreadtrum SC2331 based System-on-Chip devices.
	To compile this driver as a module, choose M here.
	If unsure say Y.
```

## drivers/misc/dual-sim-plug/Kconfig
```kconfig
config MISC_DUAL_SIM_PLUG
   bool "Sprd Dual sim plug driver"
   default n
   depends on SPRD_SIPC
   help
     This driver supports the Spreadtrum dual sim plug.
     Say Y here if you want to use it.
     It depends on sipc.
     But it is in driver/misc.
```

## drivers/misc/gpsip/Kconfig
```kconfig
config CGX
	bool "Sprd gps"
	default n
	help
	  GPS can locate you position

config CGX_DRIVER
	tristate "Sprd gps driver"
	depends on CGX
	help
	  GPS can locate you position

config CGX_VIRTUALCOM
	tristate "Sprd gps virtual com"
	depends on CGX
	help
	  GPS can locate you position

config CGX_GE_GPS
	tristate "Sprd greeneye gps use spi interface"
	depends on CGX
	help
	  GPS can locate you position

config CGX_DMA_IRQ_MODE
	bool "Force DMA irq mode instead of linked list mode"
	depends on CGX
	default n
	help
	  GPS can locate you position
```

## drivers/misc/ir-peel/Kconfig
```kconfig
config SPI_PEEL_INFRARED
	tristate "peer SPI device driver support"
	default n
	depends on SPI_MASTER
	help
	  This supports peer SPI protocol drivers.
	  Note that this application programming interface is EXPERIMENTAL
	  and hence SUBJECT TO CHANGE WITHOUT NOTICE while it stabilizes.
```

## drivers/misc/mcdt/Kconfig
```kconfig
config SPRD_MCDT
	bool "Spreadtrum MCDT support"
	depends on ARCH_SPRD
	help
	  MCDT(Multi-Channel Data Transfer) is a Hardware module
	  that can be used to transfer data between AP and DSP,
	  normally we use it transfer audio data.
	  Say Y if your platform supports hardware MCDT.
```

## drivers/misc/sprd_audio/Kconfig
```kconfig
menu "Spreadtrum Audio Assistant Modules"
config SPRD_AUDIO_AGDSP_ACCESS
	tristate "Sprd audio agdsp access"
	depends on SND_SOC_SPRD
	help
	  This module is used to enable the access of agdsp registers.
	  If r3p0 vbc is used, this must be set to Y.

config SPRD_AUDIO_MEMORY_MANAGER
	tristate "Sprd audio memory manager"
	depends on SND_SOC_SPRD
	help
	  This module is used to manager memories that needed by offlad play(mp3 play),
	  music data buffer used by dma, audio sipc and share memory.
	  If r3p0 vbc is used, this must be set to Y.

config SPRD_AUDIO_DSP_DUMP
	tristate "Sprd audio dsp dump"
	depends on SPRD_AUDIO_MEMORY_MANAGER
	help
	  This module is used to dump dsp log, memory and pcm data.

config SPRD_AUDIO_SIPC
	tristate "Sprd audio sipc"
	depends on SPRD_MAILBOX && SPRD_AUDIO_MEMORY_MANAGER
	help
	  This module is used to communication with other processor(e.g. agdsp).
	  If r3p0 vbc is used, this must be set to Y.

config SPRD_AUDIO_SAUDIO
	tristate "Sprd saudio driver in call mode based on sipc"
	depends on SPRD_SIPC && SND_SOC
	default N
	help
	  Say Y if you want to built in to kernel, Say M for ko module.
	  SAudio is a bridge to connect AP and CP system.
endmenu
```

## drivers/misc/sprd_camera/cam_sl5_roc1/Kconfig
```kconfig
config SPRD_CAMERA_CAM_SL5_ROC1
    bool "Spreadtrum Camera SharkL5 & ROC1"
    depends on SPRD_CAMERA
    help
        This is camera driver for Spreadtrum SOC SharkL5 & ROC1.
        Include submodule dcam_if_lite r1p0, isp r8p1, facedector
```
