/ { lcds {
	lcd_ft8006m_haifei_mipi_hd: lcd8006@8006 {

		work-mode = <1>;
		bpp = <24>;
		lane-number = <4>;

		need-check-esd = <0>;
		esd-timeout = <1000>;

		fps = <60>;
		width-mm = <68>;
		height-mm = <121>;
		panel-name = "lcd_ft8006m_mipi_hd";

		power-on-sequence = <
					50 1 5
					50 0 5
					50 1 20
					>;
		power-off-sequence = <
					50 0 20
					>;

		init-data = [
			39 00 00 03 50 5A 08
			39 00 00 03 80 C8 00
			39 00 00 03 50 5A 09
			39 00 00 11 80 5A 51 B5 2A 6C A5 4A 01 40 E0 0D 82 20 08 30 4B
			39 00 00 11 90 00 00 42 0A E3 25 9B 70 A5 B5 67 20 41 A1 26 00
			39 00 00 07 A0 A1 80 08 20 06 00
			39 00 00 03 50 5A 0A
			39 00 00 11 80 51 A3 02 00 18 2E 3F 56 69 6E A0 8B BE 7F 51 85
			39 00 00 11 90 59 55 44 33 1E 16 0F 00 18 2E 3F 56 69 6E A0 8B
			39 00 00 11 A0 BE 7F 51 85 59 55 44 33 1E 16 0F 00
			39 00 00 03 50 5A 0B
			39 00 00 11 80 00 00 20 44 08 00 60 47 00 00 10 22 04 00 B0 23
			39 00 00 03 90 15 00
			39 00 00 03 50 5A 0C
			39 00 00 11 80 FA 68 68 01 28 69 00 04 00 60 15 00 50 15 56 51
			39 00 00 11 90 15 55 61 15 00 60 15 00 50 15 56 51 15 55 61 95
			39 00 00 11 A0 AB 18 00 05 00 05 00 05 80 4C 29 84 52 01 09 00
			39 00 00 03 50 5A 0D
			39 00 00 0f 80 F0 B1 71 EF 49 C0 80 1A 00 00 00 00 00 00
			39 00 00 03 50 5A 0E
			39 00 00 0d 80 FF 81 68 6C 22 6D 24 00 00 00 00 00
			39 00 00 03 50 5A 0F
			39 00 00 11 80 97 C4 58 00 19 60 64 10 53 33 C8 50 01 82 8C 8C
			39 00 00 08 90 24 69 81 71 44 7C 14
			39 00 00 03 50 5A 10
			39 00 00 11 80 00 80 03 E7 1F 17 20 48 00 52 CD 18 30 88 41 8A
			39 00 00 0f 90 39 28 A9 C5 9A 7B F0 07 7E E0 07 7E 20 10 00
			39 00 00 03 50 5A 11
			39 00 00 11 80 46 77 03 40 CA F3 FF 83 30 08 C4 06 A1 D8 24 18
			39 00 00 11 90 30 C6 66 C1 80 31 15 CB E5 D2 68 6C 36 1D 04 C8
			39 00 00 11 A0 B0 D9 88 60 B0 81 40 1A 1B 48 63 03 B9 00 1C 80
			39 00 00 11 B0 50 30 00 E0 E1 01 00 28 0E 06 43 55 55 55 55 55
			39 00 00 11 C0 95 88 88 88 88 88 C8 08 86 C6 E3 81 00 20 00 21
			39 00 00 11 D0 42 88 00 00 00 00 40 00 00 31 04 41 06 00 00 00
			39 00 00 11 E0 00 92 24 49 92 04 00 00 00 00 92 04 00 85 11 0C
			39 00 00 0a F0 00 00 40 00 00 00 00 5E 00
			39 00 00 03 50 5A 12
			39 00 00 11 80 00 00 00 00 00 00 00 00 00 00 00 00 00 00 00 00
			39 00 00 0a 90 00 00 00 00 00 00 00 00 00
			39 00 00 03 50 5A 13
			39 00 00 11 80 01 00 00 0C 00 00 00 00 01 00 01 1C 44 0C CE E7
			39 00 00 04 90 62 0E 00
			39 00 00 03 50 5A 14
			39 00 00 11 80 51 01 40 5E E9 EF F7 FB FD 7E 01 00 00 40 C5 05
			39 00 00 11 90 6A 3E 60 03 D4 33 02 00 00 00 00 00 00 00 00 00
			39 00 00 11 A0 00 00 00 00 00 00 00 00 00 00 00 00 00 00 00 00
			39 00 00 11 B0 00 00 00 00 00 00 10 00 00 FC A8 83 1A 00 40 A1
			39 00 00 11 C0 50 78 07 A8 F9 80 73 00 2F 00 35 1F 70 0E E0 25
			39 00 00 11 D0 A0 E6 03 CE 01 BC 08 D4 7C C0 39 00 00 00 00 00
			39 00 00 11 E0 00 00 00 00 00 00 00 00 00 00 00 00 00 00 00 00
			39 00 00 11 F0 00 00 00 00 00 00 00 00 00 00 00 00 00 00 00 00
			39 00 00 03 50 5A 15
			39 00 00 11 80 00 00 00 00 00 00 00 00 00 00 00 00 00 00 00 00
			39 00 00 11 90 00 00 81 62 C4 A8 D5 86 D0 6A 1D 31 6A B5 21 B4
			39 00 00 11 A0 5A 00 00 00 00 00 00 00 00 00 00 00 00 00 00 00
			39 00 00 11 B0 00 00 00 00 00 00 00 00 13 00 F0 00 94 A9 55 D7
			39 00 00 11 C0 B5 6D DB F6 28 DA 76 08 A2 B6 6D DB B6 85 DA 55
			39 00 00 11 D0 5D DB B6 6D 01 A1 6D 09 43 6A DB B6 6D 5B A9 55
			39 00 00 11 E0 D7 B5 6D DB D6 20 DA 56 00 A0 B6 6D DB B6 8D DA
			39 00 00 11 F0 55 5D DB B6 6D 83 A1 6D 8B 63 6A DB B6 6D 5B 00
			39 00 00 03 50 5A 16
			39 00 00 11 80 00 00 00 00 00 00 00 00 00 00 00 00 00 00 00 00
			39 00 00 07 90 00 00 00 00 D0 40
			39 00 00 03 50 5A 18
			39 00 00 11 80 EF BD F7 DE 7B EF BD 07 08 08 0A 0C 0C 0C 0C 0C
			39 00 00 11 90 0C 0C 0C 5C 09 A8 AA AA AA AA AA AA AA AA AA 5A
			39 00 00 11 A0 59 59 59 59 59 59 59 59 59 59 59 09 04 FF 05 80
			39 00 00 0f B0 80 00 04 20 00 01 08 40 00 02 10 80 00 04 0F
			39 00 00 03 50 5A 19
			39 00 00 11 80 F0 D9 C8 BA AF A6 9E 98 92 8D 88 84 00 F0 6F F6
			39 00 00 11 90 CF FC 6F F6 FE FC 0A FF AF B5 71 0E 6C 4A 69 08
			39 00 00 08 A0 00 00 00 00 00 00 00
			39 00 00 03 50 5A 1B
			39 00 00 11 80 A0 A8 B0 B8 00 C0 C8 D0 D8 00 E0 E8 F0 F8 00 FC
			39 00 00 05 90 FE FF 00 00
			39 00 00 03 50 5A 20
			39 00 00 08 80 8C 00 00 00 00 00 00
			39 00 00 03 50 5A 22
			39 00 00 0e 80 AD D4 00 41 55 55 55 55 55 55 55 1F 00
			39 00 00 03 50 5A 23
			39 00 00 11 80 01 05 00 05 00 00 00 00 00 00 00 00 00 00 00 00
			39 00 00 0a 90 FF 0F 00 00 00 00 00 00 00
			39 00 00 03 50 5A 24
			39 00 00 11 80 00 03 00 9D BF 10 00 00 00 00 00 00 00 00 F1 1C
			23 00 00 02 90 5A
			23 00 00 02 90 A5
			39 00 00 03 50 5A 2F
			23 00 00 02 09 01
			39 00 00 03 50 5A 0A
			//#Gamma+
			39 00 00 15 83 00 25 39 50 64 77 7d ad a2 d1 6e 42 80 58 55 45 35 22 0d 00
			//#Gamma-
			39 00 00 15 97 00 25 39 50 64 77 7d ad a2 d1 6e 42 80 58 55 45 35 22 0d 00
			23 00 00 02 AB 00
			23 78 00 02 11 00
			23 14 00 02 29 00
			];
		sleep-in = [
			13 0A 00 01 28
			13 78 00 01 10
			];
		sleep-out = [
			13 78 00 01 11
			13 64 00 01 29
			];

		display-timings {
			clock-frequency = <500000>;
			hactive = <720>;
			vactive = <1280>;
			hback-porch = <25>;
			hfront-porch = <45>;
			vback-porch = <25>;
			vfront-porch = <195>;
			hsync-len = <14>;
			vsync-len = <8>;
		};
	};
};};

