/ { lcds {
	lcd_gc9306_spi_qvga: lcd9306@9306 {

		panel-name = "lcd_gc9306_spi_qvga";
		if-type = <4>;
		spi_bus_num = <1>;
		spi_cs = <0>;
		bpp = <16>;
		fps = <33>;
		spi_mode = <3>; /* SPI_CPHA 0x01 SPI_CPOL 0x02 */
		spi_cd_gpio = <138>;
		spi_te_gpio = <51>;
		spi_pol_mode = <0>;
		spi_endian = <0>;
		spi_freq = <48000000>;
		hactive = <240>;
		vactive = <320>;

		power-on-sequence = <
					50  1  5
					50  0  5
					50  1  20
					>;
		power-off-sequence = <
					50  0  20
					>;

		init-data = [
			ff  00  00  01  fe
			ff  00  00  01  ef
			ff  00  00  02  35  00
			ff  00  00  03  44  00	50
			ff  00  00  02  36  48
			ff  00  00  02  3a  05
			ff  00  00  03  a4  44  44
			ff  00  00  03  a5  42  42
			ff  00  00  03  aa  88  88
			ff  00  00  03  e8  13  70
			ff  00  00  03  e3  01  18
			ff  00  00  03  e1  10  0a
			ff  00  00  02  ac  00
			ff  00  00  02  af  67
			ff  00  00  03  a6  29  29
			ff  00  00  03  a7  27  27
			ff  00  00  03  a8  17  17
			ff  00  00  03  a9  26  26
			ff  00  00  07  f0  02  01  00  0a  10  11
			ff  00  00  07  f1  01  02  00  14  1c  09
			ff  00  00  07  f2  12  09  40  03  03  50
			ff  00  00  07  f3  0b  09  3e  03  04  4b
			ff  00  00  07  f4  0c  1a  1a  22  22  0f
			ff  00  00  07  f5  0b  17  15  18  19  0f
			ff  78  00  01  11
			ff  20  00  01  29
			ff  00  00  01  2c
			];
		sleep-in = [
			ff 78 00 01 28
			ff 78 00 01 10
			];
		sleep-out = [
			ff 78 00 01 11
			ff 64 00 01 29
			];
	};
};};

