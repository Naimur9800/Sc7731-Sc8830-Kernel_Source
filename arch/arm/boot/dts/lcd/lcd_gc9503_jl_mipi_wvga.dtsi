/ { lcds {
	lcd_gc9503_jl_mipi_wvga: lcd9503@9503 {

		work-mode = <1>;
		bpp = <24>;
		lane-number = <2>;

		need-check-esd = <0>;
		esd-timeout = <1000>;

		fps = <60>;
		width-mm = <68>;
		height-mm = <121>;
		panel-name = "lcd_gc9503_jl_mipi_wvga";

		power-on-sequence = <
					50  1  5
					50  0  5
					50  1  20
					>;
		power-off-sequence = <
					50  0  20
					>;

		init-data = [
			 39 00 00 06 F0 55 AA 52 08 00
			 39 00 00 03 F6 5A 87
			 23 00 00 02 c1 3f
			 23 00 00 02 C2 0E
			 23 00 00 02 C6 F8
			 39 00 00 04 FA 0F 0F 00
			 23 00 00 02 71 48
			 23 00 00 02 72 48
			 39 00 00 03 73 00 44
			 23 00 00 02 A3 EE
			 39 00 00 04 FD 28 28 00
			 23 00 00 02 97 EE
			 23 00 00 02 83 93
			 23 00 00 02 9A 9A
			 23 00 00 02 9B AD
			 39 00 00 03 82 7B 7B
			 23 00 00 02 B1 10
			 39 00 00 03 7A 13 1A
			 39 00 00 03 7B 13 1A
			 39 00 00 21 6D 1E 10 0E 0C 0A 1E 02 1E 19 1E 1A 1E 1E 1E 1E 1E 1E 1E 1E 1E 1E 1A 1E 19 1E 01 1E 09 0B 0D 0F 1E
			 39 00 00 11 64 18 06 03 21 70 03 18 05 03 22 70 03 10 73 10 73
			 39 00 00 11 65 18 04 03 23 70 03 18 03 03 24 70 03 10 73 10 73
			 39 00 00 11 66 18 02 03 25 70 03 18 01 03 26 70 03 10 73 10 73
			 39 00 00 11 67 18 00 03 27 70 03 10 01 03 28 70 03 10 73 10 73
			 39 00 00 0e 68 00 08 0A 08 09 00 00 08 0A 08 09 00 00
			 39 00 00 09 60 18 08 10 73 18 07 10 73
			 39 00 00 09 61 18 00 68 68 18 00 68 68
			 39 00 00 09 62 18 00 68 68 18 00 68 68
			 39 00 00 09 63 18 00 68 68 18 08 10 73
			 39 00 00 09 6A 08 0D 88 0A 01 23 45 67
			 39 00 00 08 69 14 22 14 22 14 22 08
			 23 00 00 02 6B A7
			 39 00 00 35 D1 00 00 00 03 00 1A 00 31 00 45 00 82 00 C0 01 07 01 3D 01 8F 01 C5 02 1D 02 58 02 5A 02 91 02 C8 02 E7 03 0C 03 22 03 3F 03 55 03 75 03 80 03 95 03 C2 03 FF
			 39 00 00 35 D2 00 00 00 03 00 1A 00 31 00 45 00 82 00 C0 01 07 01 3D 01 8F 01 C5 02 1D 02 58 02 5A 02 91 02 C8 02 E7 03 0C 03 22 03 3F 03 55 03 75 03 80 03 95 03 C2 03 FF
			 39 00 00 35 D3 00 00 00 03 00 1A 00 31 00 45 00 82 00 C0 01 07 01 3D 01 8F 01 C5 02 1D 02 58 02 5A 02 91 02 C8 02 E7 03 0C 03 22 03 3F 03 55 03 75 03 80 03 95 03 C2 03 FF
			 39 00 00 35 D4 00 00 00 03 00 1A 00 31 00 45 00 82 00 C0 01 07 01 3D 01 8F 01 C5 02 1D 02 58 02 5A 02 91 02 C8 02 E7 03 0C 03 22 03 3F 03 55 03 75 03 80 03 95 03 C2 03 FF
			 39 00 00 35 D5 00 00 00 03 00 1A 00 31 00 45 00 82 00 C0 01 07 01 3D 01 8F 01 C5 02 1D 02 58 02 5A 02 91 02 C8 02 E7 03 0C 03 22 03 3F 03 55 03 75 03 80 03 95 03 C2 03 FF
			 39 00 00 35 D6 00 00 00 03 00 1A 00 31 00 45 00 82 00 C0 01 07 01 3D 01 8F 01 C5 02 1D 02 58 02 5A 02 91 02 C8 02 E7 03 0C 03 22 03 3F 03 55 03 75 03 80 03 95 03 C2 03 FF
			 23 78 00 02 11 00
			 23 64 00 02 29 00
			];
		sleep-in = [
			13 0A 00 01 28
			13 78 00 01 10
			];
		sleep-out = [
			13 78 00 01 11
			13 64 00 01 29
			];

		display-timings {
			clock-frequency = <480000>;
			hactive = <480>;
			vactive = <800>;
			hback-porch = <20>;
			hfront-porch = <20>;
			vback-porch = <12>;
			vfront-porch = <14>;
			hsync-len = <12>;
			vsync-len = <8>;
		};
	};
};};

