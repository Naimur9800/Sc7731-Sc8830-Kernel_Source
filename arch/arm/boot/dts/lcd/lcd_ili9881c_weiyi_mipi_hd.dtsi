/ { lcds {
	lcd_ili9881c_weiyi_mipi_hd: lcd988101@988101 {

		work-mode = <1>;
		bpp = <24>;
		lane-number = <4>;

		need-check-esd = <1>;
		esd-timeout = <1000>;
		esd-check-reg = <0x0A>;
		esd-return-code = <0x9C>;

		fps = <60>;
		width-mm = <68>;
		height-mm = <121>;
		panel-name = "lcd_ili9881c_mipi_hd";

		power-on-sequence = <
					50  1  5
					50  0  5
					50  1  20
					>;
		power-off-sequence = <
					50  0  20
					>;

		init-data = [
			39 00 00 04 FF 98 81 03
			23 00 00 02 01 00
			23 00 00 02 02 00
			23 00 00 02 03 53
			23 00 00 02 04 14
			23 00 00 02 05 00
			23 00 00 02 06 06
			23 00 00 02 07 01
			23 00 00 02 08 00
			23 00 00 02 09 01
			23 00 00 02 0a 19
			23 00 00 02 0b 01
			23 00 00 02 0c 00
			23 00 00 02 0d 00
			23 00 00 02 0e 00
			23 00 00 02 0f 19
			23 00 00 02 10 19
			23 00 00 02 11 00
			23 00 00 02 12 00
			23 00 00 02 13 00
			23 00 00 02 14 00
			23 00 00 02 15 00
			23 00 00 02 16 00
			23 00 00 02 17 00
			23 00 00 02 18 00
			23 00 00 02 19 00
			23 00 00 02 1a 00
			23 00 00 02 1b 00
			23 00 00 02 1c 00
			23 00 00 02 1d 00
			23 00 00 02 1e 40
			23 00 00 02 1f 40
			23 00 00 02 20 02
			23 00 00 02 21 05
			23 00 00 02 22 02
			23 00 00 02 23 00
			23 00 00 02 24 87
			23 00 00 02 25 87
			23 00 00 02 26 00
			23 00 00 02 27 00
			23 00 00 02 28 3B
			23 00 00 02 29 03
			23 00 00 02 2a 00
			23 00 00 02 2b 00
			23 00 00 02 2c 00
			23 00 00 02 2d 00
			23 00 00 02 2e 00
			23 00 00 02 2f 00
			23 00 00 02 30 00
			23 00 00 02 31 00
			23 00 00 02 32 00
			23 00 00 02 33 00
			23 00 00 02 34 04
			23 00 00 02 35 00
			23 00 00 02 36 00
			23 00 00 02 37 00
			23 00 00 02 38 01
			23 00 00 02 39 01
			23 00 00 02 3a 40
			23 00 00 02 3b 40
			23 00 00 02 3c 00
			23 00 00 02 3d 00
			23 00 00 02 3e 00
			23 00 00 02 3f 00
			23 00 00 02 40 00
			23 00 00 02 41 88
			23 00 00 02 42 00
			23 00 00 02 43 00
			23 00 00 02 44 00
			23 00 00 02 50 01
			23 00 00 02 51 23
			23 00 00 02 52 45
			23 00 00 02 53 67
			23 00 00 02 54 89
			23 00 00 02 55 ab
			23 00 00 02 56 01
			23 00 00 02 57 23
			23 00 00 02 58 45
			23 00 00 02 59 67
			23 00 00 02 5a 89
			23 00 00 02 5b ab
			23 00 00 02 5c cd
			23 00 00 02 5d ef
			23 00 00 02 5e 11
			23 00 00 02 5f 06
			23 00 00 02 60 0C
			23 00 00 02 61 0D
			23 00 00 02 62 0E
			23 00 00 02 63 0F
			23 00 00 02 64 02
			23 00 00 02 65 02
			23 00 00 02 66 02
			23 00 00 02 67 02
			23 00 00 02 68 02
			23 00 00 02 69 02
			23 00 00 02 6a 02
			23 00 00 02 6b 02
			23 00 00 02 6c 02
			23 00 00 02 6d 02
			23 00 00 02 6e 05
			23 00 00 02 6f 05
			23 00 00 02 70 05
			23 00 00 02 71 02
			23 00 00 02 72 01
			23 00 00 02 73 00
			23 00 00 02 74 08
			23 00 00 02 75 08
			23 00 00 02 76 0C
			23 00 00 02 77 0D
			23 00 00 02 78 0E
			23 00 00 02 79 0F
			23 00 00 02 7a 02
			23 00 00 02 7b 02
			23 00 00 02 7c 02
			23 00 00 02 7d 02
			23 00 00 02 7e 02
			23 00 00 02 7f 02
			23 00 00 02 80 02
			23 00 00 02 81 02
			23 00 00 02 82 02
			23 00 00 02 83 02
			23 00 00 02 84 05
			23 00 00 02 85 05
			23 00 00 02 86 05
			23 00 00 02 87 02
			23 00 00 02 88 01
			23 00 00 02 89 00
			23 00 00 02 8A 06
			39 00 00 04 FF 98 81 04
			23 00 00 02 6C 15
			23 00 00 02 6E 2B
			23 00 00 02 6F 33
			23 00 00 02 3A A4
			23 00 00 02 8D 15
			23 00 00 02 87 BA
			23 00 00 02 26 76
			23 00 00 02 B2 D1
			39 00 00 04 FF 98 81 01
			23 00 00 02 22 0A
			//23 00 00 02 53 92
			23 00 00 02 55 A5
			23 00 00 02 50 A6
			23 00 00 02 51 9E
			23 00 00 02 31 00
			23 00 00 02 60 14
			23 00 00 02 A0 0F
			23 00 00 02 A1 17
			23 00 00 02 A2 28
			23 00 00 02 A3 11
			23 00 00 02 A4 16
			23 00 00 02 A5 2B
			23 00 00 02 A6 1E
			23 00 00 02 A7 1F
			23 00 00 02 A8 8B
			23 00 00 02 A9 1A
			23 00 00 02 AA 27
			23 00 00 02 AB 82
			23 00 00 02 AC 1B
			23 00 00 02 AD 1C
			23 00 00 02 AE 4E
			23 00 00 02 AF 22
			23 00 00 02 B0 28
			23 00 00 02 B1 4D
			23 00 00 02 B2 58
			23 00 00 02 B3 3F
			23 00 00 02 C0 01
			23 00 00 02 C1 2D
			23 00 00 02 C2 3C
			23 00 00 02 C3 18
			23 00 00 02 C4 18
			23 00 00 02 C5 27
			23 00 00 02 C6 1C
			23 00 00 02 C7 1D
			23 00 00 02 C8 A6
			23 00 00 02 C9 1C
			23 00 00 02 CA 2A
			23 00 00 02 CB 98
			23 00 00 02 CC 1E
			23 00 00 02 CD 1D
			23 00 00 02 CE 51
			23 00 00 02 CF 25
			23 00 00 02 D0 2C
			23 00 00 02 D1 5F
			23 00 00 02 D2 76
			23 00 00 02 D3 3F
			39 00 00 04 FF 98 81 00
			23 00 00 02 35 00
			23 78 00 02 11 00
			23 14 00 02 29 00

				];
		sleep-in = [
			13 0A 00 01 28
			13 78 00 01 10
			];
		sleep-out = [
			13 78 00 01 11
			13 64 00 01 29
			];

		display-timings {
			clock-frequency = <500000>;
			hactive = <720>;
			vactive = <1280>;
			hback-porch = <50>;
			hfront-porch = <30>;
			vback-porch = <16>;
			vfront-porch = <18>;
			hsync-len = <10>;
			vsync-len = <6>;
		};
	};
};};

