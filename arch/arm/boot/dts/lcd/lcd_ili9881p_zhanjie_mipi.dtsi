/ { lcds {
	lcd_ili9881p_zhanjie_mipi: lcd988103@988103 {

		work-mode = <1>;
		bpp = <24>;
		lane-number = <4>;

		need-check-esd = <3>;
		esd-timeout = <1000>;

		fps = <60>;
		width-mm = <68>;
		height-mm = <121>;
		panel-name = "lcd_ili9881p_zhenjie_mipi_hd";

		power-on-sequence = <
					50 1 5
					50 0 5
					50 1 20
					>;
		power-off-sequence = <
					50 0 20
					>;

		init-data = [

			39 00 00 04 FF 98 81 01
			23 00 00 02 44 31

			39 00 00 04 FF 98 81 05
			23 00 00 02 B2 70
			23 00 00 02 04 28
			23 00 00 02 30 F7
			23 00 00 02 29 00
			23 00 00 02 2A 14
			23 00 00 02 38 A8
			23 00 00 02 1A 50
			23 00 00 02 52 5F
			23 00 00 02 54 28
			23 00 00 02 55 25

			23 00 00 02 26 02
			23 00 00 02 3D A1
			23 00 00 02 1B 01

			39 00 00 04 FF 98 81 02
			23 00 00 02 42 2F
			23 00 00 02 01 50
			23 00 00 02 15 10

			23 00 00 02 57 00
			23 00 00 02 58 16
			23 00 00 02 59 25
			23 00 00 02 5A 13
			23 00 00 02 5B 16
			23 00 00 02 5C 29
			23 00 00 02 5D 1D
			23 00 00 02 5E 1F
			23 00 00 02 5F 85
			23 00 00 02 60 1E
			23 00 00 02 61 2A
			23 00 00 02 62 72
			23 00 00 02 63 19
			23 00 00 02 64 16
			23 00 00 02 65 4A
			23 00 00 02 66 21
			23 00 00 02 67 28
			23 00 00 02 68 4F
			23 00 00 02 69 5D
			23 00 00 02 6A 25

			23 00 00 02 6B 00
			23 00 00 02 6C 16
			23 00 00 02 6D 25
			23 00 00 02 6E 13
			23 00 00 02 6F 16
			23 00 00 02 70 29
			23 00 00 02 71 1D
			23 00 00 02 72 1F
			23 00 00 02 73 85
			23 00 00 02 74 1E
			23 00 00 02 75 2A
			23 00 00 02 76 72
			23 00 00 02 77 19
			23 00 00 02 78 16
			23 00 00 02 79 4A
			23 00 00 02 7A 21
			23 00 00 02 7B 28
			23 00 00 02 7C 4F
			23 00 00 02 7D 5D
			23 00 00 02 7E 25

			39 00 00 04 FF 98 81 06
			23 00 00 02 01 03
			23 00 00 02 2B 0A

			39 00 00 04 FF 98 81 00
			23 00 00 02 35 00
			23 78 00 02 11 00
			23 14 00 02 29 00

			];
		sleep-in = [
			13 1E 00 01 28
			13 78 00 01 10
			];
		sleep-out = [
			13 78 00 01 11
			13 64 00 01 29
			];

		display-timings {
			clock-frequency = <464000>;
			hactive = <720>;
			vactive = <1280>;
			hback-porch = <40>;
			hfront-porch = <60>;
			vback-porch = <16>;
			vfront-porch = <18>;
			hsync-len = <10>;
			vsync-len = <6>;
		};
	};
};};

