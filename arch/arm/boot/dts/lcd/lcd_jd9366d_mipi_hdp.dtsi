/ { lcds {
	lcd_jd9366d_mipi_hdp: lcd9366@9366 {

		work-mode = <1>;
		bpp = <24>;
		lane-number = <4>;

		need-check-esd = <3>;
		esd-timeout = <2000>;

		fps = <60>;
		width-mm = <68>;
		height-mm = <121>;
		panel-name = "lcd_jd9366d_mipi_hdp";

		power-on-sequence = <
			50  1  5
			50  0  10
			50  1  50
			>;
		power-off-sequence = <
			50  1  5
			>;

		init-data = [
			23 00 00 02 E0 00
			23 00 00 02 E1 93
			23 00 00 02 E2 66
			23 00 00 02 E3 F9
			23 00 00 02 80 03
			23 00 00 02 E0 01
			23 00 00 02 0A 08
			23 00 00 02 13 00
			23 00 00 02 14 99
			23 00 00 02 15 51
			23 00 00 02 16 51
			23 00 00 02 17 00
			23 00 00 02 18 A4
			23 00 00 02 19 00
			23 00 00 02 1A 00
			23 00 00 02 1B A4
			23 00 00 02 1C 00
			23 00 00 02 1F 2F
			23 00 00 02 20 2D
			23 00 00 02 21 19
			23 00 00 02 22 0D
			23 00 00 02 23 02
			23 00 00 02 24 FE
			23 00 00 02 26 DD
			23 00 00 02 35 13
			23 00 00 02 37 09
			23 00 00 02 38 04
			23 00 00 02 39 01
			23 00 00 02 3A 03
			23 00 00 02 3C 60
			23 00 00 02 3D FF
			23 00 00 02 3E FF
			23 00 00 02 3F FF
			23 00 00 02 4B 04
			23 00 00 02 40 04
			23 00 00 02 41 B4
			23 00 00 02 42 70
			23 00 00 02 43 24
			23 00 00 02 44 0C
			23 00 00 02 45 64
			23 00 00 02 55 05
			23 00 00 02 56 01
			23 00 00 02 57 6D
			23 00 00 02 58 0A
			23 00 00 02 59 8A
			23 00 00 02 5A 28
			23 00 00 02 5B 23
			23 00 00 02 5C 15
			23 00 00 02 5D 75
			23 00 00 02 5E 61
			23 00 00 02 5F 53
			23 00 00 02 60 47
			23 00 00 02 61 43
			23 00 00 02 62 34
			23 00 00 02 63 39
			23 00 00 02 64 22
			23 00 00 02 65 3B
			23 00 00 02 66 3A
			23 00 00 02 67 3B
			23 00 00 02 68 5C
			23 00 00 02 69 4D
			23 00 00 02 6A 57
			23 00 00 02 6B 4B
			23 00 00 02 6C 4B
			23 00 00 02 6D 3E
			23 00 00 02 6E 2E
			23 00 00 02 6F 1A
			23 00 00 02 70 75
			23 00 00 02 71 61
			23 00 00 02 72 53
			23 00 00 02 73 47
			23 00 00 02 74 43
			23 00 00 02 75 34
			23 00 00 02 76 39
			23 00 00 02 77 22
			23 00 00 02 78 3B
			23 00 00 02 79 3A
			23 00 00 02 7A 3B
			23 00 00 02 7B 5C
			23 00 00 02 7C 4D
			23 00 00 02 7D 57
			23 00 00 02 7E 4B
			23 00 00 02 7F 4B
			23 00 00 02 80 3E
			23 00 00 02 81 2E
			23 00 00 02 82 1A

			23 00 00 02 E0 02

			23 00 00 02 00 5D
			23 00 00 02 01 51
			23 00 00 02 02 5D
			23 00 00 02 03 5D
			23 00 00 02 04 5E
			23 00 00 02 05 5F
			23 00 00 02 06 51
			23 00 00 02 07 41
			23 00 00 02 08 45
			23 00 00 02 09 5D
			23 00 00 02 0A 5D
			23 00 00 02 0B 4B
			23 00 00 02 0C 49
			23 00 00 02 0D 5D
			23 00 00 02 0E 5D
			23 00 00 02 0F 47
			23 00 00 02 10 5F
			23 00 00 02 11 5D
			23 00 00 02 12 5D
			23 00 00 02 13 5D
			23 00 00 02 14 5D
			23 00 00 02 15 5D
			23 00 00 02 16 5D
			23 00 00 02 17 50
			23 00 00 02 18 5D
			23 00 00 02 19 5D
			23 00 00 02 1A 5E
			23 00 00 02 1B 5F
			23 00 00 02 1C 50
			23 00 00 02 1D 40
			23 00 00 02 1E 44
			23 00 00 02 1F 5D
			23 00 00 02 20 5D
			23 00 00 02 21 4A
			23 00 00 02 22 48
			23 00 00 02 23 5D
			23 00 00 02 24 5D
			23 00 00 02 25 46
			23 00 00 02 26 5F
			23 00 00 02 27 5D
			23 00 00 02 28 5D
			23 00 00 02 29 5D
			23 00 00 02 2A 5D
			23 00 00 02 2B 5D
			23 00 00 02 2C 1D
			23 00 00 02 2D 10
			23 00 00 02 2E 1D
			23 00 00 02 2F 1D
			23 00 00 02 30 1F
			23 00 00 02 31 1E
			23 00 00 02 32 00
			23 00 00 02 33 10
			23 00 00 02 34 06
			23 00 00 02 35 1D
			23 00 00 02 36 1D
			23 00 00 02 37 08
			23 00 00 02 38 0A
			23 00 00 02 39 1D
			23 00 00 02 3A 1D
			23 00 00 02 3B 04
			23 00 00 02 3C 1F
			23 00 00 02 3D 1D
			23 00 00 02 3E 1D
			23 00 00 02 3F 1D
			23 00 00 02 40 1D
			23 00 00 02 41 1D
			23 00 00 02 42 1D
			23 00 00 02 43 11
			23 00 00 02 44 1D
			23 00 00 02 45 1D
			23 00 00 02 46 1F
			23 00 00 02 47 1E
			23 00 00 02 48 01
			23 00 00 02 49 11
			23 00 00 02 4A 07
			23 00 00 02 4B 1D
			23 00 00 02 4C 1D
			23 00 00 02 4D 09
			23 00 00 02 4E 0B
			23 00 00 02 4F 1D
			23 00 00 02 50 1D
			23 00 00 02 51 05
			23 00 00 02 52 1F
			23 00 00 02 53 1D
			23 00 00 02 54 1D
			23 00 00 02 55 1D
			23 00 00 02 56 1D
			23 00 00 02 57 1D
			23 00 00 02 58 41
			23 00 00 02 59 00
			23 00 00 02 5A 00
			23 00 00 02 5B 10
			23 00 00 02 5C 02
			23 00 00 02 5D 60
			23 00 00 02 5E 01
			23 00 00 02 5F 02
			23 00 00 02 60 40
			23 00 00 02 61 03
			23 00 00 02 62 04
			23 00 00 02 63 14
			23 00 00 02 64 1A
			23 00 00 02 65 55
			23 00 00 02 66 B1
			23 00 00 02 67 73
			23 00 00 02 68 04
			23 00 00 02 69 16
			23 00 00 02 6A 58
			23 00 00 02 6B 0A
			23 00 00 02 6C 00
			23 00 00 02 6D 00
			23 00 00 02 6E 00
			23 00 00 02 6F 88
			23 00 00 02 70 00
			23 00 00 02 71 00
			23 00 00 02 72 06
			23 00 00 02 73 7B
			23 00 00 02 74 00
			23 00 00 02 75 BC
			23 00 00 02 76 00
			23 00 00 02 77 05
			23 00 00 02 78 34
			23 00 00 02 79 00
			23 00 00 02 7A 00
			23 00 00 02 7B 00
			23 00 00 02 7C 00
			23 00 00 02 7D 03
			23 00 00 02 7E 7B
			23 00 00 02 80 06

			23 00 00 02 E0 04

			23 00 00 02 00 02
			23 00 00 02 02 23
			23 00 00 02 03 8F

			23 00 00 02 09 11
			23 00 00 02 0E 2A

			23 00 00 02 9A 01
			23 00 00 02 9B 05

			23 00 00 02 A9 00
			23 00 00 02 AA 68

			23 00 00 02 E0 00
			23 00 00 02 E6 02
			23 00 00 02 E7 06

			23 00 00 02 E0 00
			23 00 00 02 35 00
			13 78 00 01 11
			13 14 00 01 29
			];
		sleep-in = [
			23 32 00 02 E0 00
			23 00 00 02 E0 00
			23 01 00 02 E7 16
			13 32 00 01 28
			13 96 00 01 10
			];
		sleep-out = [
			13 78 00 01 11
			13 32 00 01 29
			];

		display-timings {
			clock-frequency = <520000>;
			hactive = <720>;
			vactive = <1440>;
			hback-porch = <30>;
			hfront-porch = <80>;
			vback-porch = <8>;
			vfront-porch = <36>;
			hsync-len = <20>;
			vsync-len = <4>;
		};
	};
};};
