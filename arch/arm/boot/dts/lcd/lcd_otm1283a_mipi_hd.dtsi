/ { lcds {
	lcd_otm1283a_mipi_hd: lcd1283@1283 {

		work-mode = <1>;
		bpp = <24>;
		lane-number = <4>;

		need-check-esd = <1>;
		esd-timeout = <1000>;
		esd-check-reg = <0x0A>;
		esd-return-code = <0x9C>;

		fps = <60>;
		width-mm = <68>;
		height-mm = <121>;
		panel-name = "lcd_otm1283a_mipi_hd";

		power-on-sequence = <
					50  1  5
					50  0  5
					50  1  20
					>;
		power-off-sequence = <
					50  0  20
					>;

		init-data = [
			23 00 00 02 00 00
			39 00 00 04 FF 12 83 01
			23 00 00 02 00 80
			39 00 00 03 FF 12 83
			23 00 00 02 00 C6
			23 00 00 02 B0 03
			23 00 00 02 00 80
			39 00 00 0a C0 00 64 00 10 10 00 64 10 10
			23 00 00 02 00 90
			39 00 00 07 C0 00 5C 00 01 00 04
			23 00 00 02 00 B3
			39 00 00 04 C0 00 55 08
			23 00 00 02 00 81
			23 00 00 02 C1 56
			23 00 00 02 00 82
			23 00 00 02 C4 02
			23 00 00 02 00 90
			23 00 00 02 c4 49
			23 00 00 02 00 A0
			39 00 00 0f C4 05 10 05 02 05 15 1A 05 10 05 02 05 15 1A
			23 00 00 02 00 B0
			39 00 00 03 C4 00 00
			23 00 00 02 00 B9
			23 00 00 02 B0 51
			23 00 00 02 00 BB
			23 00 00 02 C5 80
			23 00 00 02 00 90
			39 00 00 04 C5 50 A6 C0
			23 00 00 02 00 94
			23 00 00 02 C5 66
			23 00 00 02 00 90
			39 00 00 05 F5 02 11 02 11
			23 00 00 02 00 B0
			39 00 00 03 C5 04 38
			23 00 00 02 00 B1
			23 00 00 02 c6 05
			23 00 00 02 00 00
			23 00 00 02 D0 40
			23 00 00 02 00 00
			39 00 00 03 D1 00 00
			23 00 00 02 00 80
			39 00 00 0c CB 00 00 00 00 00 00 00 00 00 00 00
			23 00 00 02 00 90
			39 00 00 10 CB 00 00 00 00 00 00 00 00 00 00 00 00 00 00 00
			23 00 00 02 00 A0
			39 00 00 10 CB 00 00 00 00 00 00 00 00 00 00 00 00 00 00 00
			23 00 00 02 00 B0
			23 00 00 02 16 00 CB 00 00 00 00 00 00 00 00 00 00 00 00 00 00 00
			23 00 00 02 00 C0
			39 00 00 10 CB 05 05 05 05 05 05 05 00 00 00 00 00 00 00 00
			23 00 00 02 00 D0
			39 00 00 10 CB 00 00 00 00 05 00 00 05 05 05 05 05 05 05 00
			23 00 00 02 00 E0
			39 00 00 0f CB 00 00 00 00 00 00 00 00 00 00 00 05 00 00
			23 00 00 02 00 F0
			39 00 00 0c CB FF FF FF FF FF FF FF FF FF FF FF
			23 00 00 02 00 80
			39 00 00 10 CC 01 09 0B 0D 0F 11 13 00 00 00 00 00 00 00 00
			23 00 00 02 00 90
			39 00 00 10 CC 00 00 00 00 05 00 00 02 0A 0C 0E 10 12 14 00
			23 00 00 02 00 A0
			39 00 00 0f CC 00 00 00 00 00 00 00 00 00 00 00 06 00 00
			23 00 00 02 00 B0
			39 00 00 10 CC 00 00 00 00 00 00 00 00 00 00 00 00 00 00 00
			23 00 00 02 00 C0
			39 00 00 10 CC 00 00 00 00 00 00 00 00 00 00 00 00 00 00 00
			23 00 00 02 00 D0
			39 00 00 0f CC 00 00 00 00 00 00 00 00 00 00 00 00 00 00
			23 00 00 02 00 80
			39 00 00 0d CE 87 05 10 86 05 10 00 00 00 00 00 00
			23 00 00 02 00 90
			39 00 00 0f CE 55 04 10 55 05 10 00 00 00 00 00 00 00 00
			23 00 00 02 00 A0
			39 00 00 0f CE 58 05 05 04 00 10 00 58 04 05 05 00 10 00
			23 00 00 02 00 B0
			39 00 00 0f CE 58 03 04 FA 00 10 00 58 02 04 FB 00 10 00
			23 00 00 02 00 C0
			39 00 00 0f CE 58 01 04 FC 00 10 00 58 00 04 FD 00 10 00
			23 00 00 02 00 D0
			39 00 00 0f CE 50 00 04 FE 00 10 00 50 01 04 FF 00 10 00
			23 00 00 02 00 80
			39 00 00 0f CF 50 02 05 00 00 10 00 50 03 05 01 00 10 00
			23 00 00 02 00 90
			39 00 00 0f CF 50 04 05 02 00 10 00 50 05 05 03 00 10 00
			23 00 00 02 00 A0
			39 00 00 0f CF 00 00 00 00 00 00 00 00 00 00 00 00 00 00
			23 00 00 02 00 B0
			39 00 00 0f CF 00 00 00 00 00 00 00 00 00 00 00 00 00 00
			23 00 00 02 00 C0
			39 00 00 0b CF 01 01 20 20 00 00 01 01 00 00
			23 00 00 02 00 B5
			39 00 00 07 C5 0B 80 7F 0B 80 7F
			23 00 00 02 00 00
			39 00 00 03 D8 B6 B6
			23 00 00 02 00 00
			23 00 00 02 D9 7B
			23 00 00 02 00 00
			39 00 00 11 E1 02 14 1A 0E 07 11 0B 0A  04 08 0D 0A 13 17 12 0A
			23 00 00 02 00 00
			39 00 00 11 E2 02 13 1A 0E 07 10 0B 0A  02 06 0D 06 0B 0F 0A 06
			23 00 00 02 00 00
			39 00 00 04 FF FF FF FF
			23 78 00 01 11
			23 0A 00 01 29
			];
		sleep-in = [
			13 0A 00 01 28
			13 78 00 01 10
			];
		sleep-out = [
			13 78 00 01 11
			13 64 00 01 29
			];

		display-timings {
			clock-frequency = <500000>;
			hactive = <720>;
			vactive = <1280>;
			hback-porch = <4>;
			hfront-porch = <74>;
			vback-porch = <18>;
			vfront-porch = <17>;
			hsync-len = <8>;
			vsync-len = <7>;
		};
	};
};};

