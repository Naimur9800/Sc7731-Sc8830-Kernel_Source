/ { lcds {
	lcd_st7701_boe_mipi_wvga: lcd7701@7701 {

		work-mode = <1>;
		bpp = <24>;
		lane-number = <2>;

		need-check-esd = <0>;
		esd-timeout = <1000>;

		fps = <60>;
		width-mm = <68>;
		height-mm = <121>;
		panel-name = "lcd_st7701_boe_mipi_wvga";

		power-on-sequence = <
					32  1  5
					32  0  5
					32  1  20
					>;
		power-off-sequence = <
					32  0  20
					>;

		init-data = [
			23 78 00 02 11 00
			39 00 00 06 FF 77 01 00 00 10
			39 00 00 03 C0 63 00
			39 00 00 03 C1 0C 02
			39 00 00 03 C2 01 04
			23 00 00 02 CC 10
			39 00 00 11 B0 00 02 07 10 14 0A 07 09 09 19 05 14 12 12 1A DE
			39 00 00 11 B1 00 02 08 0F 17 0B 0F 09 09 28 09 15 12 16 19 DE
			39 00 00 06 FF 77 01 00 00 11
			23 00 00 02 B0 42
			23 00 00 02 B1 61
			23 00 00 02 B2 87
			23 00 00 02 B3 80
			23 00 00 02 B5 4D
			23 00 00 02 B7 85
			23 00 00 02 B8 21
			23 00 00 02 B9 10
			23 00 00 02 C1 78
			23 00 00 02 C2 78
			23 00 00 02 D0 88
			39 00 00 04 E0 00 00 02
			39 00 00 0c E1 04 00 00 00 05 00 00 00 00 20 20
			39 00 00 0e E2 00 00 00 00 00 00 00 00 00 00 00 00 00
			39 00 00 05 E3 00 00 33 00
			39 00 00 03 E4 22 00
			39 00 00 11 E5 04 34 AA AA 06 34 AA AA 00 00 00 00 00 00 00 00
			39 00 00 05 E6 00 00 33 00
			39 00 00 03 E7 22 00
			39 00 00 11 E8 05 34 AA AA 07 34 AA AA 00 00 00 00 00 00 00 00
			39 00 00 08 EB 02 00 40 40 00 00 00
			39 00 00 03 EC 00 00
			39 00 00 11 ED FA 45 0B FF FF FF FF FF FF FF FF FF FF B0 54 AF
			39 00 00 06 FF 77 01 00 00 00
			23 0a 00 02 29 00
			];
		sleep-in = [
			13 0A 00 01 28
			13 78 00 01 10
			];
		sleep-out = [
			13 78 00 01 11
			13 64 00 01 29
			];

		display-timings {
			clock-frequency = <500000>;
			hactive = <480>;
			vactive = <800>;
			hback-porch = <70>;
			hfront-porch = <80>;
			vback-porch = <20>;
			vfront-porch = <18>;
			hsync-len = <10>;
			vsync-len = <10>;
		};
	};
};};

