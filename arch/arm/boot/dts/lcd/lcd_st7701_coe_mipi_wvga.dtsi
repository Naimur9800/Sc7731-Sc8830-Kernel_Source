/ { lcds {
	lcd_st7701_coe_mipi_wvga: lcd77011@77011 {

		work-mode = <1>;
		bpp = <24>;
		lane-number = <2>;

		need-check-esd = <0>;
		esd-timeout = <1000>;

		fps = <60>;
		width-mm = <68>;
		height-mm = <121>;
		panel-name = "lcd_st7701_coe_mipi_wvga";

		power-on-sequence = <
					32  1  5
					32  0  5
					32  1  20
					>;
		power-off-sequence = <
					32  0  20
					>;

		init-data = [
			 23 78 00 02 11 00
			 39 00 00 06 FF 77 01 00 00 10
			 39 00 00 03 C0 63 00
			 39 00 00 03 C1 11 02
			 39 00 00 03 C2 11 08
			 23 00 00 02 CC 10
			 39 00 00 11 B0 40 03 0B 13 19 0C 0D 0B 09 20 08 15 12 0E 1A 14
			 39 00 00 11 B1 40 02 C9 10 15 0A 0A 09 09 24 08 15 11 1B 19 14
			 39 00 00 06 FF 77 01 00 00 11
			 23 00 00 02 B0 4D
			 23 00 00 02 B1 6F
			 23 00 00 02 B2 07
			 23 00 00 02 B3 80
			 23 00 00 02 B5 47
			 23 00 00 02 B7 85
			 23 00 00 02 B8 21
			 23 00 00 02 B9 10
			 23 00 00 02 C1 78
			 23 00 00 02 C2 78
			 23 00 00 02 D0 88
			 39 00 00 04 E0 00 00 02
			 39 00 00 0c E1 08 00 0A 00 09 00 0B 00 00 44 44
			 39 00 00 0e E2 33 33 44 44 2D 00 2F 00 2E 00 30 00 00
			 39 00 00 05 E3 00 00 33 33
			 39 00 00 03 E4 44 44
			 39 00 00 11 E5 0B 40 A0 A0 0D 40 A0 A0 0F 40 A0 A0 11 40 A0 A0
			 39 00 00 05 E6 00 00 33 33
			 39 00 00 03 E7 44 44
			 39 00 00 11 E8 0C 40 A0 A0 0E 40 A0 A0 10 40 A0 A0 12 40 A0 A0
			 39 00 00 08 EB 02 00 4E 4E EE 44 00
			 39 00 00 03 EC 00 00
			 39 00 00 11 ED FF F1 04 56 72 3F FF FF FF FF F3 27 65 40 1F FF
			 39 00 00 06 FF 77 01 00 00 00
			 23 0a 00 02 29 00
			];
		sleep-in = [
			13 0A 00 01 28
			13 78 00 01 10
			];
		sleep-out = [
			13 78 00 01 11
			13 64 00 01 29
			];

		display-timings {
			clock-frequency = <500000>;
			hactive = <480>;
			vactive = <800>;
			hback-porch = <70>;
			hfront-porch = <80>;
			vback-porch = <20>;
			vfront-porch = <18>;
			hsync-len = <10>;
			vsync-len = <10>;
		};
	};
};};

