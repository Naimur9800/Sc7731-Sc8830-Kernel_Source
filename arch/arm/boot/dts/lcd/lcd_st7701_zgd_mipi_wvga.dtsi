/ { lcds {
	lcd_st7701_zgd_mipi_wvga: lcd77012@77012 {

		work-mode = <1>;
		bpp = <24>;
		lane-number = <2>;

		need-check-esd = <0>;
		esd-timeout = <1000>;

		fps = <60>;
		width-mm = <68>;
		height-mm = <121>;
		panel-name = "lcd_st7701_zgd_mipi_wvga";

		power-on-sequence = <
					50  1  5
					50  0  5
					50  1  20
					>;
		power-off-sequence = <
					50  0  20
					>;

		init-data = [
			 39 00 00 06 FF 77 01 00 00 10
			 39 00 00 03 C0 63 00
			 39 00 00 03 C1 0C 07
			 39 00 00 03 C2 31 08
			 23 00 00 02 CC 10
			 39 00 00 11 B0 40 02 87 0E 15 0A 03 0A 0A 18 08 16 13 07 09 19
			 39 00 00 11 B1 40 01 86 0D 13 09 03 0A 09 1C 09 15 13 91 16 19
			 39 00 00 06 FF 77 01 00 00 11
			 23 00 00 02 B0 4D
			 23 00 00 02 B1 64
			 23 00 00 02 B2 07
			 23 00 00 02 B3 80
			 23 00 00 02 B5 47
			 23 00 00 02 B7 85
			 23 00 00 02 B8 21
			 23 00 00 02 B9 10
			 23 00 00 02 C1 78
			 23 00 00 02 C2 78
			 23 00 00 02 D0 88
			 39 00 00 04 E0 00 B4 02
			 39 00 00 0c E1 06 00 00 00 05 00 00 00 00 20 20
			 39 00 00 0e E2 00 00 01 00 00 00 03 00 00 00 00 00 00
			 39 00 00 05 E3 00 00 33 33
			 39 00 00 03 E4 44 44
			 39 00 00 11 E5 09 31 BE A0 0B 31 BE A0 05 31 BE A0 07 31 BE A0
			 39 00 00 05 E6 00 00 33 33
			 39 00 00 03 E7 44 44
			 39 00 00 11 E8 08 31 BE A0 0A 31 BE A0 04 31 BE A0 06 31 BE A0
			 39 00 00 11 EA 10 00 10 00 10 00 10 00 10 00 10 00 10 00 10 00
			 39 00 00 08 EB 02 02 00 00 00 00 00
			 39 00 00 03 EC 02 00
			 39 00 00 11 ED F5 47 6F 0B 8F 9F FF FF FF FF F9 F8 B0 F6 74 5F
			 39 00 00 0d EF 08 08 08 08 08 08 04 04 04 04 04 04
			 39 00 00 06 FF 77 01 00 00 00
			 23 78 00 02 11 00
			 23 64 00 02 29 00
			];
		sleep-in = [
			13 0A 00 01 28
			13 78 00 01 10
			];
		sleep-out = [
			13 78 00 01 11
			13 64 00 01 29
			];

		display-timings {
			clock-frequency = <480000>;
			hactive = <480>;
			vactive = <800>;
			hback-porch = <80>;
			hfront-porch = <80>;
			vback-porch = <18>;
			vfront-porch = <18>;
			hsync-len = <10>;
			vsync-len = <4>;
		};
	};
};};

