/*
 * Spreadtrum SP9832E 1H10 GO FULL board DTS file
 *
 * Copyright (C) 2016-2017, Spreadtrum Communications Inc.
 *
 * This file is licensed under a dual GPLv2 or X11 license.
 */
#include "sp9832e-1h10-gofu.dts"

&fs_vendor {
		fsmgr_flags = "wait,avb";
};
