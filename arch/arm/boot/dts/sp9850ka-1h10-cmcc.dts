/*
 * Spreadtrum SP9850KA 1H10 CMCC board DTS file
 *
 * Copyright (C) 2016-2017, Spreadtrum Communications Inc.
 *
 * This file is licensed under a dual GPLv2 or X11 license.
 */
#include "sp9850ka-1h10-native.dts"

/ {
	model = "Spreadtrum SP9850KA-1H10-CMCC Board";

	reserved-memory {
		/delete-node/ sml-mem@94000000;
		/delete-node/ tos-mem@94100000;
		/delete-node/ sh-mem@98000000;
	};
};
