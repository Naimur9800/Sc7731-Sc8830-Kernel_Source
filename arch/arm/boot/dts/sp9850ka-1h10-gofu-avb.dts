/*
 * Spreadtrum SP9850KA 1H10 GOFU TEE board DTS file
 *
 * Copyright (C) 2016-2017, Spreadtrum Communications Inc.
 *
 * This file is licensed under a dual GPLv2 or X11 license.
 */

#include "sp9850ka-1h10-gofu.dts"

&fs_system {
		fsmgr_flags = "wait,avb";
};

&fs_vendor {
		fsmgr_flags = "wait,avb";
};
