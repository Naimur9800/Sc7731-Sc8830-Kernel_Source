/*
 * Spreadtrum SP9850KA 1H10 CMCC board DTS file
 *
 * Copyright (C) 2016-2017, Spreadtrum Communications Inc.
 *
 * This file is licensed under a dual GPLv2 or X11 license.
 */
#include "sp9850ka-1h10-native.dts"

/delete-node/ &arch_timer;
