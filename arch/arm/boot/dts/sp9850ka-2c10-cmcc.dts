/*
 * Spreadtrum SP9850KA 2C10 CMCC board DTS file
 *
 * Copyright (C) 2016-2017, Spreadtrum Communications Inc.
 *
 * This file is licensed under a dual GPLv2 or X11 license.
 */
#include "sp9850ka-2c10-native.dts"

/ {
	model = "Spreadtrum SP9850KA-2C10-CMCC Board";
	reserved-memory {
		/delete-node/ sml-mem@94000000;
		/delete-node/ tos-mem@94100000;
		/delete-node/ sh-mem@98000000;
	};
};

&i2c4 {
	status = "okay";
	sec-nfc@27{
		compatible = "samsung,sec-nfc";
		reg = <0x27>;
		sec-nfc,ven-gpio = <&ap_gpio 4 0>;
		sec-nfc,firm-gpio = <&ap_gpio 156 0>;
		sec-nfc,irq-gpio = <&ap_gpio 137 0>;
	};
};
