/*
 * this file is ued to change sprd dtsi which can't be changed by overlay
 * such as /delete-node/ /delete-property/ and alises
 */

#include "../lcd/zte_lcd_lcetron_otm8019a_ctc_4p95_480p.dtsi"
#include "../lcd/zte_lcd_lead_otm8019a_ctc_4p95_480p.dtsi"
#include "../lcd/zte_lcd_easyquick_st7701_hsd_4p95_480p.dtsi"
&panel_if {
	panel-drivers = <
		&lcd_lcetron_otm8019a_ctc_mipi_hd
		&lcd_lead_otm8019a_ctc_mipi_hd
		&lcd_easyquick_st7701_hsd_mipi_hd
	>;
};
