/ { lcds {
	l505_lcd_ili9881c_weiyi_mipi_hd: lcd988102@988102 {

		work-mode = <1>;
		bpp = <24>;
		lane-number = <4>;

		hsync-pol = <0>;
		vsync-pol = <0>;
		de-pol = <0>;
		te-pol = <0>;
		color-mode-pol = <1>;
		shut-down-pol = <1>;
		dsc-compression = <0>;

		need-check-esd = <1>;
		esd-timeout = <1000>;
		esd-check-reg = <0x0A>;
		esd-return-code = <0x9C>;

		fps = <60>;
		direction = <0>;
		low-res-simu = <0>;
		simu-width = <480>;
		simu-height = <854>;
		panel-name = "lcd_ili9881c_mipi_hd";

		power-on-sequence = <
					50  1  5
					50  0  5
					50  1  20
					>;
		power-off-sequence = <
					50  0  20
					>;

		init-data = [

			39 00 00 04 FF 98 81 03
			23 00 00 02 01 00
			23 00 00 02 02 00
			23 00 00 02 03 52
			23 00 00 02 04 12
			23 00 00 02 05 00
			23 00 00 02 06 03
			23 00 00 02 07 01
			23 00 00 02 08 00
			23 00 00 02 09 01
			23 00 00 02 0A 00
			23 00 00 02 0B 00
			23 00 00 02 0C 01
			23 00 00 02 0D 00
			23 00 00 02 0E 00
			23 00 00 02 0F 00
			23 00 00 02 10 00
			23 00 00 02 11 00
			23 00 00 02 12 00
			23 00 00 02 13 00
			23 00 00 02 14 00

			23 00 00 02 15 00
			23 00 00 02 16 00
			23 00 00 02 17 00

			23 00 00 02 18 00
			23 00 00 02 19 00
			23 00 00 02 1A 00
			23 00 00 02 1B 00
			23 00 00 02 1C 00
			23 00 00 02 1D 00
			23 00 00 02 1E 44
			23 00 00 02 1F 80
			23 00 00 02 20 01
			23 00 00 02 21 02
			23 00 00 02 22 00
			23 00 00 02 23 00
			23 00 00 02 24 00
			23 00 00 02 25 00
			23 00 00 02 26 00
			23 00 00 02 27 00
			23 00 00 02 28 33
			23 00 00 02 29 02
			23 00 00 02 2A 00
			23 00 00 02 2B 00
			23 00 00 02 2C 00
			23 00 00 02 2D 00
			23 00 00 02 2E 00
			23 00 00 02 2F 00
			23 00 00 02 30 00
			23 00 00 02 31 00
			23 00 00 02 32 00
			23 00 00 02 33 00
			23 00 00 02 34 04
			23 00 00 02 35 00
			23 00 00 02 36 00
			23 00 00 02 37 00
			23 00 00 02 38 3c
			23 00 00 02 39 00
			23 00 00 02 3A 40
			23 00 00 02 3B 40
			23 00 00 02 3C 00
			23 00 00 02 3D 00
			23 00 00 02 3E 00
			23 00 00 02 3F 00
			23 00 00 02 40 00
			23 00 00 02 41 00
			23 00 00 02 42 00
			23 00 00 02 43 00
			23 00 00 02 44 00

			23 00 00 02 50 01
			23 00 00 02 51 23
			23 00 00 02 52 45
			23 00 00 02 53 67
			23 00 00 02 54 89
			23 00 00 02 55 AB
			23 00 00 02 56 01
			23 00 00 02 57 23
			23 00 00 02 58 45
			23 00 00 02 59 67
			23 00 00 02 5A 89
			23 00 00 02 5B AB
			23 00 00 02 5C CD
			23 00 00 02 5D EF

			23 00 00 02 5E 11
			23 00 00 02 5F 01
			23 00 00 02 60 00
			23 00 00 02 61 15
			23 00 00 02 62 14
			23 00 00 02 63 0C
			23 00 00 02 64 0D
			23 00 00 02 65 0E
			23 00 00 02 66 0F
			23 00 00 02 67 06
			23 00 00 02 68 02
			23 00 00 02 69 02
			23 00 00 02 6A 02
			23 00 00 02 6B 02
			23 00 00 02 6C 02
			23 00 00 02 6D 02
			23 00 00 02 6E 08
			23 00 00 02 6F 02
			23 00 00 02 70 02
			23 00 00 02 71 02
			23 00 00 02 72 02
			23 00 00 02 73 02
			23 00 00 02 74 02
			23 00 00 02 75 01
			23 00 00 02 76 00
			23 00 00 02 77 15
			23 00 00 02 78 14
			23 00 00 02 79 0C
			23 00 00 02 7A 0D
			23 00 00 02 7B 0E
			23 00 00 02 7C 0F
			23 00 00 02 7D 08
			23 00 00 02 7E 02
			23 00 00 02 7F 02
			23 00 00 02 80 02
			23 00 00 02 81 02
			23 00 00 02 82 02
			23 00 00 02 83 02
			23 00 00 02 84 06
			23 00 00 02 85 02
			23 00 00 02 86 02
			23 00 00 02 87 02
			23 00 00 02 88 02
			23 00 00 02 89 02
			23 00 00 02 8A 02

			39 00 00 04 FF 98 81 04
			23 00 00 02 6E 2A
			23 00 00 02 6F 33
			23 00 00 02 3A 24
			23 00 00 02 8D 14
			23 00 00 02 87 BA
			23 00 00 02 26 76
			23 00 00 02 B2 D1
			23 00 00 02 B5 06
			23 00 00 02 35 1F

			23 00 00 02 33 00
			23 00 00 02 7A 0F

			39 00 00 04 FF 98 81 01
			23 00 00 02 22 0A
			23 00 00 02 31 00
			23 00 00 02 53 AD
			23 00 00 02 55 8F
			23 00 00 02 50 AE
			23 00 00 02 51 AE
			23 00 00 02 60 28
			23 00 00 02 63 00

			39 00 00 04 FF 98 81 01
			23 00 00 02 A0 08
			23 00 00 02 A1 14
			23 00 00 02 A2 20
			23 00 00 02 A3 10
			23 00 00 02 A4 12
			23 00 00 02 A5 24
			23 00 00 02 A6 19
			23 00 00 02 A7 1B
			23 00 00 02 A8 6F
			23 00 00 02 A9 1C
			23 00 00 02 AA 28
			23 00 00 02 AB 63
			23 00 00 02 AC 1D
			23 00 00 02 AD 1D
			23 00 00 02 AE 50
			23 00 00 02 AF 25
			23 00 00 02 B0 2A
			23 00 00 02 B1 45
			23 00 00 02 B2 6c
			23 00 00 02 B3 3F

			23 00 00 02 C0 08
			23 00 00 02 C1 15
			23 00 00 02 C2 1F
			23 00 00 02 C3 10
			23 00 00 02 C4 11
			23 00 00 02 C5 25
			23 00 00 02 C6 18
			23 00 00 02 C7 1B
			23 00 00 02 C8 6F
			23 00 00 02 C9 1C
			23 00 00 02 CA 29
			23 00 00 02 CB 62
			23 00 00 02 CC 1C
			23 00 00 02 CD 1C
			23 00 00 02 CE 51
			23 00 00 02 CF 26
			23 00 00 02 D0 2A
			23 00 00 02 D1 46
			23 00 00 02 D2 6c
			23 00 00 02 D3 3F

			39 00 00 04 FF 98 81 00
			23 00 00 02 35 00
			23 78 00 02 11 00
			23 14 00 02 29 00

				];
		sleep-in = [
			13 0A 00 01 28
			13 78 00 01 10
			];
		sleep-out = [
			13 78 00 01 11
			13 64 00 01 29
			];
		esd-check = [
			37 00 00 02 01 00
			];
		read-id = [
			37 00 00 02 02 00
			];

		display-timings {
			clock-frequency = <500000>;
			hactive = <720>;
			vactive = <1280>;
			hback-porch = <50>;
			hfront-porch = <30>;
			vback-porch = <16>;
			vfront-porch = <18>;
			hsync-len = <10>;
			vsync-len = <6>;
			hsync-active = <0>;
			vsync-active = <0>;
			de-active = <0>;
			pixelclk-active = <1>;
		};
	};
};};

