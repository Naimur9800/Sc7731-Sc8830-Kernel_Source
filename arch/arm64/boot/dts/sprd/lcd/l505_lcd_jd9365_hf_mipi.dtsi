/ { lcds {
	l505_lcd_jd9365_hf_mipi: lcd936502@936502 {

		work-mode = <1>;
		bpp = <24>;
		lane-number = <4>;

		hsync-pol = <0>;
		vsync-pol = <0>;
		de-pol = <0>;
		te-pol = <0>;
		color-mode-pol = <1>;
		shut-down-pol = <1>;
		dsc-compression = <0>;

		need-check-esd = <1>;
		esd-timeout = <1000>;
		esd-check-reg = <0x0A>;
		esd-return-code = <0x9C>;

		fps = <60>;
		direction = <0>;
		low-res-simu = <0>;
		simu-width = <480>;
		simu-height = <854>;
		panel-name = "lcd_jd9365_hf_mipi";

		power-on-sequence = <
					50  1  5
					50  0  5
					50  1  20
					>;
		power-off-sequence = <
					50  0  20
					>;

		init-data = [

			23 00 00 02 E0 00
			23 00 00 02 E1 93
			23 00 00 02 E2 65
			23 00 00 02 E3 F8
			23 00 00 02 E0 01
			23 00 00 02 00 00
			23 00 00 02 01 B6
			23 00 00 02 03 00
			23 00 00 02 04 C5
			23 00 00 02 17 00
			23 00 00 02 18 BF
			23 00 00 02 19 01
			23 00 00 02 1A 00
			23 00 00 02 1B BF
			23 00 00 02 1C 01
			23 00 00 02 1F 7C
			23 00 00 02 20 26
			23 00 00 02 21 26
			23 00 00 02 22 4E
			23 00 00 02 37 09
			23 00 00 02 38 04
			23 00 00 02 39 08
			23 00 00 02 3A 1F
			23 00 00 02 3B 1F
			23 00 00 02 3C 78
			23 00 00 02 3D FF
			23 00 00 02 3E FF
			23 00 00 02 3F 00
			23 00 00 02 40 04
			23 00 00 02 41 A0
			23 00 00 02 43 0F
			23 00 00 02 44 0A
			23 00 00 02 45 24
			23 00 00 02 55 01
			23 00 00 02 56 01
			23 00 00 02 57 A5
			23 00 00 02 58 0A
			23 00 00 02 59 4A
			23 00 00 02 5A 38
			23 00 00 02 5B 10
			23 00 00 02 5C 19
			23 00 00 02 5D 7C
			23 00 00 02 5E 61
			23 00 00 02 5F 51
			23 00 00 02 60 44
			23 00 00 02 61 3F
			23 00 00 02 62 2F
			23 00 00 02 63 33
			23 00 00 02 64 1C
			23 00 00 02 65 33
			23 00 00 02 66 31
			23 00 00 02 67 30
			23 00 00 02 68 58
			23 00 00 02 69 38
			23 00 00 02 6A 42
			23 00 00 02 6B 2F
			23 00 00 02 6C 23
			23 00 00 02 6D 13
			23 00 00 02 6E 02
			23 00 00 02 6F 08
			23 00 00 02 70 7C
			23 00 00 02 71 61
			23 00 00 02 72 51
			23 00 00 02 73 44
			23 00 00 02 74 3F
			23 00 00 02 75 2F
			23 00 00 02 76 33
			23 00 00 02 77 1C
			23 00 00 02 78 33
			23 00 00 02 79 31
			23 00 00 02 7A 30
			23 00 00 02 7B 37
			23 00 00 02 7C 38
			23 00 00 02 7D 42
			23 00 00 02 7E 2F
			23 00 00 02 7F 23
			23 00 00 02 80 13
			23 00 00 02 81 02
			23 00 00 02 82 08
			23 00 00 02 E0 02
			23 00 00 02 00 57
			23 00 00 02 01 77
			23 00 00 02 02 44
			23 00 00 02 03 46
			23 00 00 02 04 48
			23 00 00 02 05 4A
			23 00 00 02 06 4C
			23 00 00 02 07 4E
			23 00 00 02 08 50
			23 00 00 02 09 55
			23 00 00 02 0A 52
			23 00 00 02 0B 55
			23 00 00 02 0C 55
			23 00 00 02 0D 55
			23 00 00 02 0E 55
			23 00 00 02 0F 55
			23 00 00 02 10 55
			23 00 00 02 11 55
			23 00 00 02 12 55
			23 00 00 02 13 40
			23 00 00 02 14 55
			23 00 00 02 15 55
			23 00 00 02 16 57
			23 00 00 02 17 77
			23 00 00 02 18 45
			23 00 00 02 19 47
			23 00 00 02 1A 49
			23 00 00 02 1B 4B
			23 00 00 02 1C 4D
			23 00 00 02 1D 4F
			23 00 00 02 1E 51
			23 00 00 02 1F 55
			23 00 00 02 20 53
			23 00 00 02 21 55
			23 00 00 02 22 55
			23 00 00 02 23 55
			23 00 00 02 24 55
			23 00 00 02 25 55
			23 00 00 02 26 55
			23 00 00 02 27 55
			23 00 00 02 28 55
			23 00 00 02 29 41
			23 00 00 02 2A 55
			23 00 00 02 2B 55
			23 00 00 02 2C 57
			23 00 00 02 2D 77
			23 00 00 02 2E 4F
			23 00 00 02 2F 4D
			23 00 00 02 30 4B
			23 00 00 02 31 49
			23 00 00 02 32 47
			23 00 00 02 33 45
			23 00 00 02 34 41
			23 00 00 02 35 55
			23 00 00 02 36 53
			23 00 00 02 37 55
			23 00 00 02 38 55
			23 00 00 02 39 55
			23 00 00 02 3A 55
			23 00 00 02 3B 55
			23 00 00 02 3C 55
			23 00 00 02 3D 55
			23 00 00 02 3E 55
			23 00 00 02 3F 51
			23 00 00 02 40 55
			23 00 00 02 41 55
			23 00 00 02 42 57
			23 00 00 02 43 77
			23 00 00 02 44 4E
			23 00 00 02 45 4C
			23 00 00 02 46 4A
			23 00 00 02 47 48
			23 00 00 02 48 46
			23 00 00 02 49 44
			23 00 00 02 4A 40
			23 00 00 02 4B 55
			23 00 00 02 4C 52
			23 00 00 02 4D 55
			23 00 00 02 4E 55
			23 00 00 02 4F 55
			23 00 00 02 50 55
			23 00 00 02 51 55
			23 00 00 02 52 55
			23 00 00 02 53 55
			23 00 00 02 54 55
			23 00 00 02 55 50
			23 00 00 02 56 55
			23 00 00 02 57 55
			23 00 00 02 58 40
			23 00 00 02 59 00
			23 00 00 02 5A 00
			23 00 00 02 5B 10
			23 00 00 02 5C 09
			23 00 00 02 5D 30
			23 00 00 02 5E 01
			23 00 00 02 5F 02
			23 00 00 02 60 30
			23 00 00 02 61 03
			23 00 00 02 62 04
			23 00 00 02 63 06
			23 00 00 02 64 6A
			23 00 00 02 65 75
			23 00 00 02 66 0F
			23 00 00 02 67 B3
			23 00 00 02 68 0B
			23 00 00 02 69 06
			23 00 00 02 6A 6A
			23 00 00 02 6B 10
			23 00 00 02 6C 00
			23 00 00 02 6D 04
			23 00 00 02 6E 04
			23 00 00 02 6F 88
			23 00 00 02 70 00
			23 00 00 02 71 00
			23 00 00 02 72 06
			23 00 00 02 73 7B
			23 00 00 02 74 00
			23 00 00 02 75 BC
			23 00 00 02 76 00
			23 00 00 02 77 05
			23 00 00 02 78 2E
			23 00 00 02 79 00
			23 00 00 02 7A 00
			23 00 00 02 7B 00
			23 00 00 02 7C 00
			23 00 00 02 7D 03
			23 00 00 02 7E 7B
			23 00 00 02 E0 04
			23 00 00 02 09 10
			23 00 00 02 2B 2B
			23 00 00 02 2E 44
			23 00 00 02 E0 00
			23 00 00 02 E6 02
			23 00 00 02 E7 1F

			23 00 00 02 35 00
			23 78 00 02 11 00
			23 14 00 02 29 00

				];
		sleep-in = [
			13 0A 00 01 28
			13 78 00 01 10

			];
		sleep-out = [
			13 78 00 01 11
			13 64 00 01 29
			];
		esd-check = [
			37 00 00 02 01 00
			];
		read-id = [
			37 00 00 02 02 00
			];

		display-timings {
			clock-frequency = <500000>;
			hactive = <720>;
			vactive = <1280>;
			hback-porch = <50>;
			hfront-porch = <30>;
			vback-porch = <12>;
			vfront-porch = <18>;
			hsync-len = <10>;
			vsync-len = <6>;
			hsync-active = <0>;
			vsync-active = <0>;
			de-active = <0>;
			pixelclk-active = <1>;
		};
	};
};};

