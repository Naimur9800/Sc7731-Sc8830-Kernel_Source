/ { lcds {
	l505_lcd_jd9365_zgd_mipi: lcd9365@9365 {

		work-mode = <1>;
		bpp = <24>;
		lane-number = <4>;

		hsync-pol = <0>;
		vsync-pol = <0>;
		de-pol = <0>;
		te-pol = <0>;
		color-mode-pol = <1>;
		shut-down-pol = <1>;
		dsc-compression = <0>;

		need-check-esd = <1>;
		esd-timeout = <1000>;
		esd-check-reg = <0x0A>;
		esd-return-code = <0x9C>;

		fps = <60>;
		direction = <0>;
		low-res-simu = <0>;
		simu-width = <480>;
		simu-height = <854>;
		panel-name = "lcd_jd9365_zgd_mipi";

		power-on-sequence = <
					50  1  5
					50  0  20
					50  1  20
					>;
		power-off-sequence = <
					50  0  20
					50  1  5
					>;

		init-data = [

			23 00 00 02 E0 00
			23 00 00 02 E1 93
			23 00 00 02 E2 65
			23 00 00 02 E3 F8
			23 00 00 02 E0 01
			23 00 00 02 00 00
			23 00 00 02 01 5E
			23 00 00 02 03 00
			23 00 00 02 04 5E
			23 00 00 02 0C 64
			23 00 00 02 17 00
			23 00 00 02 18 BF
			23 00 00 02 19 01
			23 00 00 02 1A 00
			23 00 00 02 1B BF
			23 00 00 02 1C 01
			23 00 00 02 1F 79
			23 00 00 02 20 2D
			23 00 00 02 21 2D
			23 00 00 02 22 4F
			23 00 00 02 26 F1
			23 00 00 02 37 09
			23 00 00 02 38 04
			23 00 00 02 39 0C
			23 00 00 02 3A 18
			23 00 00 02 3C 78
			23 00 00 02 40 04
			23 00 00 02 41 A0
			23 00 00 02 55 01
			23 00 00 02 56 01
			23 00 00 02 57 6D
			23 00 00 02 58 0A
			23 00 00 02 59 1A
			23 00 00 02 5A 65
			23 00 00 02 5B 14
			23 00 00 02 5C 15
			23 00 00 02 5D 70
			23 00 00 02 5E 54
			23 00 00 02 5F 40
			23 00 00 02 60 31
			23 00 00 02 61 2B
			23 00 00 02 62 1B
			23 00 00 02 63 1F
			23 00 00 02 64 0A
			23 00 00 02 65 26
			23 00 00 02 66 27
			23 00 00 02 67 28
			23 00 00 02 68 47
			23 00 00 02 69 34
			23 00 00 02 6A 3B
			23 00 00 02 6B 31
			23 00 00 02 6C 33
			23 00 00 02 6D 27
			23 00 00 02 6E 17
			23 00 00 02 6F 02
			23 00 00 02 70 70
			23 00 00 02 71 54
			23 00 00 02 72 40
			23 00 00 02 73 31
			23 00 00 02 74 2B
			23 00 00 02 75 1B
			23 00 00 02 76 1F
			23 00 00 02 77 0A
			23 00 00 02 78 26
			23 00 00 02 79 27
			23 00 00 02 7A 28
			23 00 00 02 7B 47
			23 00 00 02 7C 34
			23 00 00 02 7D 3B
			23 00 00 02 7E 31
			23 00 00 02 7F 33
			23 00 00 02 80 27
			23 00 00 02 81 17
			23 00 00 02 82 02
			23 00 00 02 E0 02
			23 00 00 02 00 13
			23 00 00 02 01 11
			23 00 00 02 02 0B
			23 00 00 02 03 09
			23 00 00 02 04 07
			23 00 00 02 05 05
			23 00 00 02 06 1F
			23 00 00 02 07 1F
			23 00 00 02 08 1F
			23 00 00 02 09 1F
			23 00 00 02 0A 1F
			23 00 00 02 0B 1F
			23 00 00 02 0C 1F
			23 00 00 02 0D 1F
			23 00 00 02 0E 1F
			23 00 00 02 0F 1F
			23 00 00 02 10 1F
			23 00 00 02 11 1F
			23 00 00 02 12 01
			23 00 00 02 13 03
			23 00 00 02 14 1F
			23 00 00 02 15 1F
			23 00 00 02 16 12
			23 00 00 02 17 10
			23 00 00 02 18 0A
			23 00 00 02 19 08
			23 00 00 02 1A 06
			23 00 00 02 1B 04
			23 00 00 02 1C 1F
			23 00 00 02 1D 1F
			23 00 00 02 1E 1F
			23 00 00 02 1F 1F
			23 00 00 02 20 1F
			23 00 00 02 21 1F
			23 00 00 02 22 1F
			23 00 00 02 23 1F
			23 00 00 02 24 1F
			23 00 00 02 25 1F
			23 00 00 02 26 1F
			23 00 00 02 27 1F
			23 00 00 02 28 00
			23 00 00 02 29 02
			23 00 00 02 2A 1F
			23 00 00 02 2B 1F

			23 00 00 02 2C 00
			23 00 00 02 2D 02
			23 00 00 02 2E 08
			23 00 00 02 2F 0A
			23 00 00 02 30 04
			23 00 00 02 31 06
			23 00 00 02 32 1F
			23 00 00 02 33 1F
			23 00 00 02 34 1F
			23 00 00 02 35 1F
			23 00 00 02 36 1F
			23 00 00 02 37 1F
			23 00 00 02 38 1F
			23 00 00 02 39 1F
			23 00 00 02 3A 1F
			23 00 00 02 3B 1F
			23 00 00 02 3C 1F
			23 00 00 02 3D 1F
			23 00 00 02 3E 12
			23 00 00 02 3F 10
			23 00 00 02 40 1F
			23 00 00 02 41 1F
			23 00 00 02 42 01
			23 00 00 02 43 03
			23 00 00 02 44 09
			23 00 00 02 45 0B
			23 00 00 02 46 05
			23 00 00 02 47 07
			23 00 00 02 48 1F
			23 00 00 02 49 1F
			23 00 00 02 4A 1F
			23 00 00 02 4B 1F
			23 00 00 02 4C 1F
			23 00 00 02 4D 1F
			23 00 00 02 4E 1F
			23 00 00 02 4F 1F
			23 00 00 02 50 1F
			23 00 00 02 51 1F
			23 00 00 02 52 1F
			23 00 00 02 53 1F
			23 00 00 02 54 13
			23 00 00 02 55 11
			23 00 00 02 56 1F
			23 00 00 02 57 1F
			23 00 00 02 58 40
			23 00 00 02 59 00
			23 00 00 02 5A 00
			23 00 00 02 5B 30
			23 00 00 02 5C 09
			23 00 00 02 5D 30
			23 00 00 02 5E 01
			23 00 00 02 5F 02
			23 00 00 02 60 30
			23 00 00 02 61 01
			23 00 00 02 62 02
			23 00 00 02 63 03
			23 00 00 02 64 64
			23 00 00 02 65 75
			23 00 00 02 66 0D
			23 00 00 02 67 73
			23 00 00 02 68 0A
			23 00 00 02 69 06
			23 00 00 02 6A 64
			23 00 00 02 6B 08
			23 00 00 02 6C 00
			23 00 00 02 6D 00
			23 00 00 02 6E 00
			23 00 00 02 6F 00
			23 00 00 02 70 00
			23 00 00 02 71 00
			23 00 00 02 72 06
			23 00 00 02 73 86
			23 00 00 02 74 00
			23 00 00 02 75 07
			23 00 00 02 76 00
			23 00 00 02 77 5D
			23 00 00 02 78 19
			23 00 00 02 79 00
			23 00 00 02 7A 05
			23 00 00 02 7B 05
			23 00 00 02 7C 00
			23 00 00 02 7D 03
			23 00 00 02 7E 86
			23 00 00 02 E0 04
			23 00 00 02 09 10
			23 00 00 02 2B 2B
			23 00 00 02 2E 44
			23 00 00 02 E0 00
			23 00 00 02 E6 02
			23 00 00 02 E7 1F

			23 00 00 02 35 00
			23 78 00 02 11 00
			23 14 00 02 29 00

				];
		sleep-in = [
			//13 0A 00 01 28
			//13 78 00 01 10
			23 00 00 02 E0 00
			];
		sleep-out = [
			13 78 00 01 11
			13 64 00 01 29
			];
		esd-check = [
			37 00 00 02 01 00
			];
		read-id = [
			37 00 00 02 02 00
			];

		display-timings {
			clock-frequency = <500000>;
			hactive = <720>;
			vactive = <1280>;
			hback-porch = <50>;
			hfront-porch = <30>;
			vback-porch = <12>;
			vfront-porch = <18>;
			hsync-len = <10>;
			vsync-len = <6>;
			hsync-active = <0>;
			vsync-active = <0>;
			de-active = <0>;
			pixelclk-active = <1>;
		};
	};
};};

