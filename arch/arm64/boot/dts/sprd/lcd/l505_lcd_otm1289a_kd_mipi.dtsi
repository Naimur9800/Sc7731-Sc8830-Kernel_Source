/ { lcds {
	l505_lcd_otm1289a_kd_mipi: lcd128902@128902 {

		work-mode = <1>;
		bpp = <24>;
		lane-number = <4>;

		hsync-pol = <0>;
		vsync-pol = <0>;
		de-pol = <0>;
		te-pol = <0>;
		color-mode-pol = <1>;
		shut-down-pol = <1>;
		dsc-compression = <0>;

		need-check-esd = <1>;
		esd-timeout = <1000>;
		esd-check-reg = <0x0A>;
		esd-return-code = <0x9C>;

		fps = <60>;
		direction = <0>;
		low-res-simu = <0>;
		simu-width = <480>;
		simu-height = <854>;
		panel-name = "lcd_otm1289_kd_mipi";

		power-on-sequence = <
					50  1  5
					50  0  5
					50  1  20
					>;
		power-off-sequence = <
					50  0  20
					>;

		init-data = [

			23 00 00 02 00 00
			39 00 00 04 ff 12 89 01
			23 00 00 02 00 80
			39 00 00 03 ff 12 89
			23 00 00 02 00 90
			23 00 00 02 ff b0
			23 00 00 02 00 80
			39 00 00 09 c0 4a 00 10 10 96 01 68 40
			23 00 00 02 00 90
			39 00 00 04 c0 3b 01 09
			23 00 00 02 00 8c
			23 00 00 02 c0 00
			23 00 00 02 00 80
			23 00 00 02 c1 33
			23 00 00 02 00 85
			39 00 00 04 c5 0a 0a 49
			23 00 00 02 00 00
			39 00 00 03 d8 27 27
			23 00 00 02 00 84
			23 00 00 02 C4 02
			23 00 00 02 00 93
			23 00 00 02 C4 04
			23 00 00 02 00 96
			23 00 00 02 F5 E7
			23 00 00 02 00 A0
			23 00 00 02 F5 4A
			23 00 00 02 00 8a
			23 00 00 02 c0 11
			23 00 00 02 00 8b
			23 00 00 02 c0 04
			23 00 00 02 00 83
			23 00 00 02 F5 81
			23 00 00 02 00 90
			39 00 00 03 c4 96 05
			23 00 00 02 00 80
			39 00 00 10 cb 14 14 14 14 14 14 14 14 14 00 14 14 00 00 14
			23 00 00 02 00 90
			39 00 00 08 cb 14 00 00 00 00 00 00
			23 00 00 02 00 80
			39 00 00 0f cc 06 1d 1e 1d 1d 10 0c 0e 0a 00 02 00 00 00
			23 00 00 02 00 90
			39 00 00 10 cc 02 00 00 00 00 00 00 05 1d 1e 1d 1d 0f 0b 0d
			23 00 00 02 00 a0
			39 00 00 0e cc 09 00 01 00 00 00 01 00 00 00 00 00 00
			23 00 00 02 00 b0
			39 00 00 0f cc 01 1e 1d 1d 1d 09 0d 0b 0f 00 05 00 00 00
			23 00 00 02 00 c0
			39 00 00 10 cc 05 00 00 00 00 00 00 02 1e 1d 1d 1d 0a 0e 0c
			23 00 00 02 00 d0
			39 00 00 0e cc 10 00 06 00 00 00 06 00 00 00 00 00 00
			23 00 00 02 00 80
			39 00 00 07 ce 87 05 10 86 00 00
			23 00 00 02 00 90
			39 00 00 0a ce 34 ff 10 05 00 00 00 00 00
			23 00 00 02 00 a0
			39 00 00 10 ce 30 83 86 87 16 00 82 85 87 81 84 87 80 83 87
			23 00 00 02 00 b0
			39 00 00 10 ce 30 00 82 87 16 00 01 81 87 02 80 87 03 00 87
			23 00 00 02 00 F0
			39 00 00 07 CE 01 20 C1 81 00 00
			23 00 00 02 00 00
			39 00 00 11 E1 1a 39 4a 59 66 7f 7a 8e 69 56 5f 47 2f 14 09 00
			23 00 00 02 00 00
			39 00 00 11 E2 1a 39 4a 59 66 7f 7a 8e 69 56 5f 47 2f 14 09 00
			23 00 00 02 00 00
			39 00 00 04 ff ff ff ff

			23 78 00 02 11 00
			23 14 00 02 29 00

				];
		sleep-in = [
			13 0A 00 01 28
			13 78 00 01 10
			];
		sleep-out = [
			13 78 00 01 11
			13 64 00 01 29
			];
		esd-check = [
			37 00 00 02 01 00
			];
		read-id = [
			37 00 00 02 02 00
			];

		display-timings {
			clock-frequency = <500000>;
			hactive = <720>;
			vactive = <1280>;
			hback-porch = <4>;
			hfront-porch = <32>;
			vback-porch = <18>;
			vfront-porch = <17>;
			hsync-len = <8>;
			vsync-len = <7>;
			hsync-active = <0>;
			vsync-active = <0>;
			de-active = <0>;
			pixelclk-active = <1>;
		};
	};
};};

