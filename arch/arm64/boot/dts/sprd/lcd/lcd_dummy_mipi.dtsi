/ { lcds {
	lcd_dummy_mipi_hd: lcdffff@ffff {

		work-mode = <1>;
		bpp = <24>;
		lane-number = <4>;

		fps = <60>;
		panel-name = "lcd_dummy_mipi_hd";

		power-on-sequence = <
					126  1  20
					126  0  20
					126  1  120
					>;
		power-off-sequence = <
					126  0  20
					>;

		init-data = [
			13 78 00 01 11
			13 64 00 01 29
			];
		sleep-in =  [
			13 0A 00 01 28
			13 78 00 01 10
			];
		sleep-out = [
			13 78 00 01 11
			13 64 00 01 29
			];

		display-timings {
			clock-frequency = <500000>;
			hactive = <720>;
			vactive = <1280>;
			hback-porch = <30>;
			hfront-porch = <40>;
			vback-porch = <6>;
			vfront-porch = <20>;
			hsync-len = <30>;
			vsync-len = <4>;
		};
	};
}; };
