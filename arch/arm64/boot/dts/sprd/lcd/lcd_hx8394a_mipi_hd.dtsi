/ { lcds {
	lcd_hx8394a_mipi_hd: lcd8394@8394 {

		work-mode = <1>;
		bpp = <24>;
		lane-number = <4>;

		need-check-esd = <0>;
		esd-return-code = <0x1C>;

		fps = <60>;
		width-mm = <68>;
		height-mm = <121>;
		panel-name = "lcd_hx8394a_mipi_hd";

		power-on-sequence = <
					126  1  20
					126  0  20
					126  1  120
					>;
		power-off-sequence = <
					126  0  20
					>;

		init-data = [
			39 00 00 04 B9 FF 83 94
			39 00 00 11 BA 63 82 00 16 C5 00
			10 FF 0F 24 03 21 24 25 20 08
			39 00 00 12 B1 01 00 04 C4 03 12
			F1 24 2C 3F 3F 57 02 00 E6 E2 A6
			39 00 00 07 B2 00 C8 0E 30 00 33
			39 00 00 20 B4 80 04 32 10 08 54
			15 0F 22 10 08 47 53 54 0A 4B 53
			54 02 61 61 02 06 44 06 5F 0A 6B 70 05 08
			23 00 00 02 B6 21
			39 00 00 37 D5 00 00 00 00 0A 00
			01 22 00 33 CC 00 AA BB 01 23 45
			67 9A BC 45 67 88 88 88 88 88 88
			88 01 88 88 88 88 88 88 88 88 88
			88 88 88 88 88 88 88 88 88 88 88 88 88 3C 01
			23 00 00 02 cc 09
			39 00 00 05 bf 06 02 10 04
			39 00 00 05 c7 00 10 00 10
			39 00 00 1A E0 00 04 08 28 2F 3F
			15 34 06 0C 0E 12 14 13 14 11 19 00 04 08 29 2E 3F 15 35
			39 00 00 11 07 0C 0F 11 13 11 12
			10 16 0A 17 07 12 0A 17 06 11
			39 00 00 03 c0 0c 17
			39 00 00 03 c6 08 08
			23 00 00 02 D4 32
			13 78 00 01 11
			39 0a 00 12 BA 63 82 00 16 C5 00
			10 FF 0F 24 03 21 24 25 20 08 3D
			13 64 00 01 29
			];
		sleep-in =  [
			13 0A 00 01 28
			13 78 00 01 10
			];
		sleep-out = [
			13 78 00 01 11
			13 64 00 01 29
			];

		display-timings {
			clock-frequency = <500000>;
			hactive = <720>;
			vactive = <1280>;
			hback-porch = <30>;
			hfront-porch = <40>;
			vback-porch = <6>;
			vfront-porch = <20>;
			hsync-len = <30>;
			vsync-len = <4>;
		};
	};
};};
