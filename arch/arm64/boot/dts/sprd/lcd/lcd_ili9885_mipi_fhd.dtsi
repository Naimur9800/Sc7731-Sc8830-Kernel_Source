/ { lcds {
	lcd_ili9885_mipi_fhd: lcd98@98 {

		work-mode = <1>;
		bpp = <24>;
		lane-number = <4>;

		need-check-esd = <1>;
		esd-timeout = <2000>;
		esd-check-reg = <0x0A>;
		esd-return-code = <0x9C>;

		fps = <60>;
		width-mm = <68>;
		height-mm = <121>;
		panel-name = "txd_ili9885_mipi_fhd";

		power-on-sequence = <
					171  1  10
					172  1  20
					126  1  20
					126  0  20
					126  1  120
					>;
		power-off-sequence = <
					172  0  20
					171  0  10
					126  0  20
					>;

		init-data = [
			39 00 00 04 B0 98 85 0A
			39 00 00 04 D1 09 09 C2
			39 00 00 08 C4 70 00 23 00 20 20 00
			39 00 00 07 D0 44 05 34 7B DF C0
			39 00 00 05 D2 13 13 EA 22
			39 00 00 0A D3 33 33 05 03 6D 6D 88 36 19
			39 00 00 0F D5 8B 00 00 00 01 69 01 69 01 69 00 00 00 00
			39 00 00 08 EC 76 1E 32 00 46 00 00
			23 00 00 09 EF 3C 05 52 13 E1 33 5b 09
			39 00 00 0D D6 80 00 08 17 23 65 77 44 87 00 00 09
			39 00 00 4A E5 F6 F6 F6 A8 F6 18 0A 5C 4E 38 2A F6 F6 5B
64 8C 36 36 36 C8 F6 F6 F6 A1 F6 11 03 55 47 31 23 F6 F6 5B 64 85 36 36 36 C1 0e
40 70 00 00 00 40 04 00 01 01 24 00 00 00 00 00 00 00 00 00 00 00 00 00 13 13 13
13 13 13 00 07
			39 00 00 43 EA 51 13 00 00 00 00 00 40 00 00 00 00 00 00
0d 00 00 00 00 00 00 00 00 0f 03 00 00 00 3c 70 01 21 00 40 80 c0 00 00 01 23 45
67 89 ab cd ef 33 33 33 22 33 00 00 00 00 11 11 33 33 DD DD 22 CC CC CC 33
			39 00 00 18 ED 00 01 00 00 00 00 00 00 00 00 00 00 00 00
00 00 00 00 00 00 00 00 40
			39 00 00 14 EE 22 00 02 02 0F 40 00 07 00 04 00 00 00 B9
77 00 55 05 1F
			39 00 00 21 EB A3 CF 66 18 54 55 55 55 55 50 A9 6A 55 AA
56 25 0D 0F 00 00 00 00 00 55 55 55 55 32 3E 55 43 55
			39 00 00 7B C7 00 1A 00 27 00 3A 00 56 00 74 00 82 00 9B
00 AF 00 B7 00 EE 01 15 01 56 01 8B 01 DB 02 1A 02 1C 02 50 02 97 02 BF 02 F2 03
18 03 44 03 54 03 60 03 74 03 80 03 A0 03 B2 03 E0 03 d0 00 17 00 27 00 3A 00 56
00 74 00 82 00 9B 00 AF 00 B7 00 EE 01 15 01 56 01 8B 01 DB 02 1A 02 1C 02 57 02
97 02 BF 02 F2 03 18 03 44 03 54 03 60 03 74 03 80 03 A0 03 B2 03 E0 03 d0 01 01
			23 00 00 02 35 00
			23 00 00 02 36 00
			39 00 00 04 C1 04 00 01
			13 78 00 01 11
			39 00 00 06 D7 00 00 00 81 07
			13 14 00 01 29
			];
		sleep-in = [
			13 14 00 01 28
			13 78 00 01 10
			];
		sleep-out = [
			13 78 00 01 11
			13 14 00 01 29
			];

		display-timings {
			clock-frequency = <925000>;
			hactive = <1080>;
			vactive = <1920>;
			hback-porch = <80>;
			hfront-porch = <80>;
			vback-porch = <35>;
			vfront-porch = <35>;
			hsync-len = <10>;
			vsync-len = <4>;
		};
	};
};};

