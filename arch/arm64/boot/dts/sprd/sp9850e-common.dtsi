/*
 * Spreadtrum SP9850E board common DTS file
 *
 * Copyright (C) 2017, Spreadtrum Communications Inc.
 *
 * This file is licensed under a dual GPLv2 or X11 license.
 */

#include "sc9850e.dtsi"
#include "sharkle-board-common.dtsi"
/ {
	/* cp_reserved = cp region + debug region */
	/* debug region: not reserved in normal mode, it */
	/* will be proccessed in u-boot */
	reserved-memory {
		cp_reserved: cp-modem@89600000 {
			reg = <0x0 0x89600000 0x0 0x04c00000>;
			/* This prop specifies the size of debug region */
			/* in the cp tail */
			sprd,cpdbg-size = <0x280000>;
		};
	};
};
