/ { lcds {
	lcd_otm1901_mipi_fhd: lcd1901@1901 {

		work-mode = <1>;
		bpp = <24>;
		lane-number = <4>;

		hsync-pol = <0>;
		vsync-pol = <0>;
		de-pol = <0>;
		te-pol = <0>;
		color_mode_pol = <1>;
		shut_down_pol = <1>;

		need-check-esd = <1>;
		esd-timeout = <2000>;
		esd-check-reg = <0xA>;
		esd-return-code = <0x9c>;

		fps = <60>;
		direction = <0>;
		width-mm = <68>;
		height-mm = <121>;
		low-res-simu = <0>;
		simu-width = <480>;
		simu-height = <854>;
		panel-name = "lcd_rouyu_otm1901_mipi_fhd";

		power-on-sequence = <
				31  1  5
				32  1  5
				126  1  20
				126  0  20
				126  1  120
				>;
		power-off-sequence = <
				32  0  5
				31  0  5
				126  0  20
				>;

		init-data = [
			39 00 00 02 00 00
			39 00 00 04 FF 19 01 01
			39 00 00 02 00 80
			39 00 00 03 FF 19 01
			39 00 00 02 00 00
			39 00 00 02 1C 33
			39 00 00 02 00 A0
			39 00 00 02 C1 E8
			39 00 00 02 00 A7
			39 00 00 02 C1 00
			39 00 00 02 00 90
			39 00 00 07 C0 00 2F 00 00 00 01
			39 00 00 02 00 C0
			39 00 00 07 C0 00 2F 00 00 00 01
			39 00 00 02 00 9A
			39 00 00 02 C0 1E
			39 00 00 02 00 AC
			39 00 00 02 C0 06
			39 00 00 02 00 DC
			39 00 00 02 C0 06
			39 00 00 02 00 92
			39 00 00 02 E9 00
			39 00 00 02 00 90
			39 00 00 02 F3 01
			39 00 00 02 00 93
			39 00 00 02 C5 1E
			39 00 00 02 00 95
			39 00 00 02 C5 32
			39 00 00 02 00 97
			39 00 00 02 C5 19
			39 00 00 02 00 99
			39 00 00 02 C5 1E
			39 00 00 02 00 9B
			39 00 00 04 C5 22 20 55
			39 00 00 02 00 00
			39 00 00 03 D9 00 AA
			39 00 00 02 00 00
			39 00 00 03 D8 23 23
			39 00 00 02 00 B3
			39 00 00 02 C0 CC
			39 00 00 02 00 BC
			39 00 00 02 C0 00
			39 00 00 02 00 84
			39 00 00 02 C4 22
			39 00 00 02 00 80
			39 00 00 02 C4 16
			39 00 00 02 00 80
			39 00 00 0F C0 00 7C 00 08 08 00 7C 08 08 00 7C 00 08 08
			39 00 00 02 00 F0
			39 00 00 07 C3 22 00 00 00 00 0C
			39 00 00 02 00 A0
			39 00 00 08 C0 00 00 1E 00 00 17 06
			39 00 00 02 00 D0
			39 00 00 08 C0 00 00 1E 00 00 17 06
			39 00 00 02 00 90
			39 00 00 09 C2 83 01 74 36 82 01 74 36
			39 00 00 02 00 A0
			39 00 00 05 C2 83 00 00 D0
			39 00 00 02 00 80
			39 00 00 0D C3 82 02 03 00 13 04 81 02 03 00 13 04
			39 00 00 02 00 90
			39 00 00 0D C3 80 02 03 00 13 04 01 02 03 00 13 04
			39 00 00 02 00 80
			39 00 00 10 CC 09 0A 11 12 13 14 15 16 17 18 0B 28 28 28 28
			39 00 00 02 00 90
			39 00 00 10 CC 0A 09 14 13 12 11 15 16 17 18 0B 28 28 28 28
			39 00 00 02 00 A0
			39 00 00 10 CC 1D 1E 1F 19 1A 1B 1C 20 21 22 23 24 25 26 27
			39 00 00 02 00 B0
			39 00 00 09 CC 01 02 03 05 06 07 04 08
			39 00 00 02 00 C0
			39 00 00 0D CC 00 00 00 00 00 00 00 00 00 00 00 77
			39 00 00 02 00 D0
			39 00 00 0D CC FF 0F 30 00 05 00 00 00 33 03 00 77
			39 00 00 02 00 80
			39 00 00 10 CB 00 00 00 00 00 00 00 00 00 00 CF 00 00 00 00
			39 00 00 02 00 90
			39 00 00 10 CB 00 00 FF 00 00 00 00 00 00 00 00 00 00 00 00
			39 00 00 02 00 A0
			39 00 00 10 CB 15 15 15 15 15 15 00 00 00 00 EA 00 00 00 00
			39 00 00 02 00 B0
			39 00 00 10 CB 00 15 D5 00 00 00 00 00 00 00 00 00 00 00 00
			39 00 00 02 00 C0
			39 00 00 09 CB 00 00 00 00 00 00 77 77
			39 00 00 02 00 D0
			39 00 00 09 CB 00 00 00 00 00 00 77 77
			39 00 00 02 00 E0
			39 00 00 09 CB 00 00 00 00 00 00 77 77
			39 00 00 02 00 F0
			39 00 00 09 CB 11 11 11 00 00 00 77 77
			39 00 00 02 00 80
			39 00 00 10 CD 3F 3F 3F 3F 3F 3F 3F 3F 3F 06 04 0B 11 12 02
			39 00 00 02 00 90
			39 00 00 0C CD 3F 3F 3F 25 25 25 21 20 1F 25 25
			39 00 00 02 00 A0
			39 00 00 10 CD 3F 3F 3F 3F 3F 3F 3F 3F 3F 05 03 0B 11 12 01
			39 00 00 02 00 B0
			39 00 00 0C CD 3F 3F 3F 25 25 25 21 20 1F 25 25
			39 00 00 02 00 00
			39 00 00 19 E1 1a 1f 22 2a 30 36 40 50 58 6a 77 80 79 73 6e 5e 4c 3a 2d 25 1c 0f 07 03
			39 00 00 02 00 00
			39 00 00 19 E2 1a 1f 22 2a 30 36 40 50 58 6a 77 80 79 73 6e 5e 4c 3a 2d 25 1c 0f 07 03
			39 00 00 02 00 00
			39 00 00 19 E3 1a 1f 22 2a 30 36 40 50 58 6a 77 80 79 73 6e 5e 4c 3a 2d 25 1c 0f 07 03
			39 00 00 02 00 00
			39 00 00 19 E4 1a 1f 22 2a 30 36 40 50 58 6a 77 80 79 73 6e 5e 4c 3a 2d 25 1c 0f 07 03
			39 00 00 02 00 00
			39 00 00 19 E5 1a 1f 22 2a 30 36 40 50 58 6a 77 80 79 73 6e 5e 4c 3a 2d 25 1c 0f 07 03
			39 00 00 02 00 00
			39 00 00 19 E6 1a 1f 22 2a 30 36 40 50 58 6a 77 80 79 73 6e 5e 4c 3a 2d 25 1c 0f 07 03
			39 00 00 02 00 D4
			39 00 00 05 C3 01 01 01 01
			39 00 00 02 00 F7
			39 00 00 05 C3 04 16 00 00
			39 00 00 02 00 D0
			39 00 00 05 F5 00 00 00 00
			39 00 00 02 00 81
			39 00 00 02 A5 06
			39 00 00 02 00 82
			39 00 00 02 C4 f0
			39 00 00 02 00 84
			39 00 00 02 C4 22
			39 00 00 02 00 92
			39 00 00 02 C5 c0
			39 00 00 02 00 94
			39 00 00 02 C5 90
			39 00 00 02 00 c1
			39 00 00 02 C5 66
			39 00 00 02 00 89
			39 00 00 02 F3 5A
			39 00 00 02 00 90
			39 00 00 02 F3 01
			39 00 00 02 00 82
			39 00 00 02 A5 1F
			39 00 00 02 00 C2
			39 00 00 02 C5 1E
			39 00 00 02 00 A8
			39 00 00 02 C4 12
			39 00 00 02 00 A0
			39 00 00 05 C4 30 26 04 3A
			39 00 00 02 00 A4
			39 00 00 05 C4 30 26 84 3A
			39 00 00 02 00 E1
			39 00 00 02 F5 45
			39 00 00 02 00 A8
			39 00 00 02 C4 12
			39 78 00 02 11 00
			39 32 00 02 29 00
		];
		sleep-in = [
			13 0A 00 01 28
			13 78 00 01 10
			];
		sleep-out = [
			13 78 00 01 11
			13 32 00 01 29
			];
		esd-check = [
			37 00 00 02 02 00
			];
		read-id = [
			37 00 00 02 02 00
			];
		display-timings {
			clock-frequency = <979800>;
			hactive = <1080>;
			vactive = <1920>;
			hback-porch = <37>;
			hfront-porch = <143>;
			vback-porch = <26>;
			vfront-porch = <50>;
			hsync-len = <20>;
			vsync-len = <4>;
			hsync-active = <0>;
			vsync-active = <0>;
			de-active = <0>;
			pixelclk-active = <1>;
		};
	};
};};
