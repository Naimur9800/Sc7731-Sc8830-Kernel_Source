/ { lcds {
	lcd_otm1906c_mipi_fhd: lcd1906@1906 {

		work-mode = <1>;
		bpp = <24>;
		lane-number = <4>;

		need-check-esd = <0>;
		esd-timeout = <2000>;
		esd-check-reg = <0xA>;
		esd-return-code = <0x9c>;

		fps = <56>;
		width-mm = <68>;
		height-mm = <121>;
		panel-name = "lcd_otm1906c_mipi_fhd";

		power-on-sequence = <
					171  1  10
					172  1  20
					126  1  20
					126  0  20
					126  1  120
					>;
		power-off-sequence = <
					172  0  20
					171  0  10
					126  0  20
					>;

		init-data = [
			39 00 00 02 00 00
			39 00 00 04 FF 19 06 01
			39 00 00 02 00 80
			39 00 00 03 FF 19 06
			39 00 00 02 00 A0
			39 00 00 04 C1 00 C0 10
			39 00 00 02 00 91
			39 00 00 03 C5 14 1e
			39 00 00 02 00 85
			39 00 00 02 C5 14
			39 00 00 02 00 86
			39 00 00 02 C5 14
			39 00 00 02 00 95
			39 00 00 02 C5 11
			39 00 00 02 00 00
			39 00 00 02 D9 00
			39 00 00 02 00 01
			39 00 00 02 D9 cd
			39 00 00 02 00 02
			39 00 00 02 D9 00
			39 00 00 02 00 03
			39 00 00 02 D9 cd
			39 00 00 02 00 04
			39 00 00 02 D9 00
			39 00 00 02 00 05
			39 00 00 02 D9 cd
			39 00 00 02 00 06
			39 00 00 02 D9 00
			39 00 00 02 00 07
			39 00 00 02 D9 cd
			39 00 00 02 00 81
			39 00 00 02 A5 01
			39 00 00 02 00 A5
			39 00 00 02 C5 11
			39 00 00 02 00 90
			39 00 00 05 F5 09 16 09 16
			39 00 00 02 00 A7
			39 00 00 02 F5 1A
			39 00 00 02 00 9D
			39 00 00 02 F5 1A
			39 00 00 02 00 A5
			39 00 00 02 F5 16
			39 00 00 02 00 8D
			39 00 00 02 F5 17
			39 00 00 02 00 E3
			39 00 00 02 F5 11
			39 00 00 02 00 ED
			39 00 00 02 F5 16
			39 00 00 02 00 E5
			39 00 00 02 F5 16
			39 00 00 02 00 81
			39 00 00 02 F5 16
			39 00 00 02 00 83
			39 00 00 02 F5 16
			39 00 00 02 00 E1
			39 00 00 02 F5 16
			39 00 00 02 00 C0
			39 00 00 10 CC 0c 0c 00 00 0c 0c 0c 0c 00 00 00 00 00 00 00
			39 00 00 02 00 D0
			39 00 00 10 CC 00 00 00 00 00 00 00 00 00 00 00 33 33 33 33
			39 00 00 02 00 E0
			39 00 00 10 CC 33 33 00 00 00 00 00 00 00 00 00 00 00 00 00
			39 00 00 02 00 80
			39 00 00 03 C1 55 55
			39 00 00 02 00 94
			39 00 00 02 C5 22
			39 00 00 02 00 A4
			39 00 00 02 C5 22
			39 00 00 02 00 C1
			39 00 00 02 C5 00
			39 00 00 02 00 B3
			39 00 00 02 C0 88
			39 00 00 02 00 B4
			39 00 00 02 C0 00
			39 00 00 02 00 E0
			39 00 00 02 C5 01
			39 00 00 02 00 00
			39 00 00 03 D8 23 23
			39 00 00 02 00 80
			39 00 00 02 C4 31
			39 00 00 02 00 A0
			39 00 00 02 B3 33
			39 00 00 02 00 A6
			39 00 00 02 B3 30
			39 00 00 02 00 E0
			39 00 00 0b B4 1C 19 3F 01 64 5C 01 A0 5F A0
			39 00 00 02 00 F0
			39 00 00 02 B4 64
			39 00 00 02 00 80
			39 00 00 0f C0 00 70 00 0A 0A 00 70 0A 0A 00 70 00 0A 0A
			39 00 00 02 00 90
			39 00 00 07 C0 00 00 00 02 00 04
			39 00 00 02 00 A0
			39 00 00 10 C0 00 00 02 00 04 15 04 00 00 00 00 00 00 00 00
			39 00 00 02 00 D0
			39 00 00 10 C0 00 00 02 00 04 15 04 00 00 00 00 00 00 00 00
			39 00 00 02 00 80
			39 00 00 0d C2 83 01 00 00 82 01 00 00 00 00 00 00
			39 00 00 02 00 90
			39 00 00 0d C2 00 00 00 00 00 00 00 00 00 00 00 00
			39 00 00 02 00 A0
			39 00 00 0e C2 00 00 00 00 00 00 00 00 00 00 00 00 00
			39 00 00 02 00 B0
			39 00 00 10 C2 82 02 00 00 88 81 02 00 00 88 00 02 00 00 88
			39 00 00 02 00 C0
			39 00 00 10 C2 01 02 00 00 88 00 00 00 00 00 00 00 00 00 00
			39 00 00 02 00 D0
			39 00 00 10 C2 00 00 00 00 00 00 00 00 00 00 33 33 33 33 00
			39 00 00 02 00 80
			39 00 00 10 C3 00 00 00 00 00 00 00 00 00 00 00 00 00 00 00
			39 00 00 02 00 A0
			39 00 00 0d C3 83 01 00 00 82 01 00 00 00 00 00 00
			39 00 00 02 00 B0
			39 00 00 0f C3 00 00 00 00 82 02 00 00 88 81 02 00 00 88
			39 00 00 02 00 C0
			39 00 00 10 C3 00 02 00 00 88 01 02 00 00 88 00 00 00 00 00
			39 00 00 02 00 D0
			39 00 00 10 C3 00 00 00 00 00 00 00 00 00 00 00 00 00 00 00
			39 00 00 02 00 E0
			39 00 00 06 C3 33 33 33 33 00
			39 00 00 02 00 80
			39 00 00 0c CB 00 00 00 00 30 00 03 00 00 00 70
			39 00 00 02 00 90
			39 00 00 10 CB 00 00 00 00 00 00 00 00 00 00 00 00 00 00 00
			39 00 00 02 00 A0
			39 00 00 10 CB 00 00 00 BF 00 00 00 00 00 FF 00 00 00 00 00
			39 00 00 02 00 B0
			39 00 00 0d CB 00 00 00 00 00 00 00 00 00 00 77 77
			39 00 00 02 00 C0
			39 00 00 10 CB 01 01 01 01 01 01 01 01 01 01 01 01 01 01 01
			39 00 00 02 00 D0
			39 00 00 10 CB 01 01 01 F3 01 01 01 01 00 F3 00 00 01 00 01
			39 00 00 02 00 E0
			39 00 00 0d CB 00 01 00 01 00 01 00 01 00 00 77 07
			39 00 00 02 00 F0
			39 00 00 0c CB FF FF FF FF FF FF 03 33 03 00 70
			39 00 00 02 00 80
			39 00 00 0d CC 08 09 18 19 0C 0D 0E 0F 07 07 07 07
			39 00 00 02 00 90
			39 00 00 0d CC 09 08 19 18 0F 0E 0D 0C 07 07 07 07
			39 00 00 02 00 A0
			39 00 00 10 CC 14 15 16 17 1C 1D 1E 1F 01 04 20 07 07 07 00
			39 00 00 02 00 B0
			39 00 00 0a CC 01 02 03 04 05 06 07 07 00
			39 00 00 02 00 80
			39 00 00 10 CD 1A 01 11 12 1A 05 18 07 1A 1A 23 23 23 1F 1E
			39 00 00 02 00 90
			39 00 00 04 CD 1D 23 23
			39 00 00 02 00 A0
			39 00 00 10 CD 1A 02 11 12 1A 06 18 08 1A 1A 23 23 23 1F 1E
			39 00 00 02 00 B0
			39 00 00 04 CD 1D 23 23
			39 00 00 02 00 80
			39 00 00 0b A4 AF 00 20 04 00 17 15 03 60 00
			39 00 00 02 00 90
			39 00 00 04 A4 00 00 00
			39 00 00 02 00 80
			39 00 00 0d A7 FF 0F 1E 00 20 00 01 98 00 00 00 00
			39 00 00 02 00 90
			39 00 00 0b A7 1d 20 3d 00 00 BE 90 CE 05 F0
			39 00 00 02 00 A0
			39 00 00 02 A7 30
			39 00 00 02 00 B0
			39 00 00 06 A7 00 1E 1E 00 00
			39 00 00 02 00 C0
			39 00 00 0d A7 FF 0F 1E 00 1F 00 01 18 00 00 00 00
			39 00 00 02 00 D0
			39 00 00 0b A7 FF FF 1C 00 01 7C 81 7C 0B E0
			39 00 00 02 00 E0
			39 00 00 02 A7 30
			39 00 00 02 00 F0
			39 00 00 06 A7 00 3C 3C 00 00
			39 00 00 02 00 D0
			39 00 00 0b A7 FF FF 1D 00 01 7C 81 7C 0B E0
			39 00 00 02 00 80
			39 00 00 0d A9 00 00 00 00 00 00 00 00 00 00 00 00
			39 00 00 02 00 90
			39 00 00 0b A9 00 00 00 00 00 00 00 00 00 00
			39 00 00 02 00 A0
			39 00 00 02 A9 00
			39 00 00 02 00 B0
			39 00 00 06 A9 00 00 00 00 00
			39 00 00 02 00 C0
			39 00 00 0f A9 FF 3A 49 00 1E 00 01 00 00 00 00 00 00 77
			39 00 00 02 00 D0
			39 00 00 0b A9 FF FF 1D 00 01 7C 81 7C 0B E0
			39 00 00 02 00 E0
			39 00 00 02 A9 30
			39 00 00 02 00 F0
			39 00 00 06 A9 00 3C 3C 00 00
			39 00 00 02 00 B0
			39 00 00 09 A4 05 F0 0B E0 00 00 0B E0
			39 00 00 02 00 80
			39 00 00 10 AB 05 14 00 00 FF 6A 00 00 00 00 00 00 00 00 00
			39 00 00 02 00 A0
			39 00 00 10 AB 00 00 00 00 00 00 00 07 00 00 00 00 01 00 00
			39 00 00 02 00 B0
			39 00 00 0d AB 00 00 68 0A 00 00 44 04 00 00 00 00
			39 00 00 02 00 93
			39 00 00 02 B3 01
			39 00 00 02 00 80
			39 00 00 08 CE 00 00 00 00 00 00 00
			39 00 00 02 00 87
			39 00 00 08 CE 00 00 33 00 33 00 00
			39 00 00 02 00 F0
			39 00 00 05 CE 00 00 00 00
			39 00 00 02 00 90
			39 00 00 10 CE 00 00 00 F0 00 00 00 00 FC 00 FC 00 00 00 00
			39 00 00 02 00 A0
			39 00 00 08 CE 00 00 40 40 40 00 00
			39 00 00 02 00 B0
			39 00 00 10 CE 01 01 01 01 01 01 01 01 F1 01 F1 01 01 01 01
			39 00 00 02 00 C0
			39 00 00 08 CE 01 01 01 01 01 01 01
			39 00 00 02 00 D0
			39 00 00 10 CE 04 04 04 04 04 04 04 04 F7 04 F7 04 04 00 00
			39 00 00 02 00 E0
			39 00 00 08 CE 00 00 15 15 15 04 04
			39 00 00 02 00 F4
			39 00 00 02 CE 25
			39 00 00 02 00 A0
			39 00 00 0d D6 00 00 00 00 00 00 00 00 00 00 00 00
			39 00 00 02 00 B0
			39 00 00 0d D6 fd fd fd fd fd fd fd fd fd fd fd fd
			39 00 00 02 00 C0
			39 00 00 0d D6 a9 a9 a9 a9 a9 a9 a9 a9 a9 a9 a9 a9
			39 00 00 02 00 D0
			39 00 00 0d D6 54 54 54 54 54 54 54 54 54 54 54 54
			39 00 00 02 00 00
			39 00 00 02 81 81
			39 00 00 02 00 00
			39 00 00 19 e1 00 0B 14 1F 28 31 3C 4E 59 6C 79 84 74 6C 63 56 44 32 28 1F 16 0A 04 00
			39 00 00 02 00 00
			39 00 00 19 e2 00 0B 14 1F 28 31 3C 4E 59 6C 79 84 74 6C 63 56 44 32 28 1F 16 0A 04 00
			39 00 00 02 00 00
			39 00 00 19 e3 00 0B 14 1F 28 31 3C 4E 59 6C 79 84 74 6C 63 56 44 32 28 1F 16 0A 04 00
			39 00 00 02 00 00
			39 00 00 19 e4 00 0B 14 1F 28 31 3C 4E 59 6C 79 84 74 6C 63 56 44 32 28 1F 16 0A 04 00
			39 00 00 02 00 00
			39 00 00 19 e5 00 0B 14 1F 28 31 3C 4E 59 6C 79 84 74 6C 63 56 44 32 28 1F 16 0A 04 00
			39 00 00 02 00 00
			39 00 00 19 e6 00 0B 14 1F 28 31 3C 4E 59 6C 79 84 74 6C 63 56 44 32 28 1F 16 0A 04 00
			39 00 00 02 00 C1
			39 00 00 02 C5 75
			39 00 00 02 00 D6
			39 00 00 05 F5 00 00 00 00
			39 00 00 02 00 A7
			39 00 00 09 c0 33 33 33 33 33 33 33 33
			39 00 00 02 00 D7
			39 00 00 09 c0 33 33 33 33 33 33 33 33
			39 00 00 02 00 99
			39 00 00 02 C4 03
			39 00 00 02 00 80
			39 00 00 02 C4 61
			39 00 00 02 00 94
			39 00 00 02 C5 67
			39 00 00 02 00 A4
			39 00 00 02 C5 67

			39 00 00 02 00 00
			39 00 00 02 1C 32

			39 00 00 02 00 80
			39 00 00 03 FF 00 00
			39 00 00 02 00 00
			39 00 00 04 FF 00 00 00
			39 78 00 02 11 00
			39 05 00 02 29 00
		];
		sleep-in = [
			13 0A 00 01 28
			13 78 00 01 10
			//23 00 00 02 4F 01
			];
		sleep-out = [
			13 78 00 01 11
			13 32 00 01 29
			];

		display-timings {
			clock-frequency = <964600>;
			hactive = <1080>;
			vactive = <1920>;
			hback-porch = <36>;
			hfront-porch = <36>;
			vback-porch = <16>;
			vfront-porch = <16>;
			hsync-len = <8>;
			vsync-len = <4>;
		};
	};
};};
