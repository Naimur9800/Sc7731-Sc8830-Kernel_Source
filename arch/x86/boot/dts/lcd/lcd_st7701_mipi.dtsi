/ { lcds {
	lcd_st7701_mipi_hd: lcd7701@7701 {

		work-mode = <1>;
		bpp = <24>;
		lane-number = <4>;

		need-check-esd = <0>;
		esd-timeout = <2000>;
		esd-check-reg = <0xA>;
		esd-return-code = <0x9c>;

		fps = <60>;
		width-mm = <68>;
		height-mm = <121>;
		panel-name = "lcd_st7701_mipi_hd";

		power-on-sequence = <
					31 1 10
					32 1 20
					126 1 20
					126 0 20
					126 1 120
					118 1 20
					>;
		power-off-sequence = <
					32 0 20
					31 0 10
					126 1 20
					>;

		init-data = [
			39 00 00 06 F0 46 23 11 01 01
			23 00 00 02 B1 15
			23 00 00 02 B2 15
			39 00 00 11 B3 05 00 00 00 00 00 00 00 0C 00
			00 00 00 00 00 00
			39 00 00 11 B4 0f 00 00 00 00 00 00 00 08 00
			00 00 00 00 00 00
			39 00 00 03 B5 00 00
			39 00 00 05 B7 44 00 00 00
			39 00 00 05 B8 54 00 00 00
			23 00 00 02 B9 00
			39 00 00 04 C3 00 90 00
			39 00 00 04 C4 00 90 00
			23 00 00 02 CA 20
			39 00 00 0b CB 9F C0 C7 EC 0C 08 CC 20 20 00
			39 00 00 3D D1 00 00 00 00 00 2B 00 3F 00 5E
			00 72 00 83 00 94 00 A1 00 D1
			00 F7 01 2D 01 58 01 9C 01 D6
			01 D8 02 16 02 63 02 94 02 D3
			02 FC 03 2E 03 3D 03 4D 03 5E
			03 71 03 86 03 9E 03 B8 03 C7
			39 00 00 3D D2 00 00 00 00 00 2B 00 3F 00 5E
			00 72 00 83 00 94 00 A1 00 D1
			00 F7 01 2D 01 58 01 9C 01 D6
			01 D8 02 16 02 63 02 94 02 D3
			02 FC 03 2E 03 3D 03 4D 03 5E
			03 71 03 86 03 9E 03 B8 03 C7
			39 00 00 3D D3 00 00 00 00 00 2B 00 3F 00 5E
			00 72 00 83 00 94 00 A1 00 D1
			00 F7 01 2D 01 58 01 9C 01 D6
			01 D8 02 16 02 63 02 94 02 D3
			02 FC 03 2E 03 3D 03 4D 03 5E
			03 71 03 86 03 9E 03 B8 03 C7
			39 00 00 3D D4 00 0E 00 19 00 45 00 58 00 76
			00 88 00 99 00 A8 00 B4 00 E0
			01 00 01 35 01 5E 01 9F 01 D6
			01 D8 02 12 02 5A 02 89 02 C5
			02 EE 03 1F 03 2D 03 3D 03 4E
			03 60 03 75 03 8D 03 A7 03 B5
			39 00 00 3D D5 00 0E 00 19 00 45 00 58 00 76
			00 88 00 99 00 A8 00 B4 00 E0
			01 00 01 35 01 5E 01 9F 01 D6
			01 D8 02 12 02 5A 02 89 02 C5
			02 EE 03 1F 03 2D 03 3D 03 4E
			03 60 03 75 03 8D 03 A7 03 B5
			39 00 00 3D D6 00 0E 00 19 00 45 00 58 00 76
			00 88 00 99 00 A8 00 B4 00 E0
			01 00 01 35 01 5E 01 9F 01 D6
			01 D8 02 12 02 5A 02 89 02 C5
			02 EE 03 1F 03 2D 03 3D 03 4E
			39 00 00 06 F0 46 23 11 01 00
			39 00 00 08 B2 00 9B 31 42 07 FF 00
			23 00 00 02 B3 E9
			39 00 00 05 BA 0F 90 30 59
			39 00 00 05 BB 05 69 09 02
			39 00 00 03 BC 00 80
			39 00 00 07 BD C6 00 00 20 00 30
			39 00 00 05 BE 01 04 0F FF
			23 00 00 02 BF 0A
			39 00 00 03 C0 02 80
			39 00 00 03 C1 10 00
			39 00 00 03 C2 18 07
			39 00 00 05 C3 00 18 18 18
			39 00 00 05 C5 01 01 C0 00
			39 00 00 05 C7 3D FA 08 55
			39 00 00 48 C9 09 01 2A 02 04 08 00 09 40 04
			02 00 07 01 90 E0 01 03 03 03
			01 08 01 90 E0 00 04 02 00 01
			08 11 80 20 01 01 01 01 01 08
			11 80 20 00 02 E4 EA E4 E4 E4
			E4 3F CC CC CC 8A CC 00 55 00
			00 00 00 00 02 15 16 02 16 16 16
			39 00 00 12 CA 00 00 00 00 00 00 00 00 00 00
			00 00 00 00 00 00 00
			39 00 00 2F CB 00 02 00 11 80 20 66 00 02 11
			80 80 66 00 02 11 80 80 06 05
			03 00 05 05 00 04 00 00 00 00
			00 00 00 00 01 01 01 66 01 03 66 01 03 00 12 0F
			39 00 00 19 CC 30 01 81 00 00 11 80 20 01 03
			00 20 00 00 00 00 00 00 80 01 00 02 00 00
			39 00 00 16 CD 12 10 00 00 00 00 10 10 08 08
			31 00 00 10 12 10 81 40 00 00 01
			39 00 00 44 CE 54 55 58 59 00 00 00 00 08 08
			04 05 06 07 6E 6F 6A 6B 6C 6D
			68 69 08 08 00 00 00 00 00 00
			00 00 00 00 00 00 50 51 00 00
			00 00 00 00 00 00 00 00 00 00
			00 00 00 00 00 00 00 00 00 00 00 00 00 00 00 00 00
			23 00 00 02 EE 71
			39 00 00 0a EF 00 51 2C 74 02 18 84 84 70
			39 00 00 06 FA 00 00 64 00 00
			39 00 00 06 F0 46 23 11 01 01
			23 00 00 02 BC 01
			23 00 00 02 35 01
			39 00 00 03 44 00 00
			23 78 00 02 11 00
			23 36 00 02 29 00
			23 00 00 02 51 FF
			23 00 00 02 53 2E
			23 00 00 02 55 00
			];
		sleep-in = [
			13 0A 00 01 28
			13 78 00 01 10
			];
		sleep-out = [
			13 78 00 01 11
			13 32 00 01 29
			];

		display-timings {
			clock-frequency = <500000>;
			hactive = <720>;
			vactive = <1280>;
			hback-porch = <32>;
			hfront-porch = <32>;
			vback-porch = <40>;
			vfront-porch = <22>;
			hsync-len = <4>;
			vsync-len = <3>;
		};
	};
};};
