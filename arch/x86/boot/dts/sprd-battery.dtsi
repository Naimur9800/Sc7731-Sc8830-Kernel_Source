/*
* Copyright (C) 2015 Spreadtrum Communication Incorporated
*		http://www.spreadtrum.com/
*  This file is licensed under a dual GPLv2 or X11 license.
*
* This program is free software; you can redistribute it and/or modify
* it under the terms of the GNU General Public License version 2 as
* published by the Free Software Foundation.
*/

/* This is the sprd battery default DTS */
/{
	battery: battery {
		compatible = "sprd,sprd-battery";
		status = "disabled";
		chg-end-vol = <4200>;
		chg-end-vol-check = <4190>;
		chg-bat-safety-vol = <4280>;
		fchg-vol = <9000>;
		rechg-vol = <4131>;
		adp-cdp-cur = <700>;
		adp-dcp-cur = <700>;
		adp-sdp-cur = <450>;
		adp-unknown-cur = <450>;
		adp-fchg-cur = <3000>;
		adp-cdp-cur-limit = <1500>;
		adp-dcp-cur-limit = <3000>;
		adp-sdp-cur-limit = <500>;
		adp-fchg-cur-limit = <2000>;
		adp-unknown-cur-limit = <500>;
		ovp-stop = <6500>;
		ovp-restart = <5800>;
		fchg-ovp-stop = <11000>;
		fchg-ovp-restart = <10000>;
		chg-timeout = <21600>;
		chg-rechg-timeout = <5400>;
		chg-end-cur = <120>;
		chg-polling-time = <15>;
		chg-polling-time-fast = <1>;
		cap-one-per-time = <30>;
		/*0 vol and cur,1 status and cur,2 ext ic*/
		chg-full-condition = <0>;
		temp-support = <0>;
		/*30mohm,if temp-table-mode = <1>, use it*/
		temp-comp-res = <6>;
		temp-tab-val = <1052 953 858 762 671 584
				504 434 372 318 271 234
				198 165 140 119 104 88>;
		/* temperature + 1000,750 = 1000 + (-250)*/
		temp-tab-temp = <750 800 850 900 950 1000
				 1050 1100 1150 1200 1250 1300
				 1350 1400 1450 1500 1550 1600>;
		jeita-temp-tab = <900 1000 1100 1450 1500>;
		jeita-temp-recovery-tab = <930 1030 1130 1420 1470>;
		jeita-cur-tab = <0 100 500 0x7FFF 700 0>;
		jeita-cccv-tab = <4200 4200 4350 4350 4350 4350>;
		only-vol-mode = <0>;
		fgu-mode = <0>;
		alm-soc = <5>;
		alm-vol = <3450>;
		soft-vbat-uvlo = <3050>;
		rint = <250>;
		cnom = <1900>;
		rsense-real = <215>;
		rsense-spec = <200>;
		relax-current = <50>;
		fgu-cal-ajust = <0>;
		ocv-tab-vol = <4185 4113 4066 4022 3983 3949 3917
				3889 3864 3835 3805 3787 3777 3773
				3770 3765 3752 3724 3680 3605 3400>;
		ocv-tab-cap = <100 95 90 85 80 75 70 65 60 55
				50 45 40 35 30 25 20 15 10 5 0>;
		charge-vol-tab = <4180 4130 4100 4060 4030 4000 3959
				3930 3904 3880 3860 3840 3830 3810
				3790 3780 3730 3690 3565 3510 3400>;
		charge-vol-tab-cap = <100 95 90	85 80 75 70
				65 60 55 50 45 40 35 30 25 20 15 10 5 0>;
		discharge-vol-tab = <4150 4100 4050 4020 4000 3970 3940
				3910 3880 3850 3820 3790 3770 3755
				3750 3715 3680 3650 3600 3510 3400>;
		discharge-vol-tab-cap = <100 95 90 85 80 75 70
				65 60 55 50 45 40 35 30 25 20 15 10 5 0>;
		cnom-temp-tab = <1020 1800	/*value = 1000 + temp*/
				1010 1300
				1000 1070
				990  1000>;
		rint-temp-tab = <1020 200	/*value = 1000 + temp*/
				1010 450
				1000 650
				990  1100>;
		};
};

