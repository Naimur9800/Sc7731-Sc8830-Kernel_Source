## drivers/ontim/gsensor/Kconfig
```kconfig
#
# ontim g-sensor driver configuration
#

config GSENSOR_LIS3DH_I2C
	tristate "lis3dh g-sensor"
	depends on  I2C
	default n

config GSENSOR_MMA845X
	tristate "lis3dh g-sensor"
	depends on  I2C
	default n

config GSENSOR_KIONIX
	tristate "kionix g-sensor"
	depends on  I2C
	default n

config GSENSOR_MC3XXX_ONTIM
 	tristate "mCube mc3xxx 3-Axis accelerometer device with I2C bus"
 	depends on I2C
 	default n

config GSENSOR_MIR3DA_ONTIM
 	tristate "mCube mir3da 3-Axis accelerometer device with I2C bus"
 	depends on I2C
 	default n
 	
	help
	  Say Y here if you have a mc3xxx device on the board and use I2C
	  communication, else say N.

	  To compile this driver as a module, choose M here.

source "drivers/ontim/gsensor/bma2x2/Kconfig"
```

## drivers/ontim/light_prox/Kconfig
```kconfig
#
# light and proximity driver configuration
#

config LIGHT_PROXIMITY_TMD22713T
	tristate "tmd22713t light and proximity sensor"
	depends on  I2C
	default n

config LIGHT_PROXIMITY_RPR0400
        tristate "RPR0400 light and proximity sensor"
        depends on  I2C
	default n

config LIGHT_PROXIMITY_LTR553
        tristate "ltr553 light and proximity sensor"
        depends on  I2C
	default n

config LIGHT_PROXIMITY_STK3311
        tristate "skt3311 light and proximity sensor"
        depends on  I2C
	default n
```

## drivers/ontim/touchscreen/Kconfig
```kconfig
source "drivers/ontim/touchscreen/focaltech/Kconfig"
source "drivers/ontim/touchscreen/goodix/Kconfig"
source "drivers/ontim/touchscreen/mstar/Kconfig"
```

## drivers/ontim/touchscreen/focaltech/Kconfig
```kconfig
config TOUCHSCREEN_FOCALTECH_ONTIM
	tristate "FocalTech IC based touchscreens"
	depends on I2C
	help
	  Say Y here if you have a FocalTech IC based touchscreen
	  controller.

	  If unsure, say N.

	  To compile this driver as a module, choose M here: the
	  module will be called FocalTech.
```
