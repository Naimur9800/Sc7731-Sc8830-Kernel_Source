## drivers/misc/sprd_camera/dcam/Kconfig
```kconfig
config SPRD_CAMERA_MULTI_DCAM
    bool "Spreadtrum Camera Multi DCAM"
    depends on SPRD_CAMERA
    help
        This is a multi DCAM driver for Spreadtrum SOCs.

config SPRD_CAMERA_SINGLE_DCAM
    bool "Spreadtrum Camera Single DCAM"
    depends on SPRD_CAMERA
    help
        This is a single DCAM driver for Spreadtrum SOCs.

config SPRD_CAMERA_DCAM_IF_R2P0
    bool "Spreadtrum Camera DCAM IF R2P0"
    depends on SPRD_CAMERA
    help
        This is a single DCAM IF driver for Spreadtrum SOCs.

config SPRD_CAMERA_DCAM_IF_R3P0
    bool "Spreadtrum Camera DCAM IF R3P0"
    depends on SPRD_CAMERA
    help
        This is DCAM_IF_R3P0 driver for Spreadtrum SOCs
        and sharl2, if you want to use this config,
        please to read spec and driver code,
        they can help you to use r3p0 driver

config SPRD_CAMERA_DCAM_IF_R3P0V2
    bool "Spreadtrum Camera DCAM IF R3P0V2"
    depends on SPRD_CAMERA
    help
        This is DCAM_IF_R3P0V2 driver for Spreadtrum SOCs
        and iSharkl2, if you want to use this config,
        please to read spec and driver code,
        they can help you to use r3p0v2 driver


config SPRD_CAMERA_DCAM_IF_R4P0
    bool "Spreadtrum Camera DCAM IF R4P0"
    depends on SPRD_CAMERA
    help
        This is DCAM_IF_R4P0 driver for Spreadtrum SOCs
        and sharle, if you want to use this config,
        please to read spec and driver code,
        they can help you to use r4p0 driver

config SPRD_CAMERA_DCAM_R6P0
    bool "Spreadtrum Camera DCAM R6P0"
    depends on SPRD_CAMERA
    help
        This is DCAM_R6P0 driver for Spreadtrum SOCs
        and pike2, if you want to use this config,
        please to read spec and driver code,
        they can help you to use r6p0 driver

config SPRD_CAMERA_ISP_R6P10
    bool "Spreadtrum Camera ISP R6P10"
    depends on SPRD_CAMERA
    help
        This is ISP R6P10 driver for Spreadtrum SOCs.

config SPRD_CAMERA_ISP_R6P10V2
    bool "Spreadtrum Camera ISP R6P10V2"
    depends on SPRD_CAMERA
    help
        This is ISP R6P10V2 driver for Spreadtrum SOCs.
```

## drivers/misc/sprd_camera/isp/Kconfig
```kconfig
config SPRD_CAMERA_ISP_G2V1
    bool "Spreadtrum Camera ISP G2V1"
    depends on SPRD_CAMERA
    help
        This is a isp g2v1 driver for Spreadtrum SOCs.

config SPRD_CAMERA_ISP1P0
    bool "Spreadtrum Camera ISP1P0"
    depends on SPRD_CAMERA
    help
        This is a isp 1.0 driver for Spreadtrum SOCs.

config SPRD_CAMERA_ISP_R6P91
    bool "Spreadtrum Camera ISP_R6P91"
    depends on SPRD_CAMERA
    help
        This is ISP_R6P91 driver for Spreadtrum SOCs
        and pike2, if you want to use this config,
        please to read spec and driver code,
        they can help you to use r6p91 driver

config SPRD_CAMERA_ISP_G2V3
    bool "Spreadtrum Camera ISPG2V3"
    depends on SPRD_CAMERA
    help
        This is a iwhale2 isp driver for Spreadtrum SOCs.

config SPRD_CAMERA_ISP_R6P11
    bool "Spreadtrum Camera ISP R6P11"
    depends on SPRD_CAMERA
    help
        This is ISP R6P11 driver for Spreadtrum SOCs.
```

## drivers/misc/sprd_jpg/Kconfig
```kconfig
config SPRD_JPG
	tristate "SPRD jpg driver"

config SPRD_JPG1
	tristate "SPRD jpg1 driver"
	---help---
	 if has JPG1 device, this can be set to Y;
	 if chip doesn't have this device, it must be N.
```

## drivers/misc/sprd_otp/Kconfig
```kconfig
menuconfig OTP_SPRD

    bool "Spreadtrum OTP Efuse"
    default y
    help
      Spreadtrum OTP Efuse Support.

if OTP_SPRD

config OTP_SPRD_AP_EFUSE
    tristate "Spreadtrum AP AON Efuse driver "
    default y
    help
      Say Y here to support spreadtrum AP efuse .

config OTP_SPRD_AP_PUBLIC_EFUSE
    tristate "Spreadtrum AP Public Efuse driver "
    default n
    help
      Say Y here to support Spreadtrum AP Public efuse .

config OTP_SPRD_AP_IEFUSE
    tristate "Spreadtrum AP AON IEfuse driver "
    default n
    help
      Say Y here to support spreadtrum AP iefuse .

config OTP_SPRD_PMIC_EFUSE
    tristate "Spreadtrum PMIC eFuse/eMemory driver"
    depends on SPI_SPRD_ADI
    default y
    help
      Say Y here to support spreadtrum PMIC efuse.

endif
```

## drivers/misc/sprd_vpp/Kconfig
```kconfig
# to add sprd vpp configs in the future
config SPRD_VPP
	bool "SPRD VPP driver"
	help
	"enable vpp device driver"
```

## drivers/misc/sprd_vsp/Kconfig
```kconfig
# to add sprd vsp configs in the future
config SPRD_VSP
	tristate "SPRD vsp driver"
	depends on ION_SPRD

if SPRD_VSP

config SPRD_VSP_PW_DOMAIN
	bool "SPRD vsp power domain"
	---help---
	 say Y if in whale series chip; otherwise, N.
	 this is to power on vsp domain.

config SPRD_VSP_PW_DOMAIN_R6P0
	bool "SPRD vsp power domain r6p0"
	---help---
	 say Y if in vsp r6p0 chip; otherwise, N.
	 this is to power on vsp domain r6p0.

config SPRD_VSP_PW_DOMAIN_R7P0
	bool "SPRD vsp power domain r7p0"
	---help---
	say Y if in vsp sharkle; otherwise, N.
	this is to power on vsp domain r7p0.

endif

config SPRD_VSP_ENC
	tristate "SPRD vsp_enc driver"
	---help---
	 say Y if in whale2 series chip; otherwise, N.
	 this is only for 264 enc of 1080p.
```

## drivers/misc/sprdwcn_bsp/Kconfig
```kconfig
#
# Spreadtrum WCN subsystem configuration
#
menu "Spreadtrum WCN subsystem"

source "drivers/misc/sprdwcn_bsp/sc23xx/Kconfig"
source "drivers/misc/sprdwcn_bsp/sc2342/Kconfig"
endmenu
```

## drivers/misc/sprdwcn_bsp/sc2342/Kconfig
```kconfig
#
# Spreadtrum WCN device configuration
#
menu "Spreadtrum WCN Device Drivers"
	depends on MMC

config MARLIN2
	tristate "marlin2 ref driver"
	help
	  This enables the wcn driver for marlin2 devices.

	  Say Y here to compile support for SPRD's SC2332 driver
	  into the kernel or say M to compile it as module.

config GREENEYE2
	tristate "GNSS GreenEye2 ref driver"
	help
	  This enables the wcn driver for GE2 devices.

	  Say Y here to compile support for SPRD's SC2393 driver
	  into the kernel or say M to compile it as module.

config INTEGRATED_MARLIN2_GE2
	tristate "Integrated Marlin2 and GE2 with AP chihpset ref driver"
	help
	  This enables the wcn driver for integrated MARLIN2 and GE2 devices.

	  Say Y here to compile support for SPRD's SC2342 driver
	  into the kernel or say M to compile it as module.

source "drivers/misc/sprdwcn_bsp/sc2342/platform/Kconfig"
source "drivers/misc/sprdwcn_bsp/sc2342/packer_sim/Kconfig"
source "drivers/misc/sprdwcn_bsp/sc2342/sdiom/Kconfig"
source "drivers/misc/sprdwcn_bsp/sc2342/bluetooth/Kconfig"
source "drivers/misc/sprdwcn_bsp/sc2342/radio/Kconfig"
source "drivers/misc/sprdwcn_bsp/sc2342/gnss/Kconfig"

endmenu
```

## drivers/misc/sprdwcn_bsp/sc2342/bluetooth/Kconfig
```kconfig
#
# Spreadtrum BT devices
#
config BT_SPRD2332
	tristate "Bluetooth driver"
	depends on MARLIN2_SOC && (BT || ARCH_SPRD)
	help
	  This enables the Bluetooth driver for marlin2 devices.

	  Say Y here to compile support for Broadcomm's BCM43455 driver
	  into the kernel or say M to compile it as module.

config MARLIN2_BT_SDIO
        tristate "BT driver sdio support"
        default n
        depends on BT_SPRD2332
        help
          virtual device by BT
```

## drivers/misc/sprdwcn_bsp/sc2342/gnss/Kconfig
```kconfig
#
# Spreadtrum GNSS devices
#
config SPRD_WCN_DOWNLOAD_IMG
	tristate "Spreadtrum Marlin Download Image File"
	depends on MARLIN
	default n
	help
	 If you say yes here you get support for the wcn Marlin chip.
	 This driver would support download the firmware to Marlin,
	 And this driver can also be built as a module.  If so, the module
	 Will be called DOWNLOAD_IMG.

config GNSS_POWER_CTL
	bool "Spreadtrum GNSS Power Control"
	depends on GREENEYE2
	default n
	help
	  This driver provides support for the Marlin and GE2 chip
	  Power on, reset, clk, etc.
	  If you say yes here, you can get Marlin chip or GE2 chip
	  Control service
	  If unsure, say n.

config GNSS_DBG
	tristate "Spreadtrum GNSS Debug"
	depends on GREENEYE2
	default n
	help
	  Debug system for Spreadtrum GE2 chip
	  If unsure, say n.
```

## drivers/misc/sprdwcn_bsp/sc2342/packer_sim/Kconfig
```kconfig
config PACKER_SIMULATE
        tristate "SDIO packer simulate"
        default n
        depends on MARLIN2_SOC
        help
          Simulate SDIO packer for test
```

## drivers/misc/sprdwcn_bsp/sc2342/platform/Kconfig
```kconfig
config MARLIN2_SOC
	depends on SDIOM
	tristate "SPRD Marlin2 platform support"
	default n
	help
	  Enable this module if you want to use marlin2 chip including .
          This module support marlin2 chip platform for example:download,
          power ctl,sleep wakeup,at cmd,loopchek,mdbg,dump,marlin2 log .etc
	  Thanks.

config MARLIN2_FPGA
	bool "SPRD Marlin2 FPGA test"
	default n
        depends on MARLIN2_SOC
	help
	  only fpga test in marlin chip

config INTEGRATED_MARLIN2_GE2_SOC
	tristate "SPRD Integrated Marlin2 and GE2 platform support"
	default n
	help
	  Enable this module if you want to use marlin2 and ge2 chip including .
          This module support marlin2 and ge2 chip platform for example:download,
          power ctl,sleep wakeup,at cmd,loopchek,mdbg,dump,marlin2 log .etc
	  Thanks.
```

## drivers/misc/sprdwcn_bsp/sc2342/radio/Kconfig
```kconfig
#
# Spreadtrum SC2332 FM drivers
#
config FM_SPRD2332
	tristate "FMRadio driver"
	depends on MARLIN2_SOC
	help
	  This enables the FM driver for marlin2 devices.

	  Say Y here to compile support for SPRD's SC2332 driver
	  into the kernel or say M to compile it as module.

config RADIO_SC2332
	tristate "FMRadio driver sdio Support"
	depends on FM_SPRD2332
	default n
	---help---
	  Say Y to enable built-in FM controller in the
	  Spreadtrum SC2332 based System-on-Chip devices.
```

## drivers/misc/sprdwcn_bsp/sc2342/sdiom/Kconfig
```kconfig
config SDIOM
	depends on MMC && MARLIN2
	tristate "Spreadtrum SDIOM Support"
	help
		Enable this module for Spreadtrum Marlin2 SDIO Support.
		Please insmod this module before any other WCN subsystems.
		Thanks.
```

## drivers/misc/sprdwcn_bsp/sc23xx/Kconfig
```kconfig
#
# Spreadtrum WCN device (NEW )configuration
#
menu "Spreadtrum WCN Device Drivers(for new chip...)"
config SC23XX
	bool "SC23XX chip Support"
	#depends on MMC
	default n
	help
	  This is support wcn chip for spreadtrum.
	  if you want to use 23xx series wcn chip of spreadtrum.
	  please say "y".
	  Thanks.

config SC2342_INTEG
	tristate "SC2342 Integrated chip Support"
	depends on SC23XX
	default n
	help
	  This is support wcn chip for spreadtrum.
	  If you want to use sc2342 integrated chip of spreadtrum.
	  Please say "y".
	  Thanks.


config SC2355
	tristate "SC2355 chip Support"
	depends on SC23XX
	default n
	help
	  This is support wcn chip for spreadtrum.
	  If you want to use sc2355 chip of spreadtrum.
	  Please say "y".
	  Thanks.

config SC2366
	tristate "SC2366 chip Support"
	depends on SC23XX
	default n
	help
	  This is support wcn chip for spreadtrum.
	  If you want to use sc2366 chip of spreadtrum.
	  Please say "y".
	  Thanks.

# sprd's boot driver based on SC2342-integ...,etc
source "drivers/misc/sprdwcn_bsp/sc23xx/boot/Kconfig"

# sprd's gnss driver based on SC2355/2342...,etc
source "drivers/misc/sprdwcn_bsp/sc23xx/gnss/Kconfig"

# sprd's SDIO device driver based on SC2355...,etc
source "drivers/misc/sprdwcn_bsp/sc23xx/sdio/Kconfig"

# sprd's SIPC device driver based on SC2342 integ...,etc
source "drivers/misc/sprdwcn_bsp/sc23xx/sipc/Kconfig"

# sprd's sleep device driver based on SC2355...,etc
source "drivers/misc/sprdwcn_bsp/sc23xx/sleep/Kconfig"

# sprd's PCIe device driver based on SC2355...,etc
source "drivers/misc/sprdwcn_bsp/sc23xx/pcie/Kconfig"

# sprd's wcn platform driver based on SC2355/SC2342...,etc
source "drivers/misc/sprdwcn_bsp/sc23xx/platform/Kconfig"

endmenu
```

## drivers/mmc/core/Kconfig
```kconfig
#
# MMC core configuration
#
config PWRSEQ_EMMC
	tristate "HW reset support for eMMC"
	default n
	depends on OF
	help
	  This selects Hardware reset support aka pwrseq-emmc for eMMC
	  devices. By default this option is set to y.

	  This driver can also be built as a module. If so, the module
	  will be called pwrseq_emmc.

config PWRSEQ_SIMPLE
	tristate "Simple HW reset support for MMC"
	default n
	depends on OF
	help
	  This selects simple hardware reset support aka pwrseq-simple for MMC
	  devices. By default this option is set to y.

	  This driver can also be built as a module. If so, the module
	  will be called pwrseq_simple.

config SPRD_PWRSEQ_SDIO
	tristate "HW reset support for wcn sdio"
	default n
	depends on OF
	help
	  This selects sdio hardware reset support spreadtrum for SDIO
	  devices. By default this option is set to n.

	  This driver can also be built as a module. If so, the module
	  will be called sprd_pwrseq_sdio.

config MMC_EMBEDDED_SDIO
	boolean "MMC embedded SDIO device support (EXPERIMENTAL)"
	help
	  If you say Y here, support will be added for embedded SDIO
	  devices which do not contain the necessary enumeration
	  support in hardware to be properly detected.

config MMC_PARANOID_SD_INIT
	bool "Enable paranoid SD card initialization (EXPERIMENTAL)"
	help
	  If you say Y here, the MMC layer will be extra paranoid
	  about re-trying SD init requests. This can be a useful
	  work-around for buggy controllers and hardware. Enable
	  if you are experiencing issues with SD detection.
```

## drivers/mobilevisor/Kconfig
```kconfig
#
#  Copyright (C) 2014 Intel Mobile Communications
#
#  This program is free software: you can redistribute it and/or modify
#  it under the terms of the GNU General Public License Version 2
#  as published by the Free Software Foundation.
#
#  This program is distributed in the hope that it will be useful,
#  but WITHOUT ANY WARRANTY; without even the implied warranty of
#  MERCHANTABILITY or FITNESS FOR A PARTICULAR PURPOSE.
#
#  You should have received a copy of the GNU General Public License Version 2
#  along with this program. If not, see <http://www.gnu.org/licenses/>.
#

#
# Mobilevisor vdriver configuration
#

if MOBILEVISOR

menu "Mobilevisor virtual driver support"

config MOBILEVISOR_VDRIVER_DUMP
	tristate "VDUMP Driver"
	default y
	help
	  To support coredump
	  via VMM when Linux panic
	  To compile this driver as a module, choose M here: the
	  module will be called vdump.

endmenu

endif
```

## drivers/nfc/pn80t/Kconfig
```kconfig
#
# Nfc drivers configuration
#


config NFC_PN80T
	tristate "Nxp pn80t NCI protocol driver (I2C) devices"
	depends on I2C
	default n
	---help---
	  You'll have to say Y if your computer contains an I2C device that
	  you want to use under Linux.

	  You can say N here if you don't have any I2C connected to your computer.
```

## drivers/ontim/Kconfig
```kconfig
source "drivers/ontim/touchscreen/Kconfig"
source "drivers/ontim/compass/Kconfig"
source "drivers/ontim/gsensor/Kconfig"
source "drivers/ontim/light_prox/Kconfig"
source "drivers/ontim/ontimdbgcore/Kconfig"
source "drivers/ontim/backlight/Kconfig"
```

## drivers/ontim/backlight/Kconfig
```kconfig
#
# ontim compass driver configuration
#

config ONTIM_BACKLIGHT
	tristate "ontim backlight driver"
	depends on  I2C
	default n
```

## drivers/ontim/compass/Kconfig
```kconfig
#
# ontim compass driver configuration
#

config INPUT_LSM303D_I2C
	tristate "lsm303d compass & g-sensor 2 in 1"
	depends on  I2C
	default n
```
