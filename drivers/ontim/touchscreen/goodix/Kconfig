## drivers/ontim/touchscreen/goodix/Kconfig
```kconfig
config TOUCHSCREEN_GOODIX
	tristate "gt9xx based touchscreens"
	depends on I2C
	help
	  Say Y here if you have a gt9xx based touchscreen
	  controller.

	  If unsure, say N.

	  To compile this driver as a module, choose M here: the
	  module will be called gt9xx.
```

## drivers/ontim/touchscreen/mstar/Kconfig
```kconfig
config TOUCHSCREEN_MSTAR
	tristate "msg2133 based touchscreens"
	depends on I2C
	help
	  Say Y here if you have a msg2133 based touchscreen
	  controller.

	  If unsure, say N.

	  To compile this driver as a module, choose M here: the
	  module will be called msg2133.

config TOUCHSCREEN_MSTAR2XXX
	tristate "msg2xxx based touchscreens"
	depends on I2C
	help
	  Say Y here if you have a msg2xxx based touchscreen
	  controller.

	  If unsure, say N.

	  To compile this driver as a module, choose M here: the
	  module will be called msg2xxx.

config  ENABLE_SIMULATIONS_PROXIMITY 
	boolean "support tp simulator proximity "
	depends on TOUCHSCREEN_MSTAR2XXX 
	default n		
```

## drivers/phy/dsi_1_21a/Kconfig
```kconfig
config DSI_CTRL_R1P0
	depends on PHY_MEGACORE_SPRD
	bool "Enable dsi ctrl r1p0 driver for spreadtrum"
	help
	  This driver implements dsi ctrl r1p0 driver to config spreadtrum
	  dsi ctrl r1p0 support.
```

## drivers/pinctrl/sprd/Kconfig
```kconfig
#
# Spreadtrum PINCTRL drivers
#

config PINCTRL_SPRD
	bool "Spreadtrum pinctrl driver"
	select PINMUX
	select PINCONF
	select GENERIC_PINCONF
	help
	  Say Y here to enable Spreadtrum pinctrl driver
```

## drivers/platform/sprd/Kconfig
```kconfig
#
# SPREADTRUM Platform Specific Drivers
#
menu "Spreadtrum Platform Specific Drivers"
config SC_INTERNAL_ADI
	bool "Spredtrum ADI Support"
        default y
	help
	  Say Y here to support for adi.

config BUS_MONITOR_DEBUG
    bool "Spreadtrum BM Support"
	default y
	help
	  Say Y here to support debug busmonitor

config SC_FPGA
	bool "Spreadtrum FPGA support"
	default n
	help
	  This is used for FPGA verification

config SCX35L64BIT_FPGA
	bool "Spreadtrum FPGA platform"
	depends on ARCH_SCX35L64
	select  SC_FPGA
	default n
	help
	  SCX35L64BIT_FPGA fpga platform

config SC_VIBRATOR
        bool "vibrator for SC serials"
        select ANDROID_TIMED_OUTPUT
        default n

config SPRD_VIBRATOR_2723
        bool "vibrator for sprd_vibrator_2723"
        select ANDROID_TIMED_OUTPUT
        default n

config SC_VIBRATOR_GPIO
        bool "vibrator for SC serials by gpio"
        default n
	depends on SC_VIBRATOR

config SC_VIBRATOR_POWER
        bool "vibrator for SC serials by power"
        default n
	depends on SC_VIBRATOR

config SC_INTERNAL_WATCHDOG
	bool "spreadtrum sc internal watchdog"
	default y
	depends on ARCH_SCX35

endmenu
```

## drivers/soc/sprd/Kconfig
```kconfig
#
# SPRD Soc drivers
#
config SPRD_WAKEUPEN_INTC
        bool "SPRD wakeupen interrupt controller interface"
        depends on ARCH_SPRD
	default y if SUSPEND
        help
          Say y here to enable SPRD wakeupen intc support,which enable irqs
	  to wakeup system from suspend.

config SPRD_MEMDISK
	tristate "SPRD memdisk driver"
	depends on ARCH_SPRD
	help
	  This option can support sprd memdisk driver, which can use a block of
	  DDR memory as a disk. we can load the android image to this disk when
	  mmc driver is not ready, for example in vdk and FPGA platform.

config SPRD_VIBRATOR
	tristate "Spreadtrum vibrator driver"
	depends on SPI_SPRD_ADI
	help
	  This driver provides support for the vibrator of the
	  PMIC.

config SPRD_HOTPLUG
	tristate "SPRD hotplug driver for arm32"
	depends on ARCH_SPRD && ARM && HOTPLUG_CPU
	help
	This option enable the SPRD'S hotplug driver for arm32.

config SPRD_ARM32_SMP_WITH_PSCI
	bool "SPRD ARM32 SMP With PSCI"
	depends on ARM_PSCI && SMP
	default n
	---help---
	Select this configuration, mainly in order to distinguish between orignal psci smp
	and sprd psci smp drivers. It only helps to realize PSCI SMP under SPRD ARM32 platform

source drivers/soc/sprd/iommu/Kconfig

source "drivers/soc/sprd/sdiodev/Kconfig"

source "drivers/soc/sprd/debug/sysdump/Kconfig"

source "drivers/soc/sprd/debug/dmc_drv/Kconfig"

config SPRD_DEBUG
	tristate "Spreadtrum debug modular"
	help
		Say y here to enable Debug support.

config SPRD_REG_ACCESS_32BITS
	tristate "Spreadtrum register access 32bit alinged"
	help
		Say y here to only access register only 32bit aligned.

source "drivers/soc/sprd/debug/Kconfig"
source "drivers/soc/sprd/performance/Kconfig"

menu "ARM CPU DeepSleep Drivers"

#
# ARM64 CPU DeepSleep drivers
#

config ARM32_SPRD_DEEPSLEEP
	bool "GENERIC ARM32 DeepSleep Driver"
	depends on PM_SLEEP && ARM
	default y
	---help---
	Select this to enable generic deepsleep driver for ARM32.
	It provides a generic deepsleep driver whose deepsleep states are
	configured.The deepsleep suspend backend is initialized by calling the
	CPU operations init deepslep hook provided by architecture code.
	In deepsleep state, the ahb/aph clk are off, both master and
	peripherals are closed, chip enter lower power state,
	only the static power consumption.

config SPRD_DEEPSLEEP_WITH_PSCI
	bool "SPRD DeepSleep With PSCI"
	depends on PM_SLEEP && ARM_PSCI
	default n
	---help---
	Select this configuration, mainly in order to save the register
	before entering the deep sleep, after exiting deep restore the register.
	At the same time print some deep sleep related information to help debug deep.

config SPRD_DEEPSLEEP_SHARKLE
	bool "SPRD SHARKLE DeepSleep"
	depends on PM_SLEEP && !ARM64_SPRD_DEEPSLEEP
	default n
	---help---
	Select this to enable deepsleep driver for SharkLE.
	It provides a generic deepsleep driver whose deepsleep states are
	configured.The deepsleep suspend backend is initialized by calling the
	CPU operations init deepslep hook provided by architecture code.
	In deepsleep state, the ahb/aph clk are off, both master and
	peripherals are closed, chip enter lower power state.

config SPRD_DEEPSLEEP_PIKE2
	bool "SPRD PIKE2 DeepSleep"
	depends on PM_SLEEP && ARM_PSCI && !SPRD_DEEPSLEEP_WITH_PSCI
	default n
	---help---
	Select this to enable deepsleep driver for Pike2.
	It provides a generic deepsleep driver whose deepsleep states are
	configured.The deepsleep suspend backend is initialized by calling the
	CPU operations init deepslep hook provided by architecture code.
	In deepsleep state, the ahb/aph clk are off, both master and
	peripherals are closed, chip enter lower power state.

config SPRD_DEEPSLEEP_SHARKL3
	bool "SPRD SHARKL3 DeepSleep"
	depends on PM_SLEEP && ARM64 && !ARM64_SPRD_DEEPSLEEP
	default n
	---help---
	Select this to enable deepsleep driver for SharkL3.
	It provides a generic deepsleep driver whose deepsleep states are
	configured.The deepsleep suspend backend is initialized by calling the
	CPU operations init deepslep hook provided by architecture code.
	In deepsleep state, the ahb/aph clk are off, both master and
	peripherals are closed, chip enter lower power state.


config ARM64_SPRD_DEEPSLEEP
	bool "GENERIC ARM64 DeepSleep Driver"
	depends on PM_SLEEP && ARM64
	default y
	---help---
	Select this to enable generic deepsleep driver for ARM64.
	It provides a generic deepsleep driver whose deepsleep states are
	configured.The deepsleep suspend backend is initialized by calling the
	CPU operations init deepslep hook provided by architecture code.
	In deepsleep state, the ahb/aph clk are off, both master and
	peripherals are closed, chip enter lower power state,
	only the static power consumption.
endmenu

config SPRD_WHALE2_ISP_REGISTER_ACCESS_RETRY
	bool "SPRD whale2 isp register access retry"
	depends on ARCH_SPRD && ARM64
	help
	  Access to whale2 isp module's register may cause synchronous exception
	  because of IC design error. This option can support modify the
	  original synchronous exception handler, but after metal fix, this option
	  is not needed.
```

## drivers/soc/sprd/debug/Kconfig
```kconfig
source "drivers/soc/sprd/debug/busmonitor/Kconfig"
source "drivers/soc/sprd/debug/iodebug/Kconfig"
source "drivers/soc/sprd/debug/djtag/Kconfig"
source "drivers/soc/sprd/debug/irq/Kconfig"

config LOOK_AT
	bool "sprd look at"
	depends on SPRD_DEBUG
	default n
	help
	  this macro is for lookat driver, lookat is a debug tool that is used to
	  view the content of arm/arm64 of the address space through usb port,
	  such as the register of each module, DDR address space, etc.
	  When in doubt, say n

config SPRD_LAST_REGS
	bool "SPRD last regs access"
	depends on SPRD_DEBUG
	default y
	help
	  SPRD last regs access for Debug.
source "drivers/soc/sprd/debug/dmc_mpu/Kconfig"

config SPRD_CPU_USAGE
	bool "open sprd cpu rate compute"
	depends on DEBUG_FS && SPRD_DEBUG
	default y
	help
	  CPU usage statistics

config SPRD_PERFORMANCE_CHECKER
	bool "performance checker tool"
	depends on SPRD_DEBUG
	default n
	help
	  dump registers about performance
```

## drivers/soc/sprd/debug/busmonitor/Kconfig
```kconfig
config SPRD_BUS_MONITOR
	bool "Spreadtrum BM Support"
	depends on SPRD_DEBUG
	help
	  Say Y here to support debug busmonitor

config SPRD_BM_DJTAG
	bool "Spreadtrum DJTAG&BM Support"
	depends on SPRD_DEBUG && SPRD_SIPC
	help
	  Say Y here to support djtag&busmonitor.
	  For whale,whale2,iwhale2.

config SPRD_AON_BUSMON
	bool "Spreadtrum Aon Busmon Support"
	depends on SPRD_DEBUG
	help
	  Say Y here to support aon busmon.

config SPRD_BUSMONITOR
	bool "Spreadtrum BUS Monitor Support"
	depends on SPRD_DEBUG
	help
	  Say Y here to support BUS monitor.
```

## drivers/soc/sprd/debug/dmc_drv/Kconfig
```kconfig
config SPRD_DMC_DRV
	bool "Spreadtrum DMC DRV Support"
	default y
	help
	  Say Y here to support dmc drv.
```

## drivers/soc/sprd/debug/iodebug/Kconfig
```kconfig
config IODEBUG
	bool "IO debug function."
	depends on SPRD_DEBUG && DEBUG_FS
	help
	  Support for IO debug feature. If you say Y here,
	  it will provide a methd to acquire FS-IO operation
	  information. Also, linux can monitor process with
	  D-state. It will make a directory named iodebug in
	  /sys/kernel/debug.

	  If don't need, say N.

config IODEBUG_HOTPOINT
	bool "hotpoint debug function."
	depends on IODEBUG
	help
	  For IO debug, support for IO hotpoint monitor.
	  If you say Y here, it will provide APIs to get usage time
	  of any stage of a FS-IO operation.

	  If don't need, say N.

config IODEBUG_VFS
	bool "iodebug vfs function."
	depends on IODEBUG
	default y
	help
	  For IO debug in VFS. It can monitor vfs_read and vfs_write
	  usage time. It provides a node vfs_iodebug in
	  /sys/kernel/debug/iodebug, userspace programe can use this node to
	  get VFS operation information.

	  If don't need, say N.

config IODEBUG_BDI
	bool "iodebug bdi function."
	depends on IODEBUG
	default y
	help
	  For IO debug in BDI. For backing dev information.
	  It provides a node bdi_iodebug in /sys/kernel/debug/iodebug,
	  userspace programe can use this node to get backing dev
	  information.

	  if don't need, say N.
```

## drivers/soc/sprd/iommu/Kconfig
```kconfig
config SPRD_IOMMU
	bool "SPRD Soc IOMMU Module"
	depends on ARCH_SPRD
	---help---
	  Choose this option can support sprd iommu driver, which can use as an address translater
	  for Device DMA address access, support above 4G address access and scatter pages
	  access.
```

## drivers/soc/sprd/performance/Kconfig
```kconfig
config SPRD_PERFORMANCE
	bool "Spreadtrum Performance support"
	depends on SPRD_DEBUG
	help
	  For whale,whale2,or iwhal2.It used to
	  calculate the bandwidth of each subsystem
	  to access the memory.
	  If unsure, say N

config SPRD_PTM
	bool "Spreadtrum Performance Trace Monitor Support"
	depends on SPRD_DEBUG
	help
	  Say Y here to support ptm support.
```

## drivers/soc/sprd/sdiodev/Kconfig
```kconfig
menu "Sdiodev Modules"
config SDIODEV
    tristate "Spreadtrum SDIO device support"
    help
	For marlin sdio related interface
	It used to communicate with some modules
	eg.wifi,sprd_download,fm
	Insmod this module before other sdio dev modules
	If unsure, say N

endmenu
```

## drivers/staging/msg2138/Kconfig
```kconfig
config TOUCHSCREEN_MSG2138
	tristate "MSG213 touchscreen driver"
	depends on I2C
	---help---
	  Say Y here if you have a MSG2138 based touchscreen controller.
	  If unsure, say N.
	  To compile this driver as a module, choose M here: the module
	  will be called msg2138.o
```

## drivers/staging/sprd/modem/Kconfig
```kconfig
source "drivers/staging/sprd/modem/mailbox/Kconfig"

source "drivers/staging/sprd/modem/sipc/Kconfig"

source "drivers/staging/sprd/modem/cproc/Kconfig"

source "drivers/staging/sprd/modem/modem_control/Kconfig"

source "drivers/staging/sprd/modem/iq/Kconfig"

source "drivers/staging/sprd/modem/debug_log/Kconfig"
```

## drivers/staging/sprd/modem/mailbox/Kconfig
```kconfig
menu "SPRD Mailbox  modules"

config SPRD_MAILBOX
        bool "Spreadtrum Mailbox IPI Arch"
        default n
        help
          Spreadtrum Mailbox is a framework to control
          hardware communication between on-chip processors
          through queued messages and interrupt driven
          signals.

config SPRD_MAILBOX_FIFO
        bool "Spreadtrum Mailbox FIFO"
        default n
        depends on SPRD_SIPC
        help
          This feature be opened indicate that the sipc
          module will use the mailbox fifo message to
          repalce the message on ddr or on ram, it can
          reduce some share memory between different
          cores.

config SPRD_MAILBOX_SENSOR
        bool "Spreadtrum support mailbox sensor"
        default n
        depends on SPRD_SIPC
        help
          This feature be opened indicate that the sensorhub
          in SP will used a specialized mailbox to send the
          data of sensorhub, this box will not wake up the
          AP system.

endmenu
```

## drivers/staging/sprd/modem/modem_control/Kconfig
```kconfig
menu "Modem Control modules"

config SPRD_MODEM_CTRL
	bool "Sprd Modem Control Driver"
        default n
        help
          Spreadtrum modem control is a module that
          It can contol the modem start and stop, It
          be usded for modem boot, modem assert and
          modem reset.

config SPRD_MODEM_CTRL_AGDSP
        bool "Sprd Modem Control support AGDSP"
        default n
        depends on SPRD_SIPC
        help
          Spreadtrum Modem Control AGDSP FEATURE,
          if It is enable, The modem control mudule
          will boot agdsp, It only can be opend in
          those board that the chip has AGDSP.

endmenu
```
