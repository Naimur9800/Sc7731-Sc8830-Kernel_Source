## drivers/staging/sprd/modem/sipc/Kconfig
```kconfig
menu "SIPC modules"

config SPRD_SIPC
	bool "Sprd IPC"
	default n
	help
	  SIPC is a module for spreadtrum AP/CP communicaiton system.

config SPRD_SIPC_MULTI_SMEM
	bool "sprd multi-smems support"
	default n
	depends on SPRD_SIPC
	help
	  Multi-SMEMs support for inter-processors data transmission.

config SPRD_SIPC_SPIPE
	bool "sprd pipe driver based on SBUF"
	default n
	depends on SPRD_SIPC
	help
	  This driver is a pipe driver base on SBUF, which create
	  general pipes between AP & CP.

config SPRD_SIPC_SPOOL
       bool "sprd pool driver based on SBLOCK"
       default n
       depends on SPRD_SIPC
       help
        This driver is a pool driver base on SBLOCK, which create
        general pools between AP & CP.

config SPRD_SIPC_SETH
       bool "Sprd Ethernet driver"
       default n
       depends on SPRD_SIPC
       help
         This driver supports the Spreadtrum Ethernet based on share
         memory. Say Y here if you want to use it.

config SPRD_SIPC_SETH_OPT
      bool "Enable performance optimization for SETH (2 Bytes reserved & US gather)"
      default n
      depends on SPRD_SIPC_SETH
      help
        Starting from SharkL, the Seth driver is optimized for data thransfer
	performance, but that is not compatible with former products
	like TShark. Enable this configuration, IF the modem end surports
	these optimizations: 2 Bytes reserved in sblock field and packets gathering
	in upstreaming direction.

config SPRD_SBLOCK_SHARE_BLOCKS
      bool "Enable all sblocks used by SETH share one block pool"
      default n
      depends on SPRD_SIPC_SETH
      help
        Starting from SharkL4M, this optimization can reduce the
	reserved memory usage.Shall confim cp also support it.

config SPRD_SIPC_SETH_RAWIP
      bool "Enable SETH  transfer RawIP packets"
      default n
      depends on SPRD_SIPC
      help
        Starting from SharkL5.1, use zero copy rawip transfer.

config SPRD_SIPC_ZERO_COPY_SIPX
      bool "Enable SETH use SIPX to transfer IP packets"
      default n
      depends on SPRD_SIPC
      help
        Starting from SharkL5.1, use SIPX to replace SBlock or Seblock for SETH.

config SPRD_SIPC_MEM_CACHE_EN
	bool "Enable cache from sipc memory "
	default n
	depends on SPRD_SIPC_ZERO_COPY_SIPX
	help
	Enable cache from sipc memory.

config SPRD_SIPC_STTY
       bool "Sprd Stty driver"
       default n
       depends on SPRD_SIPC
       help
         This driver supports the Spreadtrum Ethernet based on share
         memory. Say Y here if you want to use it.

config SPRD_SIPC_GNSS_STTY
       bool "Sprd Stty gnss driver"
       default n
       depends on SPRD_SIPC
       help
         This driver supports the Spreadtrum Gnss SIPC driver based on share
         memory. Say Y here if you want to use it.

config SPRD_SIPC_SMSGC
       bool "Sprd message controller driver based on SMSG"
       default n
       depends on SPRD_SIPC
       help
         This driver is a message controller driver base on SMSG,
         controller transfer SMSG data to userspace directly.

config SPRD_SIPC_WCN
	bool "Enable sipc for WCN"
	default n
	depends on SPRD_SIPC
	help
	  This option enables sipc interface for WCN.

config SPRD_SIPC_SWCNBLK
      bool "Enable WCN use wcnblk to transfer IP packets"
      default n
      depends on SPRD_SIPC
      help
	This driver supports wcn sblock special function.
        Starting from SharkLe, wcn use swcnblk to replace sblock.

endmenu
```

## drivers/staging/sprd_usb/Kconfig
```kconfig
config USB_SPRD_DWC
	tristate "Spreadtrum USB2.0 Controller"
	help
	   Spreadtrum's usb controller is an integrated high speed
	   USB 2.0 device controller(with dwc core).

	   Say "y" to link the driver statically, or "m" to build a
	   dynamically linked module called "dwc_otg" and force all
	   gadget drivers to also be dynamically linked.

if USB_SPRD_DWC

config SPRD_USB_DEVICE_ONLY
        boolean "Spreadtrum device only controller"
        depends on USB_SPRD_DWC

        help
           the chip can only support device mode, do not support otg.

config USB_SPRD_FPGA
        boolean "Spreadtrum device for fpga"
        depends on USB_SPRD_DWC

        help
           the marco is just for fpga board.

config SPRD_INTEL_USB2_PHY
	tristate "Spreadtrum USB2 PHY(Intel) Driver"
	select USB_PHY
	help
	  Enable this to support the USB PHY(Intel) that is part of SOC. This driver
	  takes care of all the PHY functionality, normally paired with
	  DesignWare USB2.0 (DRD) Controller.

endif
```

## drivers/video/adf/sprd/Kconfig
```kconfig
config ADF_SPRD
	depends on ADF
	select VIDEOMODE_HELPERS
	bool "Enable adf driver for spreadtrum"
	help
	  This driver implements adf core to enable spreadtrum
	  adf support.
source "drivers/video/adf/sprd/drv/Kconfig"
```

## drivers/video/adf/sprd/drv/Kconfig
```kconfig
config DISP_R1P0
	depends on ADF
	bool "Enable disp r1p0 driver for spreadtrum"
	help
	  This driver implements disp r1p0 driver to enable spreadtrum
	  disp r1p0 support.

config DISP_LITE_R2P0
	depends on ADF
	bool "Enable disp lite r2p0 driver for spreadtrum"
	help
	This driver implements disp lite r2p0 driver to enable spreadtrum
	disp lite r2p0 support.
#/*zte add for lcd common function begin */
config ZTE_LCD_COMMON_FUNCTION
        bool "Support for ZTE lcd common function"
        default n
config ZTE_LCD_BACKLIGHT_LEVEL_CURVE
        depends on ZTE_LCD_COMMON_FUNCTION
        bool "Support for ZTE lcd backlight curve"
config ZTE_LCD_VDDIO_ALWAYS_ON
        depends on ZTE_LCD_COMMON_FUNCTION
        bool "Support for ZTE lcd vddio always on"
config ZTE_LCD_REG_DEBUG
        depends on ZTE_LCD_COMMON_FUNCTION
        bool "Support lcd register debug in root version"
config ZTE_LCD_DCSBL_CABC_GRADIENT
        depends on ZTE_LCD_COMMON_FUNCTION
        bool "Support for ZTE dcs bl cabc gradient effect"
config ZTE_LCD_CABC3_EXTREME_POWER_SAVE
        depends on ZTE_LCD_COMMON_FUNCTION
        bool "Support for ZTE extreme power save modem cabc"
config ZTE_LCD_ESD_ERROR_CTRL
        bool "Support for lcd esd check error ctrl"
        default n
config ZTE_LCD_DELAY_OPEN_BL
	depends on ZTE_LCD_COMMON_FUNCTION
	bool "Support for ZTE lcd delay open bl"
config ZTE_LCD_DISABLE_SSC
	depends on ZTE_LCD_COMMON_FUNCTION
	bool "Support for ZTE disable SPRD ssc func in panel dtsi"
#/*zte add for lcd common function end */
```

## drivers/video/disp_pw_domain/Kconfig
```kconfig
config DISP_PW_DOMAIN_ON
	bool "SPRD display power domain driver for whale2"
	help
	  This driver enable display power domain driver for spreadtrum.

config DISP_PM_DOMAIN_SHARKL3
	bool "SPRD display PM Generic Domain for SharkL3"
	select PM_GENERIC_DOMAINS if PM
	help
	  When you select this feature, it will enable the pm generic
	  power domain for SharkL3 display module.
```

## drivers/video/fbdev/sprdfb/Kconfig
```kconfig
if FB
config FB_SPRD
	boolean "Spreadtrum frame buffer support "
	depends on FB
	select FB_CFB_FILLRECT
	select FB_CFB_COPYAREA
	select FB_CFB_IMAGEBLIT
	help
		Frame buffer driver for Spreadtrum boards.

config SPRD_FB_SIZE
	int "MB size for frame buffer, should larger or equal lcd_w*lcd_h*4*2"
	range 1 16
	default 8
	depends on FB_SPRD

config FB_LCD_OVERLAY_SUPPORT
	boolean "support lcd overlay"
	default n

config FB_VSYNC_SUPPORT
	boolean "support wait for vsync io"
	default y

config FB_ESD_SUPPORT
       boolean "support esd check"
       default n

config FB_DYNAMIC_CLK_SUPPORT
	boolean "support close clk dynamically"
	default n

config FB_DYNAMIC_FREQ_SCALING
	boolean "support change mipi clk/fps/dpi clk dynamically"
	default y
endif
```
