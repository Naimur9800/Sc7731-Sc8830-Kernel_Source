## drivers/video/sprdfb/Kconfig
```kconfig
if FB
config FB_SCX35
	boolean "SC8830 frame buffer support "
	depends on FB && ARCH_SCX35 && (!ARCH_SCX30G) && (!ARCH_SCX35L)
	select FB_CFB_FILLRECT
	select FB_CFB_COPYAREA
	select FB_CFB_IMAGEBLIT
	help
          Frame buffer driver for sc8830 based boards.

config FB_SCX30G
	boolean "SC8830G frame buffer support "
	depends on FB && ARCH_SCX30G
	select FB_CFB_FILLRECT
	select FB_CFB_COPYAREA
	select FB_CFB_IMAGEBLIT
	help
          Frame buffer driver for sc8830G based boards.

config FB_SCX35L
	boolean "SharkL frame buffer support "
	depends on FB && ARCH_SCX35L
	select FB_CFB_FILLRECT
	select FB_CFB_COPYAREA
	select FB_CFB_IMAGEBLIT
	help
		Frame buffer driver for SharkL based boards.

config FB_SCX15
	boolean "SC7715 frame buffer support "
	depends on FB && ARCH_SCX15
	select FB_CFB_FILLRECT
	select FB_CFB_COPYAREA
	select FB_CFB_IMAGEBLIT
	help
          Frame buffer driver for sc7715 based boards.

config SPRD_FB_SIZE
	int "MB size for frame buffer, should larger or equal lcd_w*lcd_h*4*2"
	range 1 16
	default 8
	depends on FB_SC8825 || FB_SCX35 || FB_SCX15 || FB_SCX30G || FB_SCX35L

config FB_LCD_HX8363_MCU
	boolean "support HX8363 panel mcu"
	depends on FB_SC8825 || FB_SCX35 || FB_SCX15
	default n

config FB_LCD_HX8363_RGB_SPI
	boolean "support HX8363 panel rgb spi"
	depends on FB_SC8825 || FB_SCX35 || FB_SCX15
	default n

config FB_LCD_VIVA_RGB_SPI
	boolean "support VIVA panel rgb spi"
	depends on FB_SC8825 || FB_SCX35 || FB_SCX15
	default n

config FB_LCD_HX8369
	boolean "support HX8369 panel"
	depends on FB_SC8825 || FB_SCX35
	default n

config FB_LCD_HX8369B_MIPI_COREPRIMELITE
	boolean "support HX8369B coreprimelite MIPI panel"
	depends on FB_SC8825 || FB_SCX35 || FB_SCX30G || FB_SCX35L
	default n

config FB_LCD_SD7798D_MIPI_COREPRIMELITE
	boolean "support SD7798D coreprimelite MIPI panel"
	depends on FB_SC8825 || FB_SCX35 || FB_SCX30G || FB_SCX35L
	default n

config FB_LCD_HX8369B_MIPI_COREPRIMELITE_MARLIN
	boolean "support HX8369B coreprimelite_marlin MIPI panel"
	depends on FB_SC8825 || FB_SCX35 || FB_SCX30G || FB_SCX35L
	default n

config FB_LCD_HX8369B_MIPI
	boolean "support HX8369B MIPI panel"
	depends on FB_SC8825 || FB_SCX35 || FB_SCX30G
	default n

config FB_LCD_S6D0139
	boolean "support S6D0139 panel"
	depends on FB_SC8825 || FB_SCX35
	default n

config FB_LCD_NT35516_MIPI
	boolean "support NT35516 mipi panel"
	depends on FB_SC8825 || FB_SCX35 || FB_SCX30G || FB_SCX35L
	default n

config FB_LCD_HX8394D_MIPI
	boolean "support HX8394D mipi panel"
	default n

config FB_LCD_ILI6150_LVDS
        boolean "support ILI6150 lvds panel"
        depends on FB_SC8825 || FB_SCX35 || FB_SCX30G || FB_SCX35L
        default n

config FB_LCD_RM68180_MIPI
        boolean "support rm68180 mipi panel"
        depends on FB_SCX35 || FB_SCX35L || FB_SCX30G
        default n

config FB_LCD_DUMMY
	boolean "support DUMMY panel"
	depends on FB_SC8825 || FB_SCX35 || FB_SCX30G || FB_SCX35L
	default y

config FB_LCD_NT35502_MIPI
	boolean "support NT35502 mipi panel"
	depends on FB_SC8825 || FB_SCX35 || FB_SCX30G
	default n

config FB_LCD_ILI9486S1_MIPI
	boolean "support ILI9486S1 mipi panel"
	depends on FB_SCX35 || FB_SCX15 || FB_SCX30G
	default n

config FB_LCD_NT35516_RGB_I2C
	boolean "support NT35516 rgb (i2c) panel"
	depends on FB_SC8825 || FB_SCX35
	default n

config FB_LCD_NT35516_RGB_SPI
	boolean "support NT35516 rgb (spi) panel"
	depends on FB_SC8825 || FB_SCX35 || FB_SCX15
	default n

config FB_LCD_NT35516_MCU
	boolean "support NT35516 mcu panel"
	depends on FB_SC8825 || FB_SCX35 || FB_SCX15 || FB_SCX30G || FB_SCX35L
	default n

config FB_LCD_NT35510_MIPI
	boolean "support NT35510 mipi panel"
	depends on FB_SC8825 || FB_SCX35
	default n

config FB_LCD_NT35512_MIPI
	boolean "support NT35512 mipi panel"
	depends on FB_SC8825 || FB_SCX35
	default n

config FB_LCD_OTM8018B_MIPI
	boolean "support otm 8018b mipi panel"
	depends on FB_SC8825 || FB_SCX35
	default n

config FB_LCD_SSD2075_MIPI
	boolean "support ssd2075 mipi panel"
	depends on FB_SC8825 || FB_SCX35 || FB_SCX30G
	default n

config FB_LCD_ILI9486
	boolean "support ILI9486 mcu panel"
	depends on FB_SC8825 || FB_SCX35 || FB_SCX15
	default n

config FB_LCD_ILI9486_RGB_SPI
	boolean "support ILI9486 rgb spi panel"
	depends on FB_SC8825 || FB_SCX35 || FB_SCX15
	default n

config FB_LCD_SC7798_RGB_SPI
        boolean "support SC7798 rgb spi panel"
        depends on FB_SC8825 || FB_SCX35 || FB_SCX15
        default n

config FB_LCD_ILI9341
	boolean "support ILI9341 mcu panel"
	depends on FB_SC8825 || FB_SCX35 || FB_SCX15
	default n

config FB_LCD_ST7789V_MCU
	boolean "support ST7789V mcu panel"
	depends on FB_SC8825 || FB_SCX35 || FB_SCX15
	default n

config FB_LCD_NT51017_MIPI_LVDS
        boolean "support nt51017 lvds panel"
        depends on FB_SC8825 || FB_SCX35
        default n

config FB_LCD_HX8369B_MIPI
	boolean "support hx8369b mipi panel"
	depends on FB_SC8825 || FB_SCX35
	default n

config FB_LCD_OTM1283A_MIPI
	boolean "support otm 1283a mipi panel"
	depends on FB_SC8825 || FB_SCX35
	default n

config FB_LCD_ILI9806E_MIPI
	boolean "support ili9806e mipi panel"
	depends on FB_SC8825 || FB_SCX35 || FB_SCX35L
	default n

config FB_LCD_ILI9806E_2_MIPI
	boolean "support ili9806e_2 mipi panel"
	depends on FB_SC8825 || FB_SCX35 || FB_SCX35L
	default n

config FB_LCD_T8861_MIPI
	boolean "support t8861 mipi panel"
	depends on FB_SC8825 || FB_SCX35
	default n

config FB_LCD_HX8379A_MIPI
	boolean "support hx8379a mipi panel"
	depends on FB_SC8825 || FB_SCX35 || FB_SCX30G
	default n

config FB_LCD_HX8389C_MIPI
	boolean "support hx8389c mipi panel"
	depends on FB_SC8825 || FB_SCX35 || FB_SCX30G
	default n

config FB_LCD_OTM8019A_MIPI
	boolean "support otm8019a mipi panel"
	depends on FB_SC8825 || FB_SCX35 || FB_SCX30G || FB_SCX35L
	default n

config FB_LCD_RESERVE_MEM
        boolean "support FB reserve mem"
        depends on FB_SC8825 || FB_SCX35 || FB_SCX15 || FB_SCX30G || FB_SCX35L
        default n

config FB_LCD_OVERLAY_SUPPORT
	boolean "support lcd overlay"
	depends on FB_SC8825 || FB_SCX35 || FB_SCX15 || FB_SCX30G || FB_SCX35L
	default n

config FB_VSYNC_SUPPORT
	boolean "support wait for vsync io"
	depends on FB_SC8825 || FB_SCX35 || FB_SCX15 || FB_SCX30G || FB_SCX35L
	default y

config FB_ESD_SUPPORT
	boolean "support esd check"
	depends on FB_SC8825 || FB_SCX35 || FB_SCX30G || FB_SCX35L
	default n

config FB_DYNAMIC_CLK_SUPPORT
	boolean "support close clk dynamically"
	depends on FB_SC8825 || FB_SCX35 || FB_SCX30G || FB_SCX35L
	default n

config FB_DYNAMIC_FREQ_SCALING
	boolean "support change mipi clk/fps/dpi clk dynamically"
	depends on FB_SC8825 || FB_SCX35 || FB_SCX15 || FB_SCX30G || FB_SCX35L
	default y

config FB_MMAP_CACHED
	boolean "support fb_mmap with cach"
	depends on FB_SC8825 || FB_SCX35 ||FB_SCX15
	default n

config FB_LOW_RES_SIMU
	boolean "support low resolution simulator"
	depends on FB_SC8825 || FB_SCX35 ||FB_SCX15 || FB_SCX30G || FB_SCX35L
	default n

config FB_TRIPLE_FRAMEBUFFER
	boolean "support triple buffer"
	depends on FB_SC8825 || FB_SCX35 ||FB_SCX15 || FB_SCX30G || FB_SCX35L
	default y
endif
config FB_LCD_OTM8019A_BOE397_MIPI
	boolean "support  otm8019a boe 397 mipi panel"
	depends on FB_SC8825 || FB_SCX35 || FB_SCX30G
	default n

config FB_LCD_SH1282G_JSJ800_MIPI
	boolean "support  sh1282g yichang 397 mipi panel"
	depends on FB_SC8825 || FB_SCX35 || FB_SCX30G
	default n	
config FB_LCD_OTM8019A_YC3979_MIPI
	boolean "support otm8019a yc3979 mipi panel"
	depends on FB_SC8825 || FB_SCX35 || FB_SCX30G
	default n	
	
config FB_LCD_HX8379C_HSD040F8W9_MIPI
	boolean "support hx8379c_hsd040f8w9 mipi panel"
	depends on FB_SC8825 || FB_SCX35 || FB_SCX30G
	default n	

config FB_LCD_ILI9805_YT40F139A_MIPI
	boolean "support ili9805_yt40f139a mipi panel"
	depends on FB_SC8825 || FB_SCX35 || FB_SCX30G
	default n
	
config FB_LCD_NT35512S_FL040WV200_MIPI
	boolean "support nt35512s_fl040wv200 mipi panel"
	depends on FB_SC8825 || FB_SCX35 || FB_SCX30G
	default n		
		
config FB_LCD_ILI9806E_YC3979_MIPI
	boolean "support ili9806 yc3979 mipi panel"
	depends on FB_SC8825 || FB_SCX35 || FB_SCX30G
	default n

config FB_LCD_FL10802_BOYI_MIPI
	boolean "support  fl10802 boyi 397 mipi panel"
	depends on FB_SC8825 || FB_SCX35 || FB_SCX30G
	default n
	
config FB_LCD_SH1282G_JSJ854_MIPI
	boolean "support  sh1282g jinshijie 397 mipi panel"
	depends on FB_SC8825 || FB_SCX35 || FB_SCX30G
	default n	

config FB_LCD_HF9161B_HS1911_MIPI
	boolean "support  haifei jd9161B huaseng mipi panel"
	depends on FB_SC8825 || FB_SCX35 || FB_SCX30G
	default n
	
config FB_LCD_HX8379C_OUFEI_MIPI
	boolean "support hx8379c oufei mipi panel"
	depends on FB_SC8825 || FB_SCX35  || FB_SCX30G
	default n
	
config FB_LCD_NT35512S_OUFEI_MIPI
	boolean "support nt35512s oufei mipi panel"
	depends on FB_SC8825 || FB_SCX35  || FB_SCX30G
	default n
	
config FB_LCD_FL10802_BOYI_MIPI
	boolean "support fl10802 boyi mipi panel"
	depends on FB_SC8825 || FB_SCX35  || FB_SCX30G
	default n
	
config FB_LCD_ILI9806E_YASHI_MIPI
	boolean "support ili9806 yashi mipi panel"
	depends on FB_SC8825 || FB_SCX35 || FB_SCX30G
	default n		
	
config FB_LCD_ILI9806E_HOLIT0561_MIPI
	boolean "support ili9806 holit0561 mipi panel"
	depends on FB_SC8825 || FB_SCX35 || FB_SCX30G
	default n		

config FB_LCD_SH1282G_CMI_JSJ800_MIPI
	boolean "support  sh1282g cmi397  mipi panel"
	depends on FB_SC8825 || FB_SCX35 || FB_SCX30G
	default n	

config FB_LCD_JD6191_ZGD367_MIPI
	boolean "support jd9161 zgd367 mipi panel"
	depends on FB_SC8825 || FB_SCX35 || FB_SCX30G
	default n	
	
config FB_LCD_ILI9806E_ZGD367_MIPI
	boolean "support ili9806e zgd367 mipi panel"
	depends on FB_SC8825 || FB_SCX35 || FB_SCX30G
	default n	

config FB_LCD_NT35512S_ZGD102_MIPI
	boolean "support nt35512s zgd102 mipi panel"
	depends on FB_SC8825 || FB_SCX35 || FB_SCX30G
	default n	

config FB_LCD_HX8379C_HSD4D5TN_MIPI
	boolean "support hx8379c hsd4d5tn mipi panel"
	depends on FB_SC8825 || FB_SCX35 || FB_SCX30G
	default n		

config FB_LCD_W230_HX8379C_HSD040F8W9_MIPI
	boolean "support w230 hx8379c_hsd040f8w9 mipi panel"
	depends on FB_SC8825 || FB_SCX35 || FB_SCX30G
	default n	
```
