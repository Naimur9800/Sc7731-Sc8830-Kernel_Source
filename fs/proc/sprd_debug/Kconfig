## fs/proc/sprd_debug/Kconfig
```kconfig
config SPRD_DEBUG_FRAME
	bool "sprd debug proc interface support"
	depends on DEBUG_FS
	default y

config PHYMEM_INFO
	bool "physical memory show support"
	depends on SPRD_DEBUG_FRAME
	default y

config USRPROCMEM_INFO
	bool "user proc's memory show support"
	depends on SPRD_DEBUG_FRAME
	default y

config USRPROCSTACK_INFO
	bool "user proc's current stack show support"
	depends on SPRD_DEBUG_FRAME
	default y

config SPRD_CPU_RATE
	bool "open sprd cpu rate compute"
	depends on SPRD_DEBUG_FRAME
	default y

config MORE_SMAPS_INFO
	default y
	depends on PROC_FS && MMU
	bool "Enable more smaps info" if EXPERT
	help
	  Add more infos in /proc/pid/smaps

config SPRD_UBOOT_LOG_DUMP
        bool  "Spreadtrum u-boot log dump"
        depends on SPRD_SYSDUMP && PROC_FS
        default y
        help
          Enable this option to support dumping u-boot log via sysfs from
          userspace
```

## sound/soc/sprd/Kconfig
```kconfig
menuconfig SND_SOC_SPRD
	tristate "ASoC Audio for the SPREADTRUM"
	depends on ARCH_SPRD
	depends on SPRD_DMA
	help
	  Say Y if you want to build Spreadtrum ASOC card.

if SND_SOC_SPRD

config SND_SOC_SPRD_I2S
	tristate #"ASoC Spreadtrum AP I2S sound card(bypass VBC) support"
    help
      Say Y if you want to build in to kernel, Say M for ko module.
      this option will build Spreadtrum AP I2S driver for card bypasses
	  VBC module, e.g. external codec or like BT/Digital FM etc.

config SND_SOC_SPRD_R3P0_SC2731
	tristate "ASoC Spreadtrum sound card with vbc r3p0 and codec sc2731"
        select SPRD_AUDIO_AGDSP_ACCESS
        select SPRD_AUDIO_MEMORY_MANAGER
        select SPRD_AUDIO_SIPC
        select SPRD_MCDT
	select SND_SOC_SPRD_COMPRESS
	select SND_SOC_SPRD_AUDIO_BUFFER_USE_DDR32
	select SND_SOC_SPRD_VBC_R3P0
	select SND_SOC_SPRD_CODEC_SC2731
	select SPRD_AUDIO_DSP_DUMP
	help
	  Say Y or M here if you want to add support for ASoC audio on Spreadtrum
	  boards using the R3P0 VBC and the sc2731 codec.

config SND_SOC_SPRD_R3P0_RT5659
	tristate "ASoC Spreadtrum sound card with vbc r3p0 and codec rt5659"
        select SPRD_AUDIO_AGDSP_ACCESS
        select SPRD_AUDIO_MEMORY_MANAGER
        select SPRD_AUDIO_SIPC
        select SPRD_MCDT
	select SND_SOC_SPRD_COMPRESS
	select SND_SOC_SPRD_AUDIO_BUFFER_USE_DDR32
	select SND_SOC_SPRD_VBC_R3P0
	select SND_SOC_RT5659
	select SPRD_AUDIO_DSP_DUMP
	help
	  Say Y or M here if you want to add support for ASoC audio on Spreadtrum
	  boards using the R3P0 VBC and the rt5659(or compatible) codec.

config SND_SOC_SPRD_R2P0_SC2723
	tristate "ASoC Spreadtrum sound card with vbc r2p0 and codec sc2723"
	select SND_SOC_SPRD_AUDIO_USE_AON_DMA
	select SND_SOC_SPRD_AUDIO_BUFFER_USE_IRAM
	select SND_SOC_SPRD_VBC_R2P0
	select SND_SOC_SPRD_CODEC_SC2723
	select SND_SOC_SPRD_VAUDIO
	help
	  Say Y or M here if you want to add support for ASoC audio on Spreadtrum
	  boards using the R2P0 VBC and the sc2723 codec.

config SND_SOC_SPRD_R1P0V3_SC2721
	tristate "ASoC Spreadtrum sound card with vbc r1p0 v3 and codec sc2721"
	select SND_SOC_SPRD_AUDIO_TWO_STAGE_DMAENGINE_SURPPORT
	select SPRD_AUDIO_MEMORY_MANAGER
	select SND_SOC_SPRD_VBC_R1P0V3
	select SND_SOC_SPRD_CODEC_SC2721
	select SND_SOC_SPRD_VAUDIO
	help
	  Say Y or M here if you want to add support for ASoC audio on Spreadtrum
	  boards using the R1P0 V3 VBC and the sc2721 codec.


config SND_SOC_SPRD_R1P0V3_SC2731
	tristate "ASoC Spreadtrum sound card with vbc r1p0 v3 and codec sc2731"
	select SND_SOC_SPRD_AUDIO_TWO_STAGE_DMAENGINE_SURPPORT
	select SPRD_AUDIO_MEMORY_MANAGER
	select SND_SOC_SPRD_VBC_R1P0V3
	select SND_SOC_SPRD_CODEC_SC2731
	select SND_SOC_SPRD_VAUDIO
	help
	  Say Y or M here if you want to add support for ASoC audio on Spreadtrum
	  boards using the R1P0 V3 VBC and the sc2731 codec.

config SND_SOC_SPRD_I2S_DUMMY
	tristate "ASoC Spreadtrum sound card with AP I2S and a dummy codec"
	select SND_SOC_SPRD_I2S
	help
	  Say Y or M here if you want to add support for ASoC audio on Spreadtrum
	  boards using the AP I2S and a dummy codec.

config SND_SOC_SPRD_I2S_SMARTPA
	tristate "ASoC Spreadtrum sound card with AP I2S and smartpa"
	select SND_SOC_SPRD_I2S
	select SND_SOC_SPRD_AUDIO_TWO_STAGE_DMAENGINE_SURPPORT
	select SPRD_AUDIO_MEMORY_MANAGER
	select SND_SOC_TFA98XX
	help
	  Say Y or M here if you want to add support for ASoC audio on Spreadtrum
	  boards using the AP I2S and tfasmartpa

source "sound/soc/sprd/dai/vbc/Kconfig"
source "sound/soc/sprd/dai/i2s/Kconfig"
source "sound/soc/sprd/dai/vaudio/Kconfig"
source "sound/soc/sprd/platform/Kconfig"
source "sound/soc/sprd/codec/sprd/Kconfig"

endif #SND_SOC_SPRD
```

## sound/soc/sprd/codec/sprd/sc2721/Kconfig
```kconfig
config SND_SOC_SPRD_CODEC_SC2721
	tristate #"Sprd codec sc2721"
	depends on PMIC_SC2721
	select POWER_SUPPLY
	help
	  If the codec is the series of sc2721, set this to Y or M, else N.
```

## sound/soc/sprd/codec/sprd/sc2731/Kconfig
```kconfig
config SND_SOC_SPRD_CODEC_SC2731
	tristate #"Sprd codec sc2731"
	depends on PMIC_SC2731
	select POWER_SUPPLY
	help
	  If the codec is the series of sc2731, set this to Y or M, else N.
```

## sound/soc/sprd/dai/vbc/Kconfig
```kconfig
menu "SPRD VBC Dai Version"
source "sound/soc/sprd/dai/vbc/r1p0v3/Kconfig"
source "sound/soc/sprd/dai/vbc/r3p0/Kconfig"

endmenu
```

## sound/soc/sprd/dai/vbc/r3p0/Kconfig
```kconfig
config SND_SOC_SPRD_VBC_R3P0
	tristate #"VBC R3P0"
	depends on SPRD_MCDT && SPRD_AUDIO_SIPC
	help
	  If the chip is the series of whale(sp9850/sp9860),
	  set Y or M, else N.
```

## sound/soc/sprd/platform/Kconfig
```kconfig
menu "SPRD Platform"

config SND_SOC_SPRD_COMPRESS
	tristate "Enable SPRD Compress Playback Driver"
	depends on SPRD_AUDIO_MEMORY_MANAGER && SPRD_AUDIO_SIPC
	select SND_SOC_COMPRESS
	help
	  Say Y if you want enable SPRD compress(offload) playback driver.

config SND_SOC_SPRD_AUDIO_BUFFER_USE_DDR32
	depends on SPRD_AUDIO_MEMORY_MANAGER
	bool "Use reserved ddr32"
	help
	  Say Y if you want use reserved ddr32 for audio dma buffer

config SND_SOC_SPRD_AUDIO_BUFFER_USE_IRAM
	bool "Use IRAM when sound playback"
	help
	  Say Y if you want use IRAM replacment RAM when playback.
	   sometimes, use IRAM maybe reduce power consumption.
           but, it will cause system more busy, because the buffer smaller.

config SND_SOC_SPRD_IRAM_BACKUP
	bool "Backup IRAM when sound playback"
	depends on SND_SOC_SPRD_AUDIO_BUFFER_USE_IRAM
	help
	  Say Y if you want backup IRAM when playback. sometimes,
	   IRAM maybe shared with other modules,
	   then you need to open this.

config SND_SOC_SPRD_AUDIO_USE_AON_DMA
	bool "Use AON DMA when sound playback"
	depends on SND_SOC_SPRD_AUDIO_BUFFER_USE_IRAM
	help
	  Say Y if you want to use AON DMA when playback, sometimes,
	   AON DMA maybe reduce power consumption. But AON DMA can only
	   access IRAM, so we must depend on IRAM switch.

config SND_SOC_SPRD_AUDIO_TWO_STAGE_DMAENGINE_SURPPORT
	bool "Use 2 stage dma engine"
	help
	  Say Y if you want to use 2stage dma engine, 2 stage dma is
           designed for low power.
endmenu
```
